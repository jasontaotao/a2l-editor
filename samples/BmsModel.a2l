/* Version 1.1 */
ASAP2_VERSION 1 61
/begin PROJECT ProjectName "Project Comment Goes Here"
/begin HEADER "Header Comments go here" /end HEADER
/begin MODULE ModuleName "Module Comment Goes Here"
/begin MOD_PAR "MOD PAR Comment Goes Here" /end MOD_PAR
/begin MOD_COMMON "Mod Common Comment Here" BYTE_ORDER MSB_LAST /end MOD_COMMON
/begin RECORD_LAYOUT Scalar_UBYTE FNC_VALUES 1 UBYTE COLUMN_DIR DIRECT /end RECORD_LAYOUT
/begin RECORD_LAYOUT Scalar_UWORD FNC_VALUES 1 UWORD COLUMN_DIR DIRECT /end RECORD_LAYOUT
/begin RECORD_LAYOUT Scalar_ULONG FNC_VALUES 1 ULONG COLUMN_DIR DIRECT /end RECORD_LAYOUT
/begin RECORD_LAYOUT Scalar_FLOAT32_IEEE FNC_VALUES 1 FLOAT32_IEEE COLUMN_DIR DIRECT /end RECORD_LAYOUT
/begin CHARACTERISTIC RCM_cLoadOffCurr "继电器带载断开电流" VALUE 0x0000 /* @ECU_Address@RCM_cLoadOffCurr@ */ Scalar_FLOAT32_IEEE 0 BMS_CM_single -3.4e+38 3.4e+38 /end CHARACTERISTIC
/begin CHARACTERISTIC OSM_cTiCycOfCtrlUnit_U16 "OSM运行周期" VALUE 0x0000 /* @ECU_Address@OSM_cTiCycOfCtrlUnit_U16@ */ Scalar_UWORD 0 BMS_CM_uint16 0 65535 /end CHARACTERISTIC
/begin CHARACTERISTIC FCM_cMaxAllowUpCurrVaule_F32 "电流补偿最大步长" VALUE 0x0000 /* @ECU_Address@FCM_cMaxAllowUpCurrVaule_F32@ */ Scalar_FLOAT32_IEEE 0 BMS_CM_single -3.4e+38 3.4e+38 /end CHARACTERISTIC
/begin CHARACTERISTIC OSM_cExtremeLoTemp_F32 "未定义" VALUE 0x0000 /* @ECU_Address@OSM_cExtremeLoTemp_F32@ */ Scalar_FLOAT32_IEEE 0 BMS_CM_single -3.4e+38 3.4e+38 /end CHARACTERISTIC
/begin CHARACTERISTIC OSM_cExtremeHiTemp_F32 "未定义" VALUE 0x0000 /* @ECU_Address@OSM_cExtremeHiTemp_F32@ */ Scalar_FLOAT32_IEEE 0 BMS_CM_single -3.4e+38 3.4e+38 /end CHARACTERISTIC
/begin CHARACTERISTIC cEmerHVOffOutTime "紧急下高压超时时间" VALUE 0x0000 /* @ECU_Address@cEmerHVOffOutTime@ */ Scalar_UWORD 0 BMS_CM_uint16 0 65535 /end CHARACTERISTIC
/begin CHARACTERISTIC CEB_cBatPlatFormAreaMaxSoc_F32 "平台区最大SOC值" VALUE 0x0000 /* @ECU_Address@CEB_cBatPlatFormAreaMaxSoc_F32@ */ Scalar_FLOAT32_IEEE 0 BMS_CM_single -3.4e+38 3.4e+38 /end CHARACTERISTIC
/begin CHARACTERISTIC CEB_cBatPlatFormAreaMinSoc_F32 "平台区最小SOC值，当前SOC校准结果不在平台区范围内可用" VALUE 0x0000 /* @ECU_Address@CEB_cBatPlatFormAreaMinSoc_F32@ */ Scalar_FLOAT32_IEEE 0 BMS_CM_single -3.4e+38 3.4e+38 /end CHARACTERISTIC
/begin CHARACTERISTIC BDM_cBattVoltHiLV4En_U8 "总压过高等级4故障诊断使能" VALUE 0x0000 /* @ECU_Address@BDM_cBattVoltHiLV4En_U8@ */ Scalar_UBYTE 0 BMS_CM_uint8 0 255 /end CHARACTERISTIC
/begin CHARACTERISTIC BDM_cBattVoltHiLV4HealEn_U8 "总压过高等级4故障恢复使能" VALUE 0x0000 /* @ECU_Address@BDM_cBattVoltHiLV4HealEn_U8@ */ Scalar_UBYTE 0 BMS_CM_uint8 0 255 /end CHARACTERISTIC
/begin CHARACTERISTIC BDM_cBattVoltHiLV4HealTiDeb_U16 "总压过高等级4故障恢复时间" VALUE 0x0000 /* @ECU_Address@BDM_cBattVoltHiLV4HealTiDeb_U16@ */ Scalar_UWORD 0 BMS_CM_uint16 0 65535 /end CHARACTERISTIC
/begin CHARACTERISTIC BDM_cBattVoltHiLV4HealValue_F32 "总压过高等级4恢复阈值" VALUE 0x0000 /* @ECU_Address@BDM_cBattVoltHiLV4HealValue_F32@ */ Scalar_FLOAT32_IEEE 0 BMS_CM_single -3.4e+38 3.4e+38 /end CHARACTERISTIC
/begin CHARACTERISTIC BDM_cBattVoltHiLV4InitTiDeb_U16 "总压过高等级4故障初始化成熟时间" VALUE 0x0000 /* @ECU_Address@BDM_cBattVoltHiLV4InitTiDeb_U16@ */ Scalar_UWORD 0 BMS_CM_uint16 0 65535 /end CHARACTERISTIC
/begin CHARACTERISTIC BDM_cBattVoltHiLV4TiDeb_U16 "总压过高等级4故障成熟时间" VALUE 0x0000 /* @ECU_Address@BDM_cBattVoltHiLV4TiDeb_U16@ */ Scalar_UWORD 0 BMS_CM_uint16 0 65535 /end CHARACTERISTIC
/begin CHARACTERISTIC BDM_cBattVoltHiLV4Value_F32 "总压过高等级4故障阈值" VALUE 0x0000 /* @ECU_Address@BDM_cBattVoltHiLV4Value_F32@ */ Scalar_FLOAT32_IEEE 0 BMS_CM_single -3.4e+38 3.4e+38 /end CHARACTERISTIC
/begin CHARACTERISTIC BDM_cBattVoltHiLv2En_U8 "总压过高等级2故障诊断使能" VALUE 0x0000 /* @ECU_Address@BDM_cBattVoltHiLv2En_U8@ */ Scalar_UBYTE 0 BMS_CM_uint8 0 255 /end CHARACTERISTIC
/begin CHARACTERISTIC BDM_cBattVoltHiLv2HealEn_U8 "总压过高等级2故障恢复使能" VALUE 0x0000 /* @ECU_Address@BDM_cBattVoltHiLv2HealEn_U8@ */ Scalar_UBYTE 0 BMS_CM_uint8 0 255 /end CHARACTERISTIC
/begin CHARACTERISTIC BDM_cBattVoltHiLv2HealValue_F32 "总压过高等级2恢复阈值" VALUE 0x0000 /* @ECU_Address@BDM_cBattVoltHiLv2HealValue_F32@ */ Scalar_FLOAT32_IEEE 0 BMS_CM_single -3.4e+38 3.4e+38 /end CHARACTERISTIC
/begin CHARACTERISTIC BDM_cBattVoltHiLv2InitTiDeb_U16 "总压过高等级2故障初始化成熟时间" VALUE 0x0000 /* @ECU_Address@BDM_cBattVoltHiLv2InitTiDeb_U16@ */ Scalar_UWORD 0 BMS_CM_uint16 0 65535 /end CHARACTERISTIC
/begin CHARACTERISTIC BDM_cBattVoltHiLv2Value_F32 "总压过高等级2故障阈值" VALUE 0x0000 /* @ECU_Address@BDM_cBattVoltHiLv2Value_F32@ */ Scalar_FLOAT32_IEEE 0 BMS_CM_single -3.4e+38 3.4e+38 /end CHARACTERISTIC
/begin CHARACTERISTIC BDM_cBattVoltHiLv3En_U8 "总压过高等级3故障诊断使能" VALUE 0x0000 /* @ECU_Address@BDM_cBattVoltHiLv3En_U8@ */ Scalar_UBYTE 0 BMS_CM_uint8 0 255 /end CHARACTERISTIC
/begin CHARACTERISTIC BDM_cBattVoltHiLv3HealEn_U8 "总压过高等级3故障恢复使能" VALUE 0x0000 /* @ECU_Address@BDM_cBattVoltHiLv3HealEn_U8@ */ Scalar_UBYTE 0 BMS_CM_uint8 0 255 /end CHARACTERISTIC
/begin CHARACTERISTIC BDM_cBattVoltHiLv3HealTiDeb_U16 "总压过高等级3故障恢复时间" VALUE 0x0000 /* @ECU_Address@BDM_cBattVoltHiLv3HealTiDeb_U16@ */ Scalar_UWORD 0 BMS_CM_uint16 0 65535 /end CHARACTERISTIC
/begin CHARACTERISTIC BDM_cBattVoltHiLv3HealValue_F32 "总压过高等级3恢复阈值" VALUE 0x0000 /* @ECU_Address@BDM_cBattVoltHiLv3HealValue_F32@ */ Scalar_FLOAT32_IEEE 0 BMS_CM_single -3.4e+38 3.4e+38 /end CHARACTERISTIC
/begin CHARACTERISTIC BDM_cBattVoltHiLv3InitTiDeb_U16 "总压过高等级3故障初始化成熟时间" VALUE 0x0000 /* @ECU_Address@BDM_cBattVoltHiLv3InitTiDeb_U16@ */ Scalar_UWORD 0 BMS_CM_uint16 0 65535 /end CHARACTERISTIC
/begin CHARACTERISTIC BDM_cBattVoltHiLv3TiDeb_U16 "总压过高等级3故障成熟时间" VALUE 0x0000 /* @ECU_Address@BDM_cBattVoltHiLv3TiDeb_U16@ */ Scalar_UWORD 0 BMS_CM_uint16 0 65535 /end CHARACTERISTIC
/begin CHARACTERISTIC BDM_cBattVoltHiLv3Value_F32 "总压过高等级3故障阈值" VALUE 0x0000 /* @ECU_Address@BDM_cBattVoltHiLv3Value_F32@ */ Scalar_FLOAT32_IEEE 0 BMS_CM_single -3.4e+38 3.4e+38 /end CHARACTERISTIC
/begin CHARACTERISTIC BDM_cBattVoltLoLv1HealValueTemp1_F32 "总压过低等级1温度1恢复阈值" VALUE 0x0000 /* @ECU_Address@BDM_cBattVoltLoLv1HealValueTemp1_F32@ */ Scalar_FLOAT32_IEEE 0 BMS_CM_single -3.4e+38 3.4e+38 /end CHARACTERISTIC
/begin CHARACTERISTIC BDM_cBattVoltLoLv1HealValueTemp2_F32 "总压过低等级1温度2恢复阈值" VALUE 0x0000 /* @ECU_Address@BDM_cBattVoltLoLv1HealValueTemp2_F32@ */ Scalar_FLOAT32_IEEE 0 BMS_CM_single -3.4e+38 3.4e+38 /end CHARACTERISTIC
/begin CHARACTERISTIC BDM_cBattVoltLoLv1HealValueTemp3_F32 "总压过低等级1温度3恢复阈值" VALUE 0x0000 /* @ECU_Address@BDM_cBattVoltLoLv1HealValueTemp3_F32@ */ Scalar_FLOAT32_IEEE 0 BMS_CM_single -3.4e+38 3.4e+38 /end CHARACTERISTIC
/begin CHARACTERISTIC BDM_cBattVoltLoLv1HealValueTemp4_F32 "总压过低等级1温度4恢复阈值" VALUE 0x0000 /* @ECU_Address@BDM_cBattVoltLoLv1HealValueTemp4_F32@ */ Scalar_FLOAT32_IEEE 0 BMS_CM_single -3.4e+38 3.4e+38 /end CHARACTERISTIC
/begin CHARACTERISTIC BDM_cBattVoltLoLv1ValueTemp1_F32 "总压过低等级1温度1故障阈值" VALUE 0x0000 /* @ECU_Address@BDM_cBattVoltLoLv1ValueTemp1_F32@ */ Scalar_FLOAT32_IEEE 0 BMS_CM_single -3.4e+38 3.4e+38 /end CHARACTERISTIC
/begin CHARACTERISTIC BDM_cBattVoltLoLv1ValueTemp2_F32 "总压过低等级1温度2故障阈值" VALUE 0x0000 /* @ECU_Address@BDM_cBattVoltLoLv1ValueTemp2_F32@ */ Scalar_FLOAT32_IEEE 0 BMS_CM_single -3.4e+38 3.4e+38 /end CHARACTERISTIC
/begin CHARACTERISTIC BDM_cBattVoltLoLv1ValueTemp3_F32 "总压过低等级1温度3故障阈值" VALUE 0x0000 /* @ECU_Address@BDM_cBattVoltLoLv1ValueTemp3_F32@ */ Scalar_FLOAT32_IEEE 0 BMS_CM_single -3.4e+38 3.4e+38 /end CHARACTERISTIC
/begin CHARACTERISTIC BDM_cBattVoltLoLv1ValueTemp4_F32 "总压过低等级1温度4故障阈值" VALUE 0x0000 /* @ECU_Address@BDM_cBattVoltLoLv1ValueTemp4_F32@ */ Scalar_FLOAT32_IEEE 0 BMS_CM_single -3.4e+38 3.4e+38 /end CHARACTERISTIC
/begin CHARACTERISTIC BDM_cBattVoltLoLv2HealValueTemp1_F32 "总压过低等级1温度1恢复阈值" VALUE 0x0000 /* @ECU_Address@BDM_cBattVoltLoLv2HealValueTemp1_F32@ */ Scalar_FLOAT32_IEEE 0 BMS_CM_single -3.4e+38 3.4e+38 /end CHARACTERISTIC
/begin CHARACTERISTIC BDM_cBattVoltLoLv2HealValueTemp2_F32 "总压过低等级2温度2恢复阈值" VALUE 0x0000 /* @ECU_Address@BDM_cBattVoltLoLv2HealValueTemp2_F32@ */ Scalar_FLOAT32_IEEE 0 BMS_CM_single -3.4e+38 3.4e+38 /end CHARACTERISTIC
/begin CHARACTERISTIC BDM_cBattVoltLoLv2HealValueTemp3_F32 "总压过低等级2温度3恢复阈值" VALUE 0x0000 /* @ECU_Address@BDM_cBattVoltLoLv2HealValueTemp3_F32@ */ Scalar_FLOAT32_IEEE 0 BMS_CM_single -3.4e+38 3.4e+38 /end CHARACTERISTIC
/begin CHARACTERISTIC BDM_cBattVoltLoLv2HealValueTemp4_F32 "总压过低等级2温度4恢复阈值" VALUE 0x0000 /* @ECU_Address@BDM_cBattVoltLoLv2HealValueTemp4_F32@ */ Scalar_FLOAT32_IEEE 0 BMS_CM_single -3.4e+38 3.4e+38 /end CHARACTERISTIC
/begin CHARACTERISTIC BDM_cBattVoltLoLv2ValueTemp1_F32 "总压过低等级1温度1故障阈值" VALUE 0x0000 /* @ECU_Address@BDM_cBattVoltLoLv2ValueTemp1_F32@ */ Scalar_FLOAT32_IEEE 0 BMS_CM_single -3.4e+38 3.4e+38 /end CHARACTERISTIC
/begin CHARACTERISTIC BDM_cBattVoltLoLv2ValueTemp2_F32 "总压过低等级2温度2故障阈值" VALUE 0x0000 /* @ECU_Address@BDM_cBattVoltLoLv2ValueTemp2_F32@ */ Scalar_FLOAT32_IEEE 0 BMS_CM_single -3.4e+38 3.4e+38 /end CHARACTERISTIC
/begin CHARACTERISTIC BDM_cBattVoltLoLv2ValueTemp3_F32 "总压过低等级2温度3故障阈值" VALUE 0x0000 /* @ECU_Address@BDM_cBattVoltLoLv2ValueTemp3_F32@ */ Scalar_FLOAT32_IEEE 0 BMS_CM_single -3.4e+38 3.4e+38 /end CHARACTERISTIC
/begin CHARACTERISTIC BDM_cBattVoltLoLv2ValueTemp4_F32 "总压过低等级2温度4故障阈值" VALUE 0x0000 /* @ECU_Address@BDM_cBattVoltLoLv2ValueTemp4_F32@ */ Scalar_FLOAT32_IEEE 0 BMS_CM_single -3.4e+38 3.4e+38 /end CHARACTERISTIC
/begin CHARACTERISTIC BDM_cBattVoltLoLv3HealValueTemp1_F32 "总压过低等级3温度1恢复阈值" VALUE 0x0000 /* @ECU_Address@BDM_cBattVoltLoLv3HealValueTemp1_F32@ */ Scalar_FLOAT32_IEEE 0 BMS_CM_single -3.4e+38 3.4e+38 /end CHARACTERISTIC
/begin CHARACTERISTIC BDM_cBattVoltLoLv3HealValueTemp2_F32 "总压过低等级3温度2恢复阈值" VALUE 0x0000 /* @ECU_Address@BDM_cBattVoltLoLv3HealValueTemp2_F32@ */ Scalar_FLOAT32_IEEE 0 BMS_CM_single -3.4e+38 3.4e+38 /end CHARACTERISTIC
/begin CHARACTERISTIC BDM_cBattVoltLoLv3HealValueTemp3_F32 "总压过低等级3温度3恢复阈值" VALUE 0x0000 /* @ECU_Address@BDM_cBattVoltLoLv3HealValueTemp3_F32@ */ Scalar_FLOAT32_IEEE 0 BMS_CM_single -3.4e+38 3.4e+38 /end CHARACTERISTIC
/begin CHARACTERISTIC BDM_cBattVoltLoLv3HealValueTemp4_F32 "总压过低等级3温度4恢复阈值" VALUE 0x0000 /* @ECU_Address@BDM_cBattVoltLoLv3HealValueTemp4_F32@ */ Scalar_FLOAT32_IEEE 0 BMS_CM_single -3.4e+38 3.4e+38 /end CHARACTERISTIC
/begin CHARACTERISTIC BDM_cBattVoltLoLv3ValueTemp1_F32 "总压过低等级3温度1故障阈值" VALUE 0x0000 /* @ECU_Address@BDM_cBattVoltLoLv3ValueTemp1_F32@ */ Scalar_FLOAT32_IEEE 0 BMS_CM_single -3.4e+38 3.4e+38 /end CHARACTERISTIC
/begin CHARACTERISTIC BDM_cBattVoltLoLv3ValueTemp2_F32 "总压过低等级3温度2故障阈值" VALUE 0x0000 /* @ECU_Address@BDM_cBattVoltLoLv3ValueTemp2_F32@ */ Scalar_FLOAT32_IEEE 0 BMS_CM_single -3.4e+38 3.4e+38 /end CHARACTERISTIC
/begin CHARACTERISTIC BDM_cBattVoltLoLv3ValueTemp3_F32 "总压过低等级3温度3故障阈值" VALUE 0x0000 /* @ECU_Address@BDM_cBattVoltLoLv3ValueTemp3_F32@ */ Scalar_FLOAT32_IEEE 0 BMS_CM_single -3.4e+38 3.4e+38 /end CHARACTERISTIC
/begin CHARACTERISTIC BDM_cBattVoltLoLv3ValueTemp4_F32 "总压过低等级3温度4故障阈值" VALUE 0x0000 /* @ECU_Address@BDM_cBattVoltLoLv3ValueTemp4_F32@ */ Scalar_FLOAT32_IEEE 0 BMS_CM_single -3.4e+38 3.4e+38 /end CHARACTERISTIC
/begin CHARACTERISTIC BDM_cBattVoltLoLv4En_U8 "总压过低等级4故障诊断使能" VALUE 0x0000 /* @ECU_Address@BDM_cBattVoltLoLv4En_U8@ */ Scalar_UBYTE 0 BMS_CM_uint8 0 255 /end CHARACTERISTIC
/begin CHARACTERISTIC BDM_cBattVoltLoLv4HealEn_U8 "总压过低等级4故障恢复使能" VALUE 0x0000 /* @ECU_Address@BDM_cBattVoltLoLv4HealEn_U8@ */ Scalar_UBYTE 0 BMS_CM_uint8 0 255 /end CHARACTERISTIC
/begin CHARACTERISTIC BDM_cBattVoltLoLv4HealValueTemp1_F32 "总压过低等级4温度1恢复阈值" VALUE 0x0000 /* @ECU_Address@BDM_cBattVoltLoLv4HealValueTemp1_F32@ */ Scalar_FLOAT32_IEEE 0 BMS_CM_single -3.4e+38 3.4e+38 /end CHARACTERISTIC
/begin CHARACTERISTIC BDM_cBattVoltLoLv4HealValueTemp2_F32 "总压过低等级4温度2恢复阈值" VALUE 0x0000 /* @ECU_Address@BDM_cBattVoltLoLv4HealValueTemp2_F32@ */ Scalar_FLOAT32_IEEE 0 BMS_CM_single -3.4e+38 3.4e+38 /end CHARACTERISTIC
/begin CHARACTERISTIC BDM_cBattVoltLoLv4HealValueTemp3_F32 "总压过低等级4温度3恢复阈值" VALUE 0x0000 /* @ECU_Address@BDM_cBattVoltLoLv4HealValueTemp3_F32@ */ Scalar_FLOAT32_IEEE 0 BMS_CM_single -3.4e+38 3.4e+38 /end CHARACTERISTIC
/begin CHARACTERISTIC BDM_cBattVoltLoLv4HealValueTemp4_F32 "总压过低等级4温度4恢复阈值" VALUE 0x0000 /* @ECU_Address@BDM_cBattVoltLoLv4HealValueTemp4_F32@ */ Scalar_FLOAT32_IEEE 0 BMS_CM_single -3.4e+38 3.4e+38 /end CHARACTERISTIC
/begin CHARACTERISTIC BDM_cBattVoltLoLv4InitTiDeb_U16 "总压过低等级4故障初始化成熟时间" VALUE 0x0000 /* @ECU_Address@BDM_cBattVoltLoLv4InitTiDeb_U16@ */ Scalar_UWORD 0 BMS_CM_uint16 0 65535 /end CHARACTERISTIC
/begin CHARACTERISTIC BDM_cBattVoltLoLv4ValueTemp1_F32 "总压过低等级4温度1故障阈值" VALUE 0x0000 /* @ECU_Address@BDM_cBattVoltLoLv4ValueTemp1_F32@ */ Scalar_FLOAT32_IEEE 0 BMS_CM_single -3.4e+38 3.4e+38 /end CHARACTERISTIC
/begin CHARACTERISTIC BDM_cBattVoltLoLv4ValueTemp2_F32 "总压过低等级4温度2故障阈值" VALUE 0x0000 /* @ECU_Address@BDM_cBattVoltLoLv4ValueTemp2_F32@ */ Scalar_FLOAT32_IEEE 0 BMS_CM_single -3.4e+38 3.4e+38 /end CHARACTERISTIC
/begin CHARACTERISTIC BDM_cBattVoltLoLv4ValueTemp3_F32 "总压过低等级4温度3故障阈值" VALUE 0x0000 /* @ECU_Address@BDM_cBattVoltLoLv4ValueTemp3_F32@ */ Scalar_FLOAT32_IEEE 0 BMS_CM_single -3.4e+38 3.4e+38 /end CHARACTERISTIC
/begin CHARACTERISTIC BDM_cBattVoltLoLv4ValueTemp4_F32 "总压过低等级4温度4故障阈值" VALUE 0x0000 /* @ECU_Address@BDM_cBattVoltLoLv4ValueTemp4_F32@ */ Scalar_FLOAT32_IEEE 0 BMS_CM_single -3.4e+38 3.4e+38 /end CHARACTERISTIC
/begin CHARACTERISTIC BDM_cCellVoltHiLv4HealTiDeb_U16 "单体过高等级4故障恢复时间" VALUE 0x0000 /* @ECU_Address@BDM_cCellVoltHiLv4HealTiDeb_U16@ */ Scalar_UWORD 0 BMS_CM_uint16 0 65535 /end CHARACTERISTIC
/begin CHARACTERISTIC BDM_cCellVoltHiLv4TiDeb_U16 "单体过高等级4故障成熟时间" VALUE 0x0000 /* @ECU_Address@BDM_cCellVoltHiLv4TiDeb_U16@ */ Scalar_UWORD 0 BMS_CM_uint16 0 65535 /end CHARACTERISTIC
/begin CHARACTERISTIC BDM_cCellVoltLoLv1HealValueTemp2_F32 "总压过低等级1温度2恢复阈值" VALUE 0x0000 /* @ECU_Address@BDM_cCellVoltLoLv1HealValueTemp2_F32@ */ Scalar_UWORD 0 BMS_CM_uint16 0 65535 /end CHARACTERISTIC
/begin CHARACTERISTIC BDM_cCellVoltLoLv1HealValueTemp3_F32 "总压过低等级1温度3恢复阈值" VALUE 0x0000 /* @ECU_Address@BDM_cCellVoltLoLv1HealValueTemp3_F32@ */ Scalar_UWORD 0 BMS_CM_uint16 0 65535 /end CHARACTERISTIC
/begin CHARACTERISTIC BDM_cCellVoltLoLv1HealValueTemp4_F32 "总压过低等级1温度4恢复阈值" VALUE 0x0000 /* @ECU_Address@BDM_cCellVoltLoLv1HealValueTemp4_F32@ */ Scalar_UWORD 0 BMS_CM_uint16 0 65535 /end CHARACTERISTIC
/begin CHARACTERISTIC BDM_cCellVoltLoLv1ValueTemp1_F32 "总压过低等级1温度1故障阈值" VALUE 0x0000 /* @ECU_Address@BDM_cCellVoltLoLv1ValueTemp1_F32@ */ Scalar_UWORD 0 BMS_CM_uint16 0 65535 /end CHARACTERISTIC
/begin CHARACTERISTIC BDM_cCellVoltLoLv1ValueTemp2_F32 "总压过低等级1温度2故障阈值" VALUE 0x0000 /* @ECU_Address@BDM_cCellVoltLoLv1ValueTemp2_F32@ */ Scalar_UWORD 0 BMS_CM_uint16 0 65535 /end CHARACTERISTIC
/begin CHARACTERISTIC BDM_cCellVoltLoLv1ValueTemp3_F32 "总压过低等级1温度3故障阈值" VALUE 0x0000 /* @ECU_Address@BDM_cCellVoltLoLv1ValueTemp3_F32@ */ Scalar_UWORD 0 BMS_CM_uint16 0 65535 /end CHARACTERISTIC
/begin CHARACTERISTIC BDM_cCellVoltLoLv1ValueTemp4_F32 "总压过低等级1温度4故障阈值" VALUE 0x0000 /* @ECU_Address@BDM_cCellVoltLoLv1ValueTemp4_F32@ */ Scalar_UWORD 0 BMS_CM_uint16 0 65535 /end CHARACTERISTIC
/begin CHARACTERISTIC BDM_cCellVoltLoLv2HealValueTemp1_F32 "总压过低等级1温度1恢复阈值" VALUE 0x0000 /* @ECU_Address@BDM_cCellVoltLoLv2HealValueTemp1_F32@ */ Scalar_UWORD 0 BMS_CM_uint16 0 65535 /end CHARACTERISTIC
/begin CHARACTERISTIC BDM_cCellVoltLoLv2HealValueTemp2_F32 "总压过低等级2温度2恢复阈值" VALUE 0x0000 /* @ECU_Address@BDM_cCellVoltLoLv2HealValueTemp2_F32@ */ Scalar_UWORD 0 BMS_CM_uint16 0 65535 /end CHARACTERISTIC
/begin CHARACTERISTIC BDM_cCellVoltLoLv2HealValueTemp3_F32 "总压过低等级2温度3恢复阈值" VALUE 0x0000 /* @ECU_Address@BDM_cCellVoltLoLv2HealValueTemp3_F32@ */ Scalar_UWORD 0 BMS_CM_uint16 0 65535 /end CHARACTERISTIC
/begin CHARACTERISTIC BDM_cCellVoltLoLv2HealValueTemp4_F32 "总压过低等级2温度4恢复阈值" VALUE 0x0000 /* @ECU_Address@BDM_cCellVoltLoLv2HealValueTemp4_F32@ */ Scalar_UWORD 0 BMS_CM_uint16 0 65535 /end CHARACTERISTIC
/begin CHARACTERISTIC BDM_cCellVoltLoLv2ValueTemp1_F32 "总压过低等级1温度1故障阈值" VALUE 0x0000 /* @ECU_Address@BDM_cCellVoltLoLv2ValueTemp1_F32@ */ Scalar_UWORD 0 BMS_CM_uint16 0 65535 /end CHARACTERISTIC
/begin CHARACTERISTIC BDM_cCellVoltLoLv2ValueTemp2_F32 "总压过低等级2温度2故障阈值" VALUE 0x0000 /* @ECU_Address@BDM_cCellVoltLoLv2ValueTemp2_F32@ */ Scalar_UWORD 0 BMS_CM_uint16 0 65535 /end CHARACTERISTIC
/begin CHARACTERISTIC BDM_cCellVoltLoLv2ValueTemp3_F32 "总压过低等级2温度3故障阈值" VALUE 0x0000 /* @ECU_Address@BDM_cCellVoltLoLv2ValueTemp3_F32@ */ Scalar_UWORD 0 BMS_CM_uint16 0 65535 /end CHARACTERISTIC
/begin CHARACTERISTIC BDM_cCellVoltLoLv2ValueTemp4_F32 "总压过低等级2温度4故障阈值" VALUE 0x0000 /* @ECU_Address@BDM_cCellVoltLoLv2ValueTemp4_F32@ */ Scalar_UWORD 0 BMS_CM_uint16 0 65535 /end CHARACTERISTIC
/begin CHARACTERISTIC BDM_cCellVoltLoLv3HealValueTemp1_F32 "总压过低等级3温度1恢复阈值" VALUE 0x0000 /* @ECU_Address@BDM_cCellVoltLoLv3HealValueTemp1_F32@ */ Scalar_UWORD 0 BMS_CM_uint16 0 65535 /end CHARACTERISTIC
/begin CHARACTERISTIC BDM_cCellVoltLoLv3HealValueTemp2_F32 "总压过低等级3温度2恢复阈值" VALUE 0x0000 /* @ECU_Address@BDM_cCellVoltLoLv3HealValueTemp2_F32@ */ Scalar_UWORD 0 BMS_CM_uint16 0 65535 /end CHARACTERISTIC
/begin CHARACTERISTIC BDM_cCellVoltLoLv3HealValueTemp3_F32 "总压过低等级3温度3恢复阈值" VALUE 0x0000 /* @ECU_Address@BDM_cCellVoltLoLv3HealValueTemp3_F32@ */ Scalar_UWORD 0 BMS_CM_uint16 0 65535 /end CHARACTERISTIC
/begin CHARACTERISTIC BDM_cCellVoltLoLv3HealValueTemp4_F32 "总压过低等级3温度4恢复阈值" VALUE 0x0000 /* @ECU_Address@BDM_cCellVoltLoLv3HealValueTemp4_F32@ */ Scalar_UWORD 0 BMS_CM_uint16 0 65535 /end CHARACTERISTIC
/begin CHARACTERISTIC BDM_cCellVoltLoLv3ValueTemp1_F32 "总压过低等级3温度1故障阈值" VALUE 0x0000 /* @ECU_Address@BDM_cCellVoltLoLv3ValueTemp1_F32@ */ Scalar_UWORD 0 BMS_CM_uint16 0 65535 /end CHARACTERISTIC
/begin CHARACTERISTIC BDM_cCellVoltLoLv3ValueTemp2_F32 "总压过低等级3温度2故障阈值" VALUE 0x0000 /* @ECU_Address@BDM_cCellVoltLoLv3ValueTemp2_F32@ */ Scalar_UWORD 0 BMS_CM_uint16 0 65535 /end CHARACTERISTIC
/begin CHARACTERISTIC BDM_cCellVoltLoLv3ValueTemp3_F32 "总压过低等级3温度3故障阈值" VALUE 0x0000 /* @ECU_Address@BDM_cCellVoltLoLv3ValueTemp3_F32@ */ Scalar_UWORD 0 BMS_CM_uint16 0 65535 /end CHARACTERISTIC
/begin CHARACTERISTIC BDM_cCellVoltLoLv3ValueTemp4_F32 "总压过低等级3温度4故障阈值" VALUE 0x0000 /* @ECU_Address@BDM_cCellVoltLoLv3ValueTemp4_F32@ */ Scalar_UWORD 0 BMS_CM_uint16 0 65535 /end CHARACTERISTIC
/begin CHARACTERISTIC BDM_cCellVoltLoLv4HealValueTemp1_F32 "总压过低等级4温度1恢复阈值" VALUE 0x0000 /* @ECU_Address@BDM_cCellVoltLoLv4HealValueTemp1_F32@ */ Scalar_UWORD 0 BMS_CM_uint16 0 65535 /end CHARACTERISTIC
/begin CHARACTERISTIC BDM_cCellVoltLoLv4HealValueTemp2_F32 "总压过低等级4温度2恢复阈值" VALUE 0x0000 /* @ECU_Address@BDM_cCellVoltLoLv4HealValueTemp2_F32@ */ Scalar_UWORD 0 BMS_CM_uint16 0 65535 /end CHARACTERISTIC
/begin CHARACTERISTIC BDM_cCellVoltLoLv4HealValueTemp3_F32 "总压过低等级4温度3恢复阈值" VALUE 0x0000 /* @ECU_Address@BDM_cCellVoltLoLv4HealValueTemp3_F32@ */ Scalar_UWORD 0 BMS_CM_uint16 0 65535 /end CHARACTERISTIC
/begin CHARACTERISTIC BDM_cCellVoltLoLv4HealValueTemp4_F32 "总压过低等级4温度4恢复阈值" VALUE 0x0000 /* @ECU_Address@BDM_cCellVoltLoLv4HealValueTemp4_F32@ */ Scalar_UWORD 0 BMS_CM_uint16 0 65535 /end CHARACTERISTIC
/begin CHARACTERISTIC BDM_cCellVoltLoLv4ValueTemp1_F32 "总压过低等级4温度1故障阈值" VALUE 0x0000 /* @ECU_Address@BDM_cCellVoltLoLv4ValueTemp1_F32@ */ Scalar_UWORD 0 BMS_CM_uint16 0 65535 /end CHARACTERISTIC
/begin CHARACTERISTIC BDM_cCellVoltLoLv4ValueTemp2_F32 "总压过低等级4温度2故障阈值" VALUE 0x0000 /* @ECU_Address@BDM_cCellVoltLoLv4ValueTemp2_F32@ */ Scalar_UWORD 0 BMS_CM_uint16 0 65535 /end CHARACTERISTIC
/begin CHARACTERISTIC BDM_cCellVoltLoLv4ValueTemp3_F32 "总压过低等级4温度3故障阈值" VALUE 0x0000 /* @ECU_Address@BDM_cCellVoltLoLv4ValueTemp3_F32@ */ Scalar_UWORD 0 BMS_CM_uint16 0 65535 /end CHARACTERISTIC
/begin CHARACTERISTIC BDM_cCellVoltLoLv4ValueTemp4_F32 "总压过低等级4温度4故障阈值" VALUE 0x0000 /* @ECU_Address@BDM_cCellVoltLoLv4ValueTemp4_F32@ */ Scalar_UWORD 0 BMS_CM_uint16 0 65535 /end CHARACTERISTIC
/begin CHARACTERISTIC BDM_cChgCellVoltHiLv2En_U8 "充电单体电压过高等级2故障诊断使能" VALUE 0x0000 /* @ECU_Address@BDM_cChgCellVoltHiLv2En_U8@ */ Scalar_UBYTE 0 BMS_CM_uint8 0 255 /end CHARACTERISTIC
/begin CHARACTERISTIC BDM_cChgCellVoltHiLv2HealEn_U8 "充电单体电压过高等级2故障恢复使能" VALUE 0x0000 /* @ECU_Address@BDM_cChgCellVoltHiLv2HealEn_U8@ */ Scalar_UBYTE 0 BMS_CM_uint8 0 255 /end CHARACTERISTIC
/begin CHARACTERISTIC BDM_cChgCellVoltHiLv2HealTiDeb_U16 "充电单体电压过高等级2故障恢复时间" VALUE 0x0000 /* @ECU_Address@BDM_cChgCellVoltHiLv2HealTiDeb_U16@ */ Scalar_UWORD 0 BMS_CM_uint16 0 65535 /end CHARACTERISTIC
/begin CHARACTERISTIC BDM_cChgCellVoltHiLv2HealValue_F32 "充电单体电压过高等级2恢复阈值" VALUE 0x0000 /* @ECU_Address@BDM_cChgCellVoltHiLv2HealValue_F32@ */ Scalar_FLOAT32_IEEE 0 BMS_CM_single -3.4e+38 3.4e+38 /end CHARACTERISTIC
/begin CHARACTERISTIC BDM_cChgCellVoltHiLv2InitTiDeb_U16 "充电单体电压过高2故障初始化成熟时间" VALUE 0x0000 /* @ECU_Address@BDM_cChgCellVoltHiLv2InitTiDeb_U16@ */ Scalar_UWORD 0 BMS_CM_uint16 0 65535 /end CHARACTERISTIC
/begin CHARACTERISTIC BDM_cChgCellVoltHiLv2TiDeb_U16 "充电单体电压过高等级2故障成熟时间" VALUE 0x0000 /* @ECU_Address@BDM_cChgCellVoltHiLv2TiDeb_U16@ */ Scalar_UWORD 0 BMS_CM_uint16 0 65535 /end CHARACTERISTIC
/begin CHARACTERISTIC BDM_cChgCellVoltHiLv2Value_F32 "充电单体电压过高等级2故障阈值" VALUE 0x0000 /* @ECU_Address@BDM_cChgCellVoltHiLv2Value_F32@ */ Scalar_FLOAT32_IEEE 0 BMS_CM_single -3.4e+38 3.4e+38 /end CHARACTERISTIC
/begin CHARACTERISTIC BDM_cChgCellVoltHiLv3En_U8 "充电单体电压过高等级3故障诊断使能" VALUE 0x0000 /* @ECU_Address@BDM_cChgCellVoltHiLv3En_U8@ */ Scalar_UBYTE 0 BMS_CM_uint8 0 255 /end CHARACTERISTIC
/begin CHARACTERISTIC BDM_cChgCellVoltHiLv3HealEn_U8 "充电单体电压过高等级3故障恢复使能" VALUE 0x0000 /* @ECU_Address@BDM_cChgCellVoltHiLv3HealEn_U8@ */ Scalar_UBYTE 0 BMS_CM_uint8 0 255 /end CHARACTERISTIC
/begin CHARACTERISTIC BDM_cChgCellVoltHiLv3HealTiDeb_U16 "充电单体电压过高等级3故障恢复时间" VALUE 0x0000 /* @ECU_Address@BDM_cChgCellVoltHiLv3HealTiDeb_U16@ */ Scalar_UWORD 0 BMS_CM_uint16 0 65535 /end CHARACTERISTIC
/begin CHARACTERISTIC BDM_cChgCellVoltHiLv3HealValue_F32 "充电单体电压过高等级3恢复阈值" VALUE 0x0000 /* @ECU_Address@BDM_cChgCellVoltHiLv3HealValue_F32@ */ Scalar_FLOAT32_IEEE 0 BMS_CM_single -3.4e+38 3.4e+38 /end CHARACTERISTIC
/begin CHARACTERISTIC BDM_cChgCellVoltHiLv3InitTiDeb_U16 "充电单体电压过高3故障初始化成熟时间" VALUE 0x0000 /* @ECU_Address@BDM_cChgCellVoltHiLv3InitTiDeb_U16@ */ Scalar_UWORD 0 BMS_CM_uint16 0 65535 /end CHARACTERISTIC
/begin CHARACTERISTIC BDM_cChgCellVoltHiLv3TiDeb_U16 "充电单体电压过高等级3故障成熟时间" VALUE 0x0000 /* @ECU_Address@BDM_cChgCellVoltHiLv3TiDeb_U16@ */ Scalar_UWORD 0 BMS_CM_uint16 0 65535 /end CHARACTERISTIC
/begin CHARACTERISTIC BDM_cChgCellVoltHiLv3Value_F32 "充电单体电压过高等级3故障阈值" VALUE 0x0000 /* @ECU_Address@BDM_cChgCellVoltHiLv3Value_F32@ */ Scalar_FLOAT32_IEEE 0 BMS_CM_single -3.4e+38 3.4e+38 /end CHARACTERISTIC
/begin CHARACTERISTIC BDM_cDiscCellVoltHiLv2En_U8 "放电单体电压过高等级2故障诊断使能" VALUE 0x0000 /* @ECU_Address@BDM_cDiscCellVoltHiLv2En_U8@ */ Scalar_UBYTE 0 BMS_CM_uint8 0 255 /end CHARACTERISTIC
/begin CHARACTERISTIC BDM_cDiscCellVoltHiLv2HealEn_U8 "放电单体电压过高等级2故障恢复使能" VALUE 0x0000 /* @ECU_Address@BDM_cDiscCellVoltHiLv2HealEn_U8@ */ Scalar_UBYTE 0 BMS_CM_uint8 0 255 /end CHARACTERISTIC
/begin CHARACTERISTIC BDM_cDiscCellVoltHiLv2HealTiDeb_U16 "放电单体电压过高等级2故障恢复时间" VALUE 0x0000 /* @ECU_Address@BDM_cDiscCellVoltHiLv2HealTiDeb_U16@ */ Scalar_UWORD 0 BMS_CM_uint16 0 65535 /end CHARACTERISTIC
/begin CHARACTERISTIC BDM_cDiscCellVoltHiLv2HealValue_F32 "放电单体电压过高等级2恢复阈值" VALUE 0x0000 /* @ECU_Address@BDM_cDiscCellVoltHiLv2HealValue_F32@ */ Scalar_FLOAT32_IEEE 0 BMS_CM_single -3.4e+38 3.4e+38 /end CHARACTERISTIC
/begin CHARACTERISTIC BDM_cDiscCellVoltHiLv2InitTiDeb_U16 "放电单体电压过高2故障初始化成熟时间" VALUE 0x0000 /* @ECU_Address@BDM_cDiscCellVoltHiLv2InitTiDeb_U16@ */ Scalar_UWORD 0 BMS_CM_uint16 0 65535 /end CHARACTERISTIC
/begin CHARACTERISTIC BDM_cDiscCellVoltHiLv2TiDeb_U16 "放电单体电压过高等级2故障成熟时间" VALUE 0x0000 /* @ECU_Address@BDM_cDiscCellVoltHiLv2TiDeb_U16@ */ Scalar_UWORD 0 BMS_CM_uint16 0 65535 /end CHARACTERISTIC
/begin CHARACTERISTIC BDM_cDiscCellVoltHiLv2Value_F32 "放电单体电压过高等级2故障阈值" VALUE 0x0000 /* @ECU_Address@BDM_cDiscCellVoltHiLv2Value_F32@ */ Scalar_FLOAT32_IEEE 0 BMS_CM_single -3.4e+38 3.4e+38 /end CHARACTERISTIC
/begin CHARACTERISTIC BDM_cDiscCellVoltHiLv3En_U8 "放电单体电压过高等级3故障诊断使能" VALUE 0x0000 /* @ECU_Address@BDM_cDiscCellVoltHiLv3En_U8@ */ Scalar_UBYTE 0 BMS_CM_uint8 0 255 /end CHARACTERISTIC
/begin CHARACTERISTIC BDM_cDiscCellVoltHiLv3HealEn_U8 "放电单体电压过高等级3故障恢复使能" VALUE 0x0000 /* @ECU_Address@BDM_cDiscCellVoltHiLv3HealEn_U8@ */ Scalar_UBYTE 0 BMS_CM_uint8 0 255 /end CHARACTERISTIC
/begin CHARACTERISTIC BDM_cDiscCellVoltHiLv3HealTiDeb_U16 "放电单体电压过高等级3故障恢复时间" VALUE 0x0000 /* @ECU_Address@BDM_cDiscCellVoltHiLv3HealTiDeb_U16@ */ Scalar_UWORD 0 BMS_CM_uint16 0 65535 /end CHARACTERISTIC
/begin CHARACTERISTIC BDM_cDiscCellVoltHiLv3HealValue_F32 "放电单体电压过高等级3恢复阈值" VALUE 0x0000 /* @ECU_Address@BDM_cDiscCellVoltHiLv3HealValue_F32@ */ Scalar_FLOAT32_IEEE 0 BMS_CM_single -3.4e+38 3.4e+38 /end CHARACTERISTIC
/begin CHARACTERISTIC BDM_cDiscCellVoltHiLv3InitTiDeb_U16 "放电单体电压过高3故障初始化成熟时间" VALUE 0x0000 /* @ECU_Address@BDM_cDiscCellVoltHiLv3InitTiDeb_U16@ */ Scalar_UWORD 0 BMS_CM_uint16 0 65535 /end CHARACTERISTIC
/begin CHARACTERISTIC BDM_cDiscCellVoltHiLv3TiDeb_U16 "放电单体电压过高等级3故障成熟时间" VALUE 0x0000 /* @ECU_Address@BDM_cDiscCellVoltHiLv3TiDeb_U16@ */ Scalar_UWORD 0 BMS_CM_uint16 0 65535 /end CHARACTERISTIC
/begin CHARACTERISTIC BDM_cDiscCellVoltHiLv3Value_F32 "放电单体电压过高等级3故障阈值" VALUE 0x0000 /* @ECU_Address@BDM_cDiscCellVoltHiLv3Value_F32@ */ Scalar_FLOAT32_IEEE 0 BMS_CM_single -3.4e+38 3.4e+38 /end CHARACTERISTIC
/begin CHARACTERISTIC RCC_cBattQuality_F32 "电池质量" VALUE 0x0000 /* @ECU_Address@RCC_cBattQuality_F32@ */ Scalar_FLOAT32_IEEE 0 BMS_CM_single -3.4e+38 3.4e+38 /end CHARACTERISTIC
/begin CHARACTERISTIC RCC_cCalRemainTimeVersion_U8 "用于选择计算充电剩余时间的算法，1为复杂版，2为简单版" VALUE 0x0000 /* @ECU_Address@RCC_cCalRemainTimeVersion_U8@ */ Scalar_UBYTE 0 BMS_CM_uint8 0 255 /end CHARACTERISTIC
/begin CHARACTERISTIC RCC_cChgCurrChangeRange_F32 "电池电流变化过大的相对幅度（用于及时更新剩余充电时间）" VALUE 0x0000 /* @ECU_Address@RCC_cChgCurrChangeRange_F32@ */ Scalar_FLOAT32_IEEE 0 BMS_CM_single -3.4e+38 3.4e+38 /end CHARACTERISTIC
/begin CHARACTERISTIC RCC_cConstVolChgTime_U32 "恒压充电剩余时间" VALUE 0x0000 /* @ECU_Address@RCC_cConstVolChgTime_U32@ */ Scalar_ULONG 0 BMS_CM_uint32 0 4.29497e+09 /end CHARACTERISTIC
/begin CHARACTERISTIC RCC_cCurConstantQuickJudgeTime_U8 "用于判断电流是否为平均电流的次数" VALUE 0x0000 /* @ECU_Address@RCC_cCurConstantQuickJudgeTime_U8@ */ Scalar_UBYTE 0 BMS_CM_uint8 0 255 /end CHARACTERISTIC
/begin CHARACTERISTIC RCC_cDecreaseCurrentSOC_F32 "降流点SOC" VALUE 0x0000 /* @ECU_Address@RCC_cDecreaseCurrentSOC_F32@ */ Scalar_FLOAT32_IEEE 0 BMS_CM_single -3.4e+38 3.4e+38 /end CHARACTERISTIC
/begin CHARACTERISTIC RCC_cPreChgEndSOC_F32 "预充电结束SOC值" VALUE 0x0000 /* @ECU_Address@RCC_cPreChgEndSOC_F32@ */ Scalar_FLOAT32_IEEE 0 BMS_CM_single -3.4e+38 3.4e+38 /end CHARACTERISTIC
/begin CHARACTERISTIC RCC_cPreChgReqCurrent_F32 "预充电请求电流" VALUE 0x0000 /* @ECU_Address@RCC_cPreChgReqCurrent_F32@ */ Scalar_FLOAT32_IEEE 0 BMS_CM_single -3.4e+38 3.4e+38 /end CHARACTERISTIC
/begin CHARACTERISTIC RCC_cSOCChangeRange_F32 "判断SOC变化的绝对值" VALUE 0x0000 /* @ECU_Address@RCC_cSOCChangeRange_F32@ */ Scalar_FLOAT32_IEEE 0 BMS_CM_single -3.4e+38 3.4e+38 /end CHARACTERISTIC
/begin CHARACTERISTIC RCC_cSpeHeatCapacity_F32 "电池比热容" VALUE 0x0000 /* @ECU_Address@RCC_cSpeHeatCapacity_F32@ */ Scalar_FLOAT32_IEEE 0 BMS_CM_single -3.4e+38 3.4e+38 /end CHARACTERISTIC
/begin CHARACTERISTIC RCC_cThermalConductivity_F32 "导热率" VALUE 0x0000 /* @ECU_Address@RCC_cThermalConductivity_F32@ */ Scalar_FLOAT32_IEEE 0 BMS_CM_single -3.4e+38 3.4e+38 /end CHARACTERISTIC
/begin CHARACTERISTIC CUR_mZerodriftCurThreshold_F32 "零漂电流阈值" VALUE 0x0000 /* @ECU_Address@CUR_mZerodriftCurThreshold_F32@ */ Scalar_FLOAT32_IEEE 0 BMS_CM_single -3.4e+38 3.4e+38 /end CHARACTERISTIC
/begin CHARACTERISTIC RCC_cRemainTimeSpeedDecrease_F32 "显示剩余时间追随速度降低" VALUE 0x0000 /* @ECU_Address@RCC_cRemainTimeSpeedDecrease_F32@ */ Scalar_FLOAT32_IEEE 0 BMS_CM_single -3.4e+38 3.4e+38 /end CHARACTERISTIC
/begin CHARACTERISTIC RCC_cRemainTimeSpeedGain_F32 "显示剩余时间追随速度增益" VALUE 0x0000 /* @ECU_Address@RCC_cRemainTimeSpeedGain_F32@ */ Scalar_FLOAT32_IEEE 0 BMS_CM_single -3.4e+38 3.4e+38 /end CHARACTERISTIC
/begin CHARACTERISTIC SMC_cEmergencyPowOffTiDeb_U16 "触发极限故障下高压延迟时间" VALUE 0x0000 /* @ECU_Address@SMC_cEmergencyPowOffTiDeb_U16@ */ Scalar_UWORD 0 BMS_CM_uint16 0 65535 /end CHARACTERISTIC
/begin CHARACTERISTIC SMC_cThermalPowOffTiDeb_U16 "热管理下高压延迟时间" VALUE 0x0000 /* @ECU_Address@SMC_cThermalPowOffTiDeb_U16@ */ Scalar_UWORD 0 BMS_CM_uint16 0 65535 /end CHARACTERISTIC
/begin CHARACTERISTIC HVP_mVoltReasonHighLim_F32 "高压合理性上限阈值" VALUE 0x0000 /* @ECU_Address@HVP_mVoltReasonHighLim_F32@ */ Scalar_FLOAT32_IEEE 0 BMS_CM_single -3.4e+38 3.4e+38 /end CHARACTERISTIC
/begin CHARACTERISTIC HVP_mVoltReasonLowLim_F32 "高压合理性下限阈值" VALUE 0x0000 /* @ECU_Address@HVP_mVoltReasonLowLim_F32@ */ Scalar_FLOAT32_IEEE 0 BMS_CM_single -3.4e+38 3.4e+38 /end CHARACTERISTIC
/begin CHARACTERISTIC RLM_cLoadOffCurr "继电器带载断开电流" VALUE 0x0000 /* @ECU_Address@RLM_cLoadOffCurr@ */ Scalar_FLOAT32_IEEE 0 BMS_CM_single -3.4e+38 3.4e+38 /end CHARACTERISTIC
/begin CHARACTERISTIC TSM_cChgHeatStartMinTemp_U8 "充电加热开启最小单体温度阈值" VALUE 0x0000 /* @ECU_Address@TSM_cChgHeatStartMinTemp_U8@ */ Scalar_UBYTE 0 BMS_CM_uint8 0 255 /end CHARACTERISTIC
/begin CHARACTERISTIC TSM_cChgHeatStopMinTemp_U8 "充电加热关闭最小单体温度阈值" VALUE 0x0000 /* @ECU_Address@TSM_cChgHeatStopMinTemp_U8@ */ Scalar_UBYTE 0 BMS_CM_uint8 0 255 /end CHARACTERISTIC
/begin CHARACTERISTIC TSM_cChgTMSCoolTempHi_U8 "TMS充电冷却阈值上限" VALUE 0x0000 /* @ECU_Address@TSM_cChgTMSCoolTempHi_U8@ */ Scalar_UBYTE 0 BMS_CM_uint8 0 255 /end CHARACTERISTIC
/begin CHARACTERISTIC TSM_cChgTMSCoolTempLo_U8 "TMS充电冷却阈值下限" VALUE 0x0000 /* @ECU_Address@TSM_cChgTMSCoolTempLo_U8@ */ Scalar_UBYTE 0 BMS_CM_uint8 0 255 /end CHARACTERISTIC
/begin CHARACTERISTIC TSM_cChgTMSHeatTempHi_U8 "TMS充电加热阈值上限" VALUE 0x0000 /* @ECU_Address@TSM_cChgTMSHeatTempHi_U8@ */ Scalar_UBYTE 0 BMS_CM_uint8 0 255 /end CHARACTERISTIC
/begin CHARACTERISTIC TSM_cChgTMSHeatTempLo_U8 "TMS充电加热阈值下限" VALUE 0x0000 /* @ECU_Address@TSM_cChgTMSHeatTempLo_U8@ */ Scalar_UBYTE 0 BMS_CM_uint8 0 255 /end CHARACTERISTIC
/begin CHARACTERISTIC TSM_cCirculationStartTemp_U8 "自循环开启阈值" VALUE 0x0000 /* @ECU_Address@TSM_cCirculationStartTemp_U8@ */ Scalar_UBYTE 0 BMS_CM_uint8 0 255 /end CHARACTERISTIC
/begin CHARACTERISTIC TSM_cCirculationStopTemp_U8 "自循环关闭阈值" VALUE 0x0000 /* @ECU_Address@TSM_cCirculationStopTemp_U8@ */ Scalar_UBYTE 0 BMS_CM_uint8 0 255 /end CHARACTERISTIC
/begin CHARACTERISTIC TSM_cCoolStartMaxTemp_U8 "冷却开启最大单体温度阈值" VALUE 0x0000 /* @ECU_Address@TSM_cCoolStartMaxTemp_U8@ */ Scalar_UBYTE 0 BMS_CM_uint8 0 255 /end CHARACTERISTIC
/begin CHARACTERISTIC TSM_cCoolStartMinTemp_U8 "冷却开启平均温度阈值" VALUE 0x0000 /* @ECU_Address@TSM_cCoolStartMinTemp_U8@ */ Scalar_UBYTE 0 BMS_CM_uint8 0 255 /end CHARACTERISTIC
/begin CHARACTERISTIC TSM_cCoolStopMaxTemp_U8 "冷却关闭最大单体温度阈值" VALUE 0x0000 /* @ECU_Address@TSM_cCoolStopMaxTemp_U8@ */ Scalar_UBYTE 0 BMS_CM_uint8 0 255 /end CHARACTERISTIC
/begin CHARACTERISTIC TSM_cCoolStopMinTemp_U8 "冷却关闭平均温度阈值" VALUE 0x0000 /* @ECU_Address@TSM_cCoolStopMinTemp_U8@ */ Scalar_UBYTE 0 BMS_CM_uint8 0 255 /end CHARACTERISTIC
/begin CHARACTERISTIC TSM_cDiscHeatStartMinTemp_U8 "放电加热开启最小单体温度阈值" VALUE 0x0000 /* @ECU_Address@TSM_cDiscHeatStartMinTemp_U8@ */ Scalar_UBYTE 0 BMS_CM_uint8 0 255 /end CHARACTERISTIC
/begin CHARACTERISTIC TSM_cDiscHeatStopMinTemp_U8 "放电加热关闭最小单体温度阈值" VALUE 0x0000 /* @ECU_Address@TSM_cDiscHeatStopMinTemp_U8@ */ Scalar_UBYTE 0 BMS_CM_uint8 0 255 /end CHARACTERISTIC
/begin CHARACTERISTIC TSM_cDiscTMSCoolTempHi_U8 "TMS放电冷却阈值上限" VALUE 0x0000 /* @ECU_Address@TSM_cDiscTMSCoolTempHi_U8@ */ Scalar_UBYTE 0 BMS_CM_uint8 0 255 /end CHARACTERISTIC
/begin CHARACTERISTIC TSM_cDiscTMSCoolTempLo_U8 "TMS放电冷却阈值下限" VALUE 0x0000 /* @ECU_Address@TSM_cDiscTMSCoolTempLo_U8@ */ Scalar_UBYTE 0 BMS_CM_uint8 0 255 /end CHARACTERISTIC
/begin CHARACTERISTIC TSM_cDiscTMSHeatTempHi_U8 "TMS放电加热阈值上限" VALUE 0x0000 /* @ECU_Address@TSM_cDiscTMSHeatTempHi_U8@ */ Scalar_UBYTE 0 BMS_CM_uint8 0 255 /end CHARACTERISTIC
/begin CHARACTERISTIC TSM_cDiscTMSHeatTempLo_U8 "TMS放电加热阈值下限" VALUE 0x0000 /* @ECU_Address@TSM_cDiscTMSHeatTempLo_U8@ */ Scalar_UBYTE 0 BMS_CM_uint8 0 255 /end CHARACTERISTIC
/begin CHARACTERISTIC TSM_cHeatStartMaxTemp_U8 "加热开启最大单体温度阈值" VALUE 0x0000 /* @ECU_Address@TSM_cHeatStartMaxTemp_U8@ */ Scalar_UBYTE 0 BMS_CM_uint8 0 255 /end CHARACTERISTIC
/begin CHARACTERISTIC TSM_cHeatStopMaxTemp_U8 "加热关闭最大单体温度阈值" VALUE 0x0000 /* @ECU_Address@TSM_cHeatStopMaxTemp_U8@ */ Scalar_UBYTE 0 BMS_CM_uint8 0 255 /end CHARACTERISTIC
/begin CHARACTERISTIC TSM_cStPreHeatStopTemp_U8 "纯加热停止温度" VALUE 0x0000 /* @ECU_Address@TSM_cStPreHeatStopTemp_U8@ */ Scalar_UBYTE 0 BMS_CM_uint8 0 255 /end CHARACTERISTIC
/begin CHARACTERISTIC FCMGB_cDischgVoltMinReq_F32 "最低允许放电总电压" VALUE 0x0000 /* @ECU_Address@FCMGB_cDischgVoltMinReq_F32@ */ Scalar_FLOAT32_IEEE 0 BMS_CM_single -3.4e+38 3.4e+38 /end CHARACTERISTIC
/begin CHARACTERISTIC BDM_cThermalMagDisChgCurLoLv1TiDeb_U16 "放电热管理电流过低等级1故障成熟时间" VALUE 0x0000 /* @ECU_Address@BDM_cThermalMagDisChgCurLoLv1TiDeb_U16@ */ Scalar_UWORD 0 BMS_CM_uint16 0 65535 /end CHARACTERISTIC
/begin CHARACTERISTIC RCM_cBattOKVolt "总压有效阈值" VALUE 0x0000 /* @ECU_Address@RCM_cBattOKVolt@ */ Scalar_FLOAT32_IEEE 0 BMS_CM_single -3.4e+38 3.4e+38 /end CHARACTERISTIC
/begin CHARACTERISTIC RCM_cOpenRlyOKCur "继电器断开电流" VALUE 0x0000 /* @ECU_Address@RCM_cOpenRlyOKCur@ */ Scalar_FLOAT32_IEEE 0 BMS_CM_single -3.4e+38 3.4e+38 /end CHARACTERISTIC
/begin CHARACTERISTIC RCM_cOpenRlyOKTime "带载切断最长等待时间" VALUE 0x0000 /* @ECU_Address@RCM_cOpenRlyOKTime@ */ Scalar_UWORD 0 BMS_CM_uint16 0 65535 /end CHARACTERISTIC
/begin CHARACTERISTIC RCM_cPreChgTiOutTime "预充超时时间阈值1.5s" VALUE 0x0000 /* @ECU_Address@RCM_cPreChgTiOutTime@ */ Scalar_UWORD 0 BMS_CM_uint16 0 65535 /end CHARACTERISTIC
/begin CHARACTERISTIC RCM_cPreChrgOKRate "预充完成阈值" VALUE 0x0000 /* @ECU_Address@RCM_cPreChrgOKRate@ */ Scalar_FLOAT32_IEEE 0 BMS_CM_single -3.4e+38 3.4e+38 /end CHARACTERISTIC
/begin CHARACTERISTIC RCM_cPreChrgOKVolt "预充完成电压阈值" VALUE 0x0000 /* @ECU_Address@RCM_cPreChrgOKVolt@ */ Scalar_FLOAT32_IEEE 0 BMS_CM_single -3.4e+38 3.4e+38 /end CHARACTERISTIC
/begin CHARACTERISTIC RCM_cPreChrgOverCur "预充过流阈值" VALUE 0x0000 /* @ECU_Address@RCM_cPreChrgOverCur@ */ Scalar_FLOAT32_IEEE 0 BMS_CM_single -3.4e+38 3.4e+38 /end CHARACTERISTIC
/begin CHARACTERISTIC RCM_cRlyClsOKRate "继电器闭合阈值" VALUE 0x0000 /* @ECU_Address@RCM_cRlyClsOKRate@ */ Scalar_FLOAT32_IEEE 0 BMS_CM_single -3.4e+38 3.4e+38 /end CHARACTERISTIC
/begin CHARACTERISTIC RCM_cRlyErrOpenRate "继电器无法闭合阈值" VALUE 0x0000 /* @ECU_Address@RCM_cRlyErrOpenRate@ */ Scalar_FLOAT32_IEEE 0 BMS_CM_single -3.4e+38 3.4e+38 /end CHARACTERISTIC
/begin CHARACTERISTIC RCM_cRlyOpenTime "继电器动作时间" VALUE 0x0000 /* @ECU_Address@RCM_cRlyOpenTime@ */ Scalar_UWORD 0 BMS_CM_uint16 0 65535 /end CHARACTERISTIC
/begin CHARACTERISTIC RCM_cRlyOpenWldErrVolt "继电器粘连与无法闭合故障电压阈值" VALUE 0x0000 /* @ECU_Address@RCM_cRlyOpenWldErrVolt@ */ Scalar_FLOAT32_IEEE 0 BMS_CM_single -3.4e+38 3.4e+38 /end CHARACTERISTIC
/begin CHARACTERISTIC COSP_BattRateVol "电池包标称电压" VALUE 0x0000 /* @ECU_Address@COSP_BattRateVol@ */ Scalar_FLOAT32_IEEE 0 BMS_CM_single -3.4e+38 3.4e+38 /end CHARACTERISTIC
/begin CHARACTERISTIC BCU_AfeNum "一路下面是AFE个数" VALUE 0x0000 /* @ECU_Address@BCU_AfeNum@ */ Scalar_UBYTE 0 BMS_CM_uint8 0 255 /end CHARACTERISTIC
/begin CHARACTERISTIC BCU_Afe_Tote "AFE的总数" VALUE 0x0000 /* @ECU_Address@BCU_Afe_Tote@ */ Scalar_UBYTE 0 BMS_CM_uint8 0 255 /end CHARACTERISTIC
/begin CHARACTERISTIC BCU_CAN_CellTNum "一个CAN转接下面单体温度个数" VALUE 0x0000 /* @ECU_Address@BCU_CAN_CellTNum@ */ Scalar_UWORD 0 BMS_CM_uint16 0 65535 /end CHARACTERISTIC
/begin CHARACTERISTIC BCU_CAN_CellVNum "一个CAN转接下面单体电压个数" VALUE 0x0000 /* @ECU_Address@BCU_CAN_CellVNum@ */ Scalar_UWORD 0 BMS_CM_uint16 0 65535 /end CHARACTERISTIC
/begin CHARACTERISTIC BCU_CanNum "CAN转接模块个数" VALUE 0x0000 /* @ECU_Address@BCU_CanNum@ */ Scalar_UBYTE 0 BMS_CM_uint8 0 255 /end CHARACTERISTIC
/begin CHARACTERISTIC BCU_CellTNum "所有单体温度个数" VALUE 0x0000 /* @ECU_Address@BCU_CellTNum@ */ Scalar_UWORD 0 BMS_CM_uint16 0 65535 /end CHARACTERISTIC
/begin CHARACTERISTIC BCU_CellVNum "所有单体电压个数" VALUE 0x0000 /* @ECU_Address@BCU_CellVNum@ */ Scalar_UWORD 0 BMS_CM_uint16 0 65535 /end CHARACTERISTIC
/begin CHARACTERISTIC SOH_tRunTs_C "未定义" VALUE 0x0000 /* @ECU_Address@SOH_tRunTs_C@ */ Scalar_FLOAT32_IEEE 0 BMS_CM_single -3.4e+38 3.4e+38 /end CHARACTERISTIC
/begin CHARACTERISTIC COSP_BattRateCap "电池包额定容量" VALUE 0x0000 /* @ECU_Address@COSP_BattRateCap@ */ Scalar_UWORD 0 BMS_CM_uint16 0 65535 /end CHARACTERISTIC
/begin CHARACTERISTIC COSP_BattRateV0l "电池包额定电压" VALUE 0x0000 /* @ECU_Address@COSP_BattRateV0l@ */ Scalar_FLOAT32_IEEE 0 BMS_CM_single -3.4e+38 3.4e+38 /end CHARACTERISTIC
/begin CHARACTERISTIC COSP_BattType "电池类型" VALUE 0x0000 /* @ECU_Address@COSP_BattType@ */ Scalar_UBYTE 0 BMS_CM_uint8 0 255 /end CHARACTERISTIC
/begin CHARACTERISTIC COSP_CellNum "PACK中单体电芯的总数目" VALUE 0x0000 /* @ECU_Address@COSP_CellNum@ */ Scalar_UWORD 0 BMS_CM_uint16 0 65535 /end CHARACTERISTIC
/begin CHARACTERISTIC COSP_CellVol "单体平台电压" VALUE 0x0000 /* @ECU_Address@COSP_CellVol@ */ Scalar_FLOAT32_IEEE 0 BMS_CM_single -3.4e+38 3.4e+38 /end CHARACTERISTIC
/begin CHARACTERISTIC COSP_CoolMode "电池冷却方式" VALUE 0x0000 /* @ECU_Address@COSP_CoolMode@ */ Scalar_UBYTE 0 BMS_CM_uint8 0 255 /end CHARACTERISTIC
/begin CHARACTERISTIC COSP_MaxCellVol "单体可用最高电压" VALUE 0x0000 /* @ECU_Address@COSP_MaxCellVol@ */ Scalar_FLOAT32_IEEE 0 BMS_CM_single -3.4e+38 3.4e+38 /end CHARACTERISTIC
/begin CHARACTERISTIC COSP_MinCellVol "单体可用最低电压" VALUE 0x0000 /* @ECU_Address@COSP_MinCellVol@ */ Scalar_FLOAT32_IEEE 0 BMS_CM_single -3.4e+38 3.4e+38 /end CHARACTERISTIC
/begin CHARACTERISTIC COSP_TempNum "PACK中电芯温度点(探针)的总数目" VALUE 0x0000 /* @ECU_Address@COSP_TempNum@ */ Scalar_UWORD 0 BMS_CM_uint16 0 65535 /end CHARACTERISTIC
/begin CHARACTERISTIC COSP_CSCNum "电池系统中CSC总的数目" VALUE 0x0000 /* @ECU_Address@COSP_CSCNum@ */ Scalar_UBYTE 0 BMS_CM_uint8 0 255 /end CHARACTERISTIC
/begin CHARACTERISTIC TRM_cCellVoltChangeSpeed_U16 "热失控单体电压变化速度阈值" VALUE 0x0000 /* @ECU_Address@TRM_cCellVoltChangeSpeed_U16@ */ Scalar_UWORD 0 BMS_CM_uint16 0 65535 /end CHARACTERISTIC
/begin CHARACTERISTIC TRM_cCellVoltMin_U16 "热失控单体电压阈值" VALUE 0x0000 /* @ECU_Address@TRM_cCellVoltMin_U16@ */ Scalar_FLOAT32_IEEE 0 BMS_CM_single -3.4e+38 3.4e+38 /end CHARACTERISTIC
/begin CHARACTERISTIC TRM_cTempChangeSpeed_F32 "热失控温度变化速度阈值" VALUE 0x0000 /* @ECU_Address@TRM_cTempChangeSpeed_F32@ */ Scalar_FLOAT32_IEEE 0 BMS_CM_single -3.4e+38 3.4e+38 /end CHARACTERISTIC
/begin CHARACTERISTIC TRM_cTempMax_F32 "热失控温度阈值" VALUE 0x0000 /* @ECU_Address@TRM_cTempMax_F32@ */ Scalar_FLOAT32_IEEE 0 BMS_CM_single -3.4e+38 3.4e+38 /end CHARACTERISTIC
/begin CHARACTERISTIC TRM_cConditionA1TiDeb_U16 "热失控条件A1成熟时间" VALUE 0x0000 /* @ECU_Address@TRM_cConditionA1TiDeb_U16@ */ Scalar_UWORD 0 BMS_CM_uint16 0 65535 /end CHARACTERISTIC
/begin CHARACTERISTIC TRM_cConditionA2TiDeb_U16 "热失控条件A2成熟时间" VALUE 0x0000 /* @ECU_Address@TRM_cConditionA2TiDeb_U16@ */ Scalar_UWORD 0 BMS_CM_uint16 0 65535 /end CHARACTERISTIC
/begin CHARACTERISTIC TRM_cConditionBTiDeb_U16 "热失控条件B成熟时间" VALUE 0x0000 /* @ECU_Address@TRM_cConditionBTiDeb_U16@ */ Scalar_UWORD 0 BMS_CM_uint16 0 65535 /end CHARACTERISTIC
/begin CHARACTERISTIC TRM_cConditionCTiDeb_U16 "热失控条件C成熟时间" VALUE 0x0000 /* @ECU_Address@TRM_cConditionCTiDeb_U16@ */ Scalar_UWORD 0 BMS_CM_uint16 0 65535 /end CHARACTERISTIC
/begin CHARACTERISTIC TRM_cConditionDTiDeb_U16 "热失控条件D成熟时间" VALUE 0x0000 /* @ECU_Address@TRM_cConditionDTiDeb_U16@ */ Scalar_UWORD 0 BMS_CM_uint16 0 65535 /end CHARACTERISTIC
/begin CHARACTERISTIC TRM_cConditionTimeOut_U16 "热失控超时时间（单位100ms）" VALUE 0x0000 /* @ECU_Address@TRM_cConditionTimeOut_U16@ */ Scalar_UWORD 0 BMS_CM_uint16 0 65535 /end CHARACTERISTIC
/begin CHARACTERISTIC HVP_mRateTotalV_F32 "额定总压" VALUE 0x0000 /* @ECU_Address@HVP_mRateTotalV_F32@ */ Scalar_FLOAT32_IEEE 0 BMS_CM_single -3.4e+38 3.4e+38 /end CHARACTERISTIC
/begin CHARACTERISTIC SOE_tBattRateEnergyRT_C "未定义" VALUE 0x0000 /* @ECU_Address@SOE_tBattRateEnergyRT_C@ */ Scalar_FLOAT32_IEEE 0 BMS_CM_single -3.4e+38 3.4e+38 /end CHARACTERISTIC
/begin CHARACTERISTIC DCOSP_tBatteryType_C "电池种类" VALUE 0x0000 /* @ECU_Address@DCOSP_tBatteryType_C@ */ Scalar_UBYTE 0 BMS_CM_uint8 0 255 /end CHARACTERISTIC
/begin CHARACTERISTIC SOH_tNCMUpSOC_C "未定义" VALUE 0x0000 /* @ECU_Address@SOH_tNCMUpSOC_C@ */ Scalar_FLOAT32_IEEE 0 BMS_CM_single -3.4e+38 3.4e+38 /end CHARACTERISTIC
/begin CHARACTERISTIC SOH_tSOHDownValue_C "未定义" VALUE 0x0000 /* @ECU_Address@SOH_tSOHDownValue_C@ */ Scalar_FLOAT32_IEEE 0 BMS_CM_single -3.4e+38 3.4e+38 /end CHARACTERISTIC
/begin CHARACTERISTIC CEB_cBalanceRatedCurrent_F32 "均衡额定电流(A)" VALUE 0x0000 /* @ECU_Address@CEB_cBalanceRatedCurrent_F32@ */ Scalar_FLOAT32_IEEE 0 BMS_CM_single -3.4e+38 3.4e+38 /end CHARACTERISTIC
/begin CHARACTERISTIC CEB_cBalanceSocMinDiff_F32 "最小均衡soc差" VALUE 0x0000 /* @ECU_Address@CEB_cBalanceSocMinDiff_F32@ */ Scalar_FLOAT32_IEEE 0 BMS_CM_single -3.4e+38 3.4e+38 /end CHARACTERISTIC
/begin CHARACTERISTIC CEB_cBattRateCap_F32 "单包额定容量(Ah)" VALUE 0x0000 /* @ECU_Address@CEB_cBattRateCap_F32@ */ Scalar_FLOAT32_IEEE 0 BMS_CM_single -3.4e+38 3.4e+38 /end CHARACTERISTIC
/begin CHARACTERISTIC CEB_cCellSampDeviation_F32 "电压采样误差(mv)" VALUE 0x0000 /* @ECU_Address@CEB_cCellSampDeviation_F32@ */ Scalar_FLOAT32_IEEE 0 BMS_CM_single -3.4e+38 3.4e+38 /end CHARACTERISTIC
/begin CHARACTERISTIC CEB_cPwmCtrlBalanceMaxTime_F32 "均衡PWM控制周期（s）10分钟" VALUE 0x0000 /* @ECU_Address@CEB_cPwmCtrlBalanceMaxTime_F32@ */ Scalar_FLOAT32_IEEE 0 BMS_CM_single -3.4e+38 3.4e+38 /end CHARACTERISTIC
/begin CHARACTERISTIC CEB_cStaticCalMaxCurrent_F32 "均衡静态最大允许电流" VALUE 0x0000 /* @ECU_Address@CEB_cStaticCalMaxCurrent_F32@ */ Scalar_FLOAT32_IEEE 0 BMS_CM_single -3.4e+38 3.4e+38 /end CHARACTERISTIC
/begin CHARACTERISTIC CEB_cStaticWaitTempAry_F32 "静态均衡等待时间温度Y轴" VALUE 0x0000 /* @ECU_Address@CEB_cStaticWaitTempAry_F32@ */ Scalar_FLOAT32_IEEE 0 BMS_CM_single -3.4e+38 3.4e+38 /end CHARACTERISTIC
/begin CHARACTERISTIC CEB_cVolSOCMaxPlatSlope_F32 "电压/SOC变化斜率" VALUE 0x0000 /* @ECU_Address@CEB_cVolSOCMaxPlatSlope_F32@ */ Scalar_FLOAT32_IEEE 0 BMS_CM_single -3.4e+38 3.4e+38 /end CHARACTERISTIC
/begin CHARACTERISTIC CEB_tBalanceContinuousTime_C "最长均衡持续时间(分)" VALUE 0x0000 /* @ECU_Address@CEB_tBalanceContinuousTime_C@ */ Scalar_ULONG 0 BMS_CM_uint32 0 4.29497e+09 /end CHARACTERISTIC
/begin CHARACTERISTIC CHC_cDownDebounceCycle_U8 "向下补偿电流Debounce周期" VALUE 0x0000 /* @ECU_Address@CHC_cDownDebounceCycle_U8@ */ Scalar_UBYTE 0 BMS_CM_uint8 0 255 /end CHARACTERISTIC
/begin CHARACTERISTIC CHC_cUpDebounceCycle_U8 "向上补偿电流Debounce周期" VALUE 0x0000 /* @ECU_Address@CHC_cUpDebounceCycle_U8@ */ Scalar_UBYTE 0 BMS_CM_uint8 0 255 /end CHARACTERISTIC
/begin CHARACTERISTIC CHC_mChgCurrMaxReq_F32 "单枪充电最大允许电流" VALUE 0x0000 /* @ECU_Address@CHC_mChgCurrMaxReq_F32@ */ Scalar_FLOAT32_IEEE 0 BMS_CM_single -3.4e+38 3.4e+38 /end CHARACTERISTIC
/begin CHARACTERISTIC CHC_mChgVoltMaxReq_F32 "充电最大允许电压" VALUE 0x0000 /* @ECU_Address@CHC_mChgVoltMaxReq_F32@ */ Scalar_FLOAT32_IEEE 0 BMS_CM_single -3.4e+38 3.4e+38 /end CHARACTERISTIC
/begin CHARACTERISTIC CHC_mDoubleChgCurrMaxReq_F32 "双枪充电最大允许电流" VALUE 0x0000 /* @ECU_Address@CHC_mDoubleChgCurrMaxReq_F32@ */ Scalar_FLOAT32_IEEE 0 BMS_CM_single -3.4e+38 3.4e+38 /end CHARACTERISTIC
/begin CHARACTERISTIC CHC_mStationChgCurrMaxReq_F32 "换电站充电最大允许电流" VALUE 0x0000 /* @ECU_Address@CHC_mStationChgCurrMaxReq_F32@ */ Scalar_FLOAT32_IEEE 0 BMS_CM_single -3.4e+38 3.4e+38 /end CHARACTERISTIC
/begin CHARACTERISTIC CHC_tCurLimitStage1Cycle_C "根据电压限制充电电流阶段1的Debounce周期" VALUE 0x0000 /* @ECU_Address@CHC_tCurLimitStage1Cycle_C@ */ Scalar_UBYTE 0 BMS_CM_uint8 0 255 /end CHARACTERISTIC
/begin CHARACTERISTIC CHC_tCurLimitStage2Cycle_C "根据电压限制充电电流阶段2的Debounce周期" VALUE 0x0000 /* @ECU_Address@CHC_tCurLimitStage2Cycle_C@ */ Scalar_UBYTE 0 BMS_CM_uint8 0 255 /end CHARACTERISTIC
/begin CHARACTERISTIC CHC_tCurLimitStage3Cycle_C "根据电压限制充电电流阶段3的Debounce周期" VALUE 0x0000 /* @ECU_Address@CHC_tCurLimitStage3Cycle_C@ */ Scalar_UBYTE 0 BMS_CM_uint8 0 255 /end CHARACTERISTIC
/begin CHARACTERISTIC CHC_tCurLimitStage4Cycle_C "根据电压限制充电电流阶段4的Debounce周期" VALUE 0x0000 /* @ECU_Address@CHC_tCurLimitStage4Cycle_C@ */ Scalar_UBYTE 0 BMS_CM_uint8 0 255 /end CHARACTERISTIC
/begin CHARACTERISTIC CHC_tDownCompensationEn_C "向下补偿触发阈值" VALUE 0x0000 /* @ECU_Address@CHC_tDownCompensationEn_C@ */ Scalar_FLOAT32_IEEE 0 BMS_CM_single -3.4e+38 3.4e+38 /end CHARACTERISTIC
/begin CHARACTERISTIC CHC_tDownCompensationPercent_C "单次触发向下补偿比例" VALUE 0x0000 /* @ECU_Address@CHC_tDownCompensationPercent_C@ */ Scalar_FLOAT32_IEEE 0 BMS_CM_single -3.4e+38 3.4e+38 /end CHARACTERISTIC
/begin CHARACTERISTIC CHC_tFacFstCurrLv1_C "快充一级故障降电流因子" VALUE 0x0000 /* @ECU_Address@CHC_tFacFstCurrLv1_C@ */ Scalar_FLOAT32_IEEE 0 BMS_CM_single -3.4e+38 3.4e+38 /end CHARACTERISTIC
/begin CHARACTERISTIC CHC_tFacFstCurrLv2_C "快充二级故障降电流因子" VALUE 0x0000 /* @ECU_Address@CHC_tFacFstCurrLv2_C@ */ Scalar_FLOAT32_IEEE 0 BMS_CM_single -3.4e+38 3.4e+38 /end CHARACTERISTIC
/begin CHARACTERISTIC CHC_tFacFstCurrLv3_C "快充三级故障降电流因子" VALUE 0x0000 /* @ECU_Address@CHC_tFacFstCurrLv3_C@ */ Scalar_FLOAT32_IEEE 0 BMS_CM_single -3.4e+38 3.4e+38 /end CHARACTERISTIC
/begin CHARACTERISTIC CHC_tFacFstCurrLv4_C "快充四级故障降电流因子" VALUE 0x0000 /* @ECU_Address@CHC_tFacFstCurrLv4_C@ */ Scalar_FLOAT32_IEEE 0 BMS_CM_single -3.4e+38 3.4e+38 /end CHARACTERISTIC
/begin CHARACTERISTIC CHC_tFacSlwCurrLv1_C "慢充一级故障降电流因子" VALUE 0x0000 /* @ECU_Address@CHC_tFacSlwCurrLv1_C@ */ Scalar_FLOAT32_IEEE 0 BMS_CM_single -3.4e+38 3.4e+38 /end CHARACTERISTIC
/begin CHARACTERISTIC CHC_tFacSlwCurrLv2_C "慢充二级故障降电流因子" VALUE 0x0000 /* @ECU_Address@CHC_tFacSlwCurrLv2_C@ */ Scalar_FLOAT32_IEEE 0 BMS_CM_single -3.4e+38 3.4e+38 /end CHARACTERISTIC
/begin CHARACTERISTIC CHC_tFacSlwCurrLv3_C "慢充三级故障降电流因子" VALUE 0x0000 /* @ECU_Address@CHC_tFacSlwCurrLv3_C@ */ Scalar_FLOAT32_IEEE 0 BMS_CM_single -3.4e+38 3.4e+38 /end CHARACTERISTIC
/begin CHARACTERISTIC CHC_tFacSlwCurrLv4_C "慢充四级故障降电流因子" VALUE 0x0000 /* @ECU_Address@CHC_tFacSlwCurrLv4_C@ */ Scalar_FLOAT32_IEEE 0 BMS_CM_single -3.4e+38 3.4e+38 /end CHARACTERISTIC
/begin CHARACTERISTIC CHC_tMaxChgTemp_C "最大可充电温度" VALUE 0x0000 /* @ECU_Address@CHC_tMaxChgTemp_C@ */ Scalar_FLOAT32_IEEE 0 BMS_CM_single -3.4e+38 3.4e+38 /end CHARACTERISTIC
/begin CHARACTERISTIC CHC_tMaxCompensation_C "补偿电流最大值" VALUE 0x0000 /* @ECU_Address@CHC_tMaxCompensation_C@ */ Scalar_FLOAT32_IEEE 0 BMS_CM_single -3.4e+38 3.4e+38 /end CHARACTERISTIC
/begin CHARACTERISTIC CHC_tMinCompensation_C "补偿电流最小值" VALUE 0x0000 /* @ECU_Address@CHC_tMinCompensation_C@ */ Scalar_FLOAT32_IEEE 0 BMS_CM_single -3.4e+38 3.4e+38 /end CHARACTERISTIC
/begin CHARACTERISTIC CHC_tTempCompensationLv1Value_C "温度补偿一阶段补偿数值" VALUE 0x0000 /* @ECU_Address@CHC_tTempCompensationLv1Value_C@ */ Scalar_FLOAT32_IEEE 0 BMS_CM_single -3.4e+38 3.4e+38 /end CHARACTERISTIC
/begin CHARACTERISTIC CHC_tTempCompensationLv1_C "温度补偿一阶段开启阈值" VALUE 0x0000 /* @ECU_Address@CHC_tTempCompensationLv1_C@ */ Scalar_FLOAT32_IEEE 0 BMS_CM_single -3.4e+38 3.4e+38 /end CHARACTERISTIC
/begin CHARACTERISTIC CHC_tTempCompensationLv2Value_C "温度补偿二阶段补偿数值" VALUE 0x0000 /* @ECU_Address@CHC_tTempCompensationLv2Value_C@ */ Scalar_FLOAT32_IEEE 0 BMS_CM_single -3.4e+38 3.4e+38 /end CHARACTERISTIC
/begin CHARACTERISTIC CHC_tTempCompensationLv2_C "温度补偿二阶段开启阈值" VALUE 0x0000 /* @ECU_Address@CHC_tTempCompensationLv2_C@ */ Scalar_FLOAT32_IEEE 0 BMS_CM_single -3.4e+38 3.4e+38 /end CHARACTERISTIC
/begin CHARACTERISTIC CHC_tTempCompensationLv3Value_C "温度补偿三阶段补偿数值" VALUE 0x0000 /* @ECU_Address@CHC_tTempCompensationLv3Value_C@ */ Scalar_FLOAT32_IEEE 0 BMS_CM_single -3.4e+38 3.4e+38 /end CHARACTERISTIC
/begin CHARACTERISTIC CHC_tTempCompensationLv3_C "温度补偿三阶段开启阈值" VALUE 0x0000 /* @ECU_Address@CHC_tTempCompensationLv3_C@ */ Scalar_FLOAT32_IEEE 0 BMS_CM_single -3.4e+38 3.4e+38 /end CHARACTERISTIC
/begin CHARACTERISTIC CHC_tUpCompensationEn_C "向上补偿触发阈值" VALUE 0x0000 /* @ECU_Address@CHC_tUpCompensationEn_C@ */ Scalar_FLOAT32_IEEE 0 BMS_CM_single -3.4e+38 3.4e+38 /end CHARACTERISTIC
/begin CHARACTERISTIC CHC_tUpCompensationPercent_C "单次触发向上补偿比例" VALUE 0x0000 /* @ECU_Address@CHC_tUpCompensationPercent_C@ */ Scalar_FLOAT32_IEEE 0 BMS_CM_single -3.4e+38 3.4e+38 /end CHARACTERISTIC
/begin CHARACTERISTIC SOCRC_tKalR_C "电池模型卡尔曼R值" VALUE 0x0000 /* @ECU_Address@SOCRC_tKalR_C@ */ Scalar_FLOAT32_IEEE 0 BMS_CM_single -3.4e+38 3.4e+38 /end CHARACTERISTIC
/begin CHARACTERISTIC SOCRC_tKalSOCQ_C "电池模型卡尔曼SOC预估Q值" VALUE 0x0000 /* @ECU_Address@SOCRC_tKalSOCQ_C@ */ Scalar_FLOAT32_IEEE 0 BMS_CM_single -3.4e+38 3.4e+38 /end CHARACTERISTIC
/begin CHARACTERISTIC SOCRC_tKalUcQ_C "电池模型卡尔曼Uc预估Q值" VALUE 0x0000 /* @ECU_Address@SOCRC_tKalUcQ_C@ */ Scalar_FLOAT32_IEEE 0 BMS_CM_single -3.4e+38 3.4e+38 /end CHARACTERISTIC
/begin CHARACTERISTIC SOC_BattType_C "1:LFP电池，2:NCM电池" VALUE 0x0000 /* @ECU_Address@SOC_BattType_C@ */ Scalar_UBYTE 0 BMS_CM_uint8 0 255 /end CHARACTERISTIC
/begin CHARACTERISTIC SOC_CapUnchangeTempMax_C "未定义" VALUE 0x0000 /* @ECU_Address@SOC_CapUnchangeTempMax_C@ */ Scalar_FLOAT32_IEEE 0 BMS_CM_single -3.4e+38 3.4e+38 /end CHARACTERISTIC
/begin CHARACTERISTIC SOC_CapUnchangeTempMin_C "未定义" VALUE 0x0000 /* @ECU_Address@SOC_CapUnchangeTempMin_C@ */ Scalar_FLOAT32_IEEE 0 BMS_CM_single -3.4e+38 3.4e+38 /end CHARACTERISTIC
/begin CHARACTERISTIC SOC_RealSOCDownSOC_C "SOC窗口下限值" VALUE 0x0000 /* @ECU_Address@SOC_RealSOCDownSOC_C@ */ Scalar_FLOAT32_IEEE 0 BMS_CM_single -3.4e+38 3.4e+38 /end CHARACTERISTIC
/begin CHARACTERISTIC SOC_RealSOCUpSOC_C "SOC窗口上限值" VALUE 0x0000 /* @ECU_Address@SOC_RealSOCUpSOC_C@ */ Scalar_FLOAT32_IEEE 0 BMS_CM_single -3.4e+38 3.4e+38 /end CHARACTERISTIC
/begin CHARACTERISTIC SOC_mTempVaryValue_C "未定义" VALUE 0x0000 /* @ECU_Address@SOC_mTempVaryValue_C@ */ Scalar_FLOAT32_IEEE 0 BMS_CM_single -3.4e+38 3.4e+38 /end CHARACTERISTIC
/begin CHARACTERISTIC SOC_tBattRateCap_C "标称容量" VALUE 0x0000 /* @ECU_Address@SOC_tBattRateCap_C@ */ Scalar_FLOAT32_IEEE 0 BMS_CM_single -3.4e+38 3.4e+38 /end CHARACTERISTIC
/begin CHARACTERISTIC SOC_tBeforeEmpCurrentRate_C "满放前校准电流倍率" VALUE 0x0000 /* @ECU_Address@SOC_tBeforeEmpCurrentRate_C@ */ Scalar_FLOAT32_IEEE 0 BMS_CM_single -3.4e+38 3.4e+38 /end CHARACTERISTIC
/begin CHARACTERISTIC SOC_tBeforeEmpSOCMarkDown_C "满放前校准SOC区间下限SOC" VALUE 0x0000 /* @ECU_Address@SOC_tBeforeEmpSOCMarkDown_C@ */ Scalar_FLOAT32_IEEE 0 BMS_CM_single -3.4e+38 3.4e+38 /end CHARACTERISTIC
/begin CHARACTERISTIC SOC_tBeforeEmpSOCMarkUp_C "满放前校准SOC区间上限SOC" VALUE 0x0000 /* @ECU_Address@SOC_tBeforeEmpSOCMarkUp_C@ */ Scalar_FLOAT32_IEEE 0 BMS_CM_single -3.4e+38 3.4e+38 /end CHARACTERISTIC
/begin CHARACTERISTIC SOC_tBeforeFullCurrentRate_C "满充前校准电流倍率" VALUE 0x0000 /* @ECU_Address@SOC_tBeforeFullCurrentRate_C@ */ Scalar_FLOAT32_IEEE 0 BMS_CM_single -3.4e+38 3.4e+38 /end CHARACTERISTIC
/begin CHARACTERISTIC SOC_tBeforeFullSOCMarkDown_C "满充前校准SOC区间下限SOC" VALUE 0x0000 /* @ECU_Address@SOC_tBeforeFullSOCMarkDown_C@ */ Scalar_FLOAT32_IEEE 0 BMS_CM_single -3.4e+38 3.4e+38 /end CHARACTERISTIC
/begin CHARACTERISTIC SOC_tBeforeFullSOCMarkUp_C "满充前校准SOC区间上限SOC" VALUE 0x0000 /* @ECU_Address@SOC_tBeforeFullSOCMarkUp_C@ */ Scalar_FLOAT32_IEEE 0 BMS_CM_single -3.4e+38 3.4e+38 /end CHARACTERISTIC
/begin CHARACTERISTIC SOC_tCellVoltHiLim_C "最大电压限制" VALUE 0x0000 /* @ECU_Address@SOC_tCellVoltHiLim_C@ */ Scalar_UWORD 0 BMS_CM_uint16 0 65535 /end CHARACTERISTIC
/begin CHARACTERISTIC SOC_tCellVoltLoLim_C "最小电压限制" VALUE 0x0000 /* @ECU_Address@SOC_tCellVoltLoLim_C@ */ Scalar_UWORD 0 BMS_CM_uint16 0 65535 /end CHARACTERISTIC
/begin CHARACTERISTIC SOC_tChaBeforeFulltime_C "满充前校准时间标定" VALUE 0x0000 /* @ECU_Address@SOC_tChaBeforeFulltime_C@ */ Scalar_UBYTE 0 BMS_CM_uint8 0 255 /end CHARACTERISTIC
/begin CHARACTERISTIC SOC_tChrgFullCalVoltLookUp_C "满充电压" VALUE 0x0000 /* @ECU_Address@SOC_tChrgFullCalVoltLookUp_C@ */ Scalar_FLOAT32_IEEE 0 BMS_CM_single -3.4e+38 3.4e+38 /end CHARACTERISTIC
/begin CHARACTERISTIC SOC_tChrgFullZeroTime_C "满充清零持续最大时间" VALUE 0x0000 /* @ECU_Address@SOC_tChrgFullZeroTime_C@ */ Scalar_ULONG 0 BMS_CM_uint32 0 4.29497e+09 /end CHARACTERISTIC
/begin CHARACTERISTIC SOC_tChrgFullZeroVolt_C "满充清零电压" VALUE 0x0000 /* @ECU_Address@SOC_tChrgFullZeroVolt_C@ */ Scalar_UWORD 0 BMS_CM_uint16 0 65535 /end CHARACTERISTIC
/begin CHARACTERISTIC SOC_tDCchargerMode_C "0:普通模式，1:充放电测试柜模式" VALUE 0x0000 /* @ECU_Address@SOC_tDCchargerMode_C@ */ Scalar_UBYTE 0 BMS_CM_uint8 0 255 /end CHARACTERISTIC
/begin CHARACTERISTIC SOC_tDchBeforeEmptime_C "满放前校准时间标定" VALUE 0x0000 /* @ECU_Address@SOC_tDchBeforeEmptime_C@ */ Scalar_UBYTE 0 BMS_CM_uint8 0 255 /end CHARACTERISTIC
/begin CHARACTERISTIC SOC_tDchrgEmpZeroVolt_C "满放清零电压" VALUE 0x0000 /* @ECU_Address@SOC_tDchrgEmpZeroVolt_C@ */ Scalar_UWORD 0 BMS_CM_uint16 0 65535 /end CHARACTERISTIC
/begin CHARACTERISTIC SOC_tDefaultIniSOC_C "默认初始SOC" VALUE 0x0000 /* @ECU_Address@SOC_tDefaultIniSOC_C@ */ Scalar_FLOAT32_IEEE 0 BMS_CM_single -3.4e+38 3.4e+38 /end CHARACTERISTIC
/begin CHARACTERISTIC SOC_tDefaultIniTemp_C "默认初始温度" VALUE 0x0000 /* @ECU_Address@SOC_tDefaultIniTemp_C@ */ Scalar_FLOAT32_IEEE 0 BMS_CM_single -3.4e+38 3.4e+38 /end CHARACTERISTIC
/begin CHARACTERISTIC SOC_tFirstPlatDownSOC_C "第一平台区下限SOC" VALUE 0x0000 /* @ECU_Address@SOC_tFirstPlatDownSOC_C@ */ Scalar_FLOAT32_IEEE 0 BMS_CM_single -3.4e+38 3.4e+38 /end CHARACTERISTIC
/begin CHARACTERISTIC SOC_tFirstPlatUpSOC_C "第一平台区上限SOC" VALUE 0x0000 /* @ECU_Address@SOC_tFirstPlatUpSOC_C@ */ Scalar_FLOAT32_IEEE 0 BMS_CM_single -3.4e+38 3.4e+38 /end CHARACTERISTIC
/begin CHARACTERISTIC SOC_tFirstSlopeDownSOC_C "第一斜坡区下限SOC" VALUE 0x0000 /* @ECU_Address@SOC_tFirstSlopeDownSOC_C@ */ Scalar_FLOAT32_IEEE 0 BMS_CM_single -3.4e+38 3.4e+38 /end CHARACTERISTIC
/begin CHARACTERISTIC SOC_tFirstSlopeUpSOC_C "第一斜坡区上限SOC" VALUE 0x0000 /* @ECU_Address@SOC_tFirstSlopeUpSOC_C@ */ Scalar_FLOAT32_IEEE 0 BMS_CM_single -3.4e+38 3.4e+38 /end CHARACTERISTIC
/begin CHARACTERISTIC SOC_tFollowDownSOC_C "未定义" VALUE 0x0000 /* @ECU_Address@SOC_tFollowDownSOC_C@ */ Scalar_FLOAT32_IEEE 0 BMS_CM_single -3.4e+38 3.4e+38 /end CHARACTERISTIC
/begin CHARACTERISTIC SOC_tFollowMaxSpeed_C "追随SOC追随最大速率" VALUE 0x0000 /* @ECU_Address@SOC_tFollowMaxSpeed_C@ */ Scalar_FLOAT32_IEEE 0 BMS_CM_single -3.4e+38 3.4e+38 /end CHARACTERISTIC
/begin CHARACTERISTIC SOC_tFollowSOCResetTime_C "追随SOC重置时间" VALUE 0x0000 /* @ECU_Address@SOC_tFollowSOCResetTime_C@ */ Scalar_ULONG 0 BMS_CM_uint32 0 4.29497e+09 /end CHARACTERISTIC
/begin CHARACTERISTIC SOC_tFollowUpSOC_C "未定义" VALUE 0x0000 /* @ECU_Address@SOC_tFollowUpSOC_C@ */ Scalar_FLOAT32_IEEE 0 BMS_CM_single -3.4e+38 3.4e+38 /end CHARACTERISTIC
/begin CHARACTERISTIC SOC_tNoCalCycleTimes "OCV校准缩短循环数标定" VALUE 0x0000 /* @ECU_Address@SOC_tNoCalCycleTimes@ */ Scalar_FLOAT32_IEEE 0 BMS_CM_single -3.4e+38 3.4e+38 /end CHARACTERISTIC
/begin CHARACTERISTIC SOC_tReduceStaticTimeCri "OCV校准缩短时间标准" VALUE 0x0000 /* @ECU_Address@SOC_tReduceStaticTimeCri@ */ Scalar_ULONG 0 BMS_CM_uint32 0 4.29497e+09 /end CHARACTERISTIC
/begin CHARACTERISTIC SOC_tRunTs_C "模型运行时间" VALUE 0x0000 /* @ECU_Address@SOC_tRunTs_C@ */ Scalar_FLOAT32_IEEE 0 BMS_CM_single -3.4e+38 3.4e+38 /end CHARACTERISTIC
/begin CHARACTERISTIC SOC_tSOCBeforeFull_C "满充前SOC校准点" VALUE 0x0000 /* @ECU_Address@SOC_tSOCBeforeFull_C@ */ Scalar_FLOAT32_IEEE 0 BMS_CM_single -3.4e+38 3.4e+38 /end CHARACTERISTIC
/begin CHARACTERISTIC SOC_tSOCWaitFull_C "满充等待SOC" VALUE 0x0000 /* @ECU_Address@SOC_tSOCWaitFull_C@ */ Scalar_FLOAT32_IEEE 0 BMS_CM_single -3.4e+38 3.4e+38 /end CHARACTERISTIC
/begin CHARACTERISTIC SOC_tSecondPlatDownSOC_C "第二平台区下限SOC" VALUE 0x0000 /* @ECU_Address@SOC_tSecondPlatDownSOC_C@ */ Scalar_FLOAT32_IEEE 0 BMS_CM_single -3.4e+38 3.4e+38 /end CHARACTERISTIC
/begin CHARACTERISTIC SOC_tSecondPlatUpSOC_C "第二平台区上限SOC" VALUE 0x0000 /* @ECU_Address@SOC_tSecondPlatUpSOC_C@ */ Scalar_FLOAT32_IEEE 0 BMS_CM_single -3.4e+38 3.4e+38 /end CHARACTERISTIC
/begin CHARACTERISTIC SOC_tSecondSlopeDownSOC_C "第二斜坡区下限SOC" VALUE 0x0000 /* @ECU_Address@SOC_tSecondSlopeDownSOC_C@ */ Scalar_FLOAT32_IEEE 0 BMS_CM_single -3.4e+38 3.4e+38 /end CHARACTERISTIC
/begin CHARACTERISTIC SOC_tSecondSlopeUpSOC_C "第二斜坡区上限SOC" VALUE 0x0000 /* @ECU_Address@SOC_tSecondSlopeUpSOC_C@ */ Scalar_FLOAT32_IEEE 0 BMS_CM_single -3.4e+38 3.4e+38 /end CHARACTERISTIC
/begin CHARACTERISTIC SOC_tStaticCalMaxCurrent_C "静止状态最大电流" VALUE 0x0000 /* @ECU_Address@SOC_tStaticCalMaxCurrent_C@ */ Scalar_FLOAT32_IEEE 0 BMS_CM_single -3.4e+38 3.4e+38 /end CHARACTERISTIC
/begin CHARACTERISTIC SOP_tCountclearTime_C "降电流策略计数恢复阈值2s" VALUE 0x0000 /* @ECU_Address@SOP_tCountclearTime_C@ */ Scalar_UWORD 0 BMS_CM_uint16 0 65535 /end CHARACTERISTIC
/begin CHARACTERISTIC SOP_tDecCurLowerRat_C "触发降电流策略后功率下降平滑功率 x*10/s" VALUE 0x0000 /* @ECU_Address@SOP_tDecCurLowerRat_C@ */ Scalar_FLOAT32_IEEE 0 BMS_CM_single -3.4e+38 3.4e+38 /end CHARACTERISTIC
/begin CHARACTERISTIC SOP_tDecCurRecoverTime2_C "二级限制降电流策略恢复阈值30s" VALUE 0x0000 /* @ECU_Address@SOP_tDecCurRecoverTime2_C@ */ Scalar_UWORD 0 BMS_CM_uint16 0 65535 /end CHARACTERISTIC
/begin CHARACTERISTIC SOP_tDecCurRecoverTime_C "一级限制降电流策略恢复阈值20s" VALUE 0x0000 /* @ECU_Address@SOP_tDecCurRecoverTime_C@ */ Scalar_UWORD 0 BMS_CM_uint16 0 65535 /end CHARACTERISTIC
/begin CHARACTERISTIC SOP_tDecCurTime2_C "二级限制降电流策略阈值180s" VALUE 0x0000 /* @ECU_Address@SOP_tDecCurTime2_C@ */ Scalar_UWORD 0 BMS_CM_uint16 0 65535 /end CHARACTERISTIC
/begin CHARACTERISTIC SOP_tDecCurTime_C "一级限制降电流策略阈值60s" VALUE 0x0000 /* @ECU_Address@SOP_tDecCurTime_C@ */ Scalar_UWORD 0 BMS_CM_uint16 0 65535 /end CHARACTERISTIC
/begin CHARACTERISTIC SOP_tFacDiscPwrLv1_C "放电一级故障降功率因子" VALUE 0x0000 /* @ECU_Address@SOP_tFacDiscPwrLv1_C@ */ Scalar_FLOAT32_IEEE 0 BMS_CM_single -3.4e+38 3.4e+38 /end CHARACTERISTIC
/begin CHARACTERISTIC SOP_tFacDiscPwrLv2_C "放电二级故障降功率因子" VALUE 0x0000 /* @ECU_Address@SOP_tFacDiscPwrLv2_C@ */ Scalar_FLOAT32_IEEE 0 BMS_CM_single -3.4e+38 3.4e+38 /end CHARACTERISTIC
/begin CHARACTERISTIC SOP_tFacDiscPwrLv3_C "放电三级故障降功率因子" VALUE 0x0000 /* @ECU_Address@SOP_tFacDiscPwrLv3_C@ */ Scalar_FLOAT32_IEEE 0 BMS_CM_single -3.4e+38 3.4e+38 /end CHARACTERISTIC
/begin CHARACTERISTIC SOP_tFacFbPwrLv1_C "回馈一级故障降功率因子" VALUE 0x0000 /* @ECU_Address@SOP_tFacFbPwrLv1_C@ */ Scalar_FLOAT32_IEEE 0 BMS_CM_single -3.4e+38 3.4e+38 /end CHARACTERISTIC
/begin CHARACTERISTIC SOP_tFacFbPwrLv2_C "回馈二级故障降功率因子" VALUE 0x0000 /* @ECU_Address@SOP_tFacFbPwrLv2_C@ */ Scalar_FLOAT32_IEEE 0 BMS_CM_single -3.4e+38 3.4e+38 /end CHARACTERISTIC
/begin CHARACTERISTIC SOP_tFacFbPwrLv3_C "回馈三级故障降功率因子" VALUE 0x0000 /* @ECU_Address@SOP_tFacFbPwrLv3_C@ */ Scalar_FLOAT32_IEEE 0 BMS_CM_single -3.4e+38 3.4e+38 /end CHARACTERISTIC
/begin CHARACTERISTIC SOP_tLowerRat_C "功率下降平滑功率 x*10/s" VALUE 0x0000 /* @ECU_Address@SOP_tLowerRat_C@ */ Scalar_FLOAT32_IEEE 0 BMS_CM_single -3.4e+38 3.4e+38 /end CHARACTERISTIC
/begin CHARACTERISTIC SOP_tRatedcapacity_C "系统额定容量" VALUE 0x0000 /* @ECU_Address@SOP_tRatedcapacity_C@ */ Scalar_UWORD 0 BMS_CM_uint16 0 65535 /end CHARACTERISTIC
/begin CHARACTERISTIC SOP_tSeveErrLowerRat_C "极限故障时功率下降平滑功率 x*10/s" VALUE 0x0000 /* @ECU_Address@SOP_tSeveErrLowerRat_C@ */ Scalar_FLOAT32_IEEE 0 BMS_CM_single -3.4e+38 3.4e+38 /end CHARACTERISTIC
/begin CHARACTERISTIC SOP_tUpperRat_C "功率上升平滑功率 x*10/s" VALUE 0x0000 /* @ECU_Address@SOP_tUpperRat_C@ */ Scalar_FLOAT32_IEEE 0 BMS_CM_single -3.4e+38 3.4e+38 /end CHARACTERISTIC
/begin CHARACTERISTIC BDM_DCChgCurrHiLv2HealValue_F32 "快充过流等级2恢复阈值" VALUE 0x0000 /* @ECU_Address@BDM_DCChgCurrHiLv2HealValue_F32@ */ Scalar_FLOAT32_IEEE 0 BMS_CM_single -3.4e+38 3.4e+38 /end CHARACTERISTIC
/begin CHARACTERISTIC BDM_DCChgCurrHiLv2Value_F32 "快充过流等级2故障阈值" VALUE 0x0000 /* @ECU_Address@BDM_DCChgCurrHiLv2Value_F32@ */ Scalar_FLOAT32_IEEE 0 BMS_CM_single -3.4e+38 3.4e+38 /end CHARACTERISTIC
/begin CHARACTERISTIC BDM_DCChgCurrHiLv3HealValue_F32 "快充过流等级3恢复阈值" VALUE 0x0000 /* @ECU_Address@BDM_DCChgCurrHiLv3HealValue_F32@ */ Scalar_FLOAT32_IEEE 0 BMS_CM_single -3.4e+38 3.4e+38 /end CHARACTERISTIC
/begin CHARACTERISTIC BDM_DCChgCurrHiLv3Value_F32 "快充过流等级3故障阈值" VALUE 0x0000 /* @ECU_Address@BDM_DCChgCurrHiLv3Value_F32@ */ Scalar_FLOAT32_IEEE 0 BMS_CM_single -3.4e+38 3.4e+38 /end CHARACTERISTIC
/begin CHARACTERISTIC BDM_cBDMTiCycle_U16 "BDM故障诊断周期" VALUE 0x0000 /* @ECU_Address@BDM_cBDMTiCycle_U16@ */ Scalar_UWORD 0 BMS_CM_uint16 0 65535 /end CHARACTERISTIC
/begin CHARACTERISTIC BDM_cBattVoltHiLv1En_U8 "总压过高等级1故障诊断使能" VALUE 0x0000 /* @ECU_Address@BDM_cBattVoltHiLv1En_U8@ */ Scalar_UBYTE 0 BMS_CM_uint8 0 255 /end CHARACTERISTIC
/begin CHARACTERISTIC BDM_cBattVoltHiLv1HealEn_U8 "总压过高等级1故障恢复使能" VALUE 0x0000 /* @ECU_Address@BDM_cBattVoltHiLv1HealEn_U8@ */ Scalar_UBYTE 0 BMS_CM_uint8 0 255 /end CHARACTERISTIC
/begin CHARACTERISTIC BDM_cBattVoltHiLv1HealTiDeb_U16 "总压过高等级1故障恢复时间" VALUE 0x0000 /* @ECU_Address@BDM_cBattVoltHiLv1HealTiDeb_U16@ */ Scalar_UWORD 0 BMS_CM_uint16 0 65535 /end CHARACTERISTIC
/begin CHARACTERISTIC BDM_cBattVoltHiLv1HealValue_F32 "总压过高等级1恢复阈值" VALUE 0x0000 /* @ECU_Address@BDM_cBattVoltHiLv1HealValue_F32@ */ Scalar_FLOAT32_IEEE 0 BMS_CM_single -3.4e+38 3.4e+38 /end CHARACTERISTIC
/begin CHARACTERISTIC BDM_cBattVoltHiLv1InitTiDeb_U16 "总压过高等级1故障初始化成熟时间" VALUE 0x0000 /* @ECU_Address@BDM_cBattVoltHiLv1InitTiDeb_U16@ */ Scalar_UWORD 0 BMS_CM_uint16 0 65535 /end CHARACTERISTIC
/begin CHARACTERISTIC BDM_cBattVoltHiLv1TiDeb_U16 "总压过高等级1故障成熟时间" VALUE 0x0000 /* @ECU_Address@BDM_cBattVoltHiLv1TiDeb_U16@ */ Scalar_UWORD 0 BMS_CM_uint16 0 65535 /end CHARACTERISTIC
/begin CHARACTERISTIC BDM_cBattVoltHiLv1Value_F32 "总压过高等级1故障阈值" VALUE 0x0000 /* @ECU_Address@BDM_cBattVoltHiLv1Value_F32@ */ Scalar_FLOAT32_IEEE 0 BMS_CM_single -3.4e+38 3.4e+38 /end CHARACTERISTIC
/begin CHARACTERISTIC BDM_cBattVoltLoLv1En_U8 "总压过低等级1故障诊断使能" VALUE 0x0000 /* @ECU_Address@BDM_cBattVoltLoLv1En_U8@ */ Scalar_UBYTE 0 BMS_CM_uint8 0 255 /end CHARACTERISTIC
/begin CHARACTERISTIC BDM_cBattVoltLoLv1HealEn_U8 "总压过低等级1故障恢复使能" VALUE 0x0000 /* @ECU_Address@BDM_cBattVoltLoLv1HealEn_U8@ */ Scalar_UBYTE 0 BMS_CM_uint8 0 255 /end CHARACTERISTIC
/begin CHARACTERISTIC BDM_cBattVoltLoLv1HealTiDeb_U16 "总压过低等级1故障恢复时间" VALUE 0x0000 /* @ECU_Address@BDM_cBattVoltLoLv1HealTiDeb_U16@ */ Scalar_UWORD 0 BMS_CM_uint16 0 65535 /end CHARACTERISTIC
/begin CHARACTERISTIC BDM_cBattVoltLoLv1InitTiDeb_U16 "总压过低1故障初始化成熟时间" VALUE 0x0000 /* @ECU_Address@BDM_cBattVoltLoLv1InitTiDeb_U16@ */ Scalar_UWORD 0 BMS_CM_uint16 0 65535 /end CHARACTERISTIC
/begin CHARACTERISTIC BDM_cBattVoltLoLv1TiDeb_U16 "总压过低等级1故障成熟时间" VALUE 0x0000 /* @ECU_Address@BDM_cBattVoltLoLv1TiDeb_U16@ */ Scalar_UWORD 0 BMS_CM_uint16 0 65535 /end CHARACTERISTIC
/begin CHARACTERISTIC BDM_cBattVoltLoLv2En_U8 "总压过低等级2故障诊断使能" VALUE 0x0000 /* @ECU_Address@BDM_cBattVoltLoLv2En_U8@ */ Scalar_UBYTE 0 BMS_CM_uint8 0 255 /end CHARACTERISTIC
/begin CHARACTERISTIC BDM_cBattVoltLoLv2HealEn_U8 "总压过低等级2故障恢复使能" VALUE 0x0000 /* @ECU_Address@BDM_cBattVoltLoLv2HealEn_U8@ */ Scalar_UBYTE 0 BMS_CM_uint8 0 255 /end CHARACTERISTIC
/begin CHARACTERISTIC BDM_cBattVoltLoLv2HealTiDeb_U16 "总压过低等级2故障恢复时间" VALUE 0x0000 /* @ECU_Address@BDM_cBattVoltLoLv2HealTiDeb_U16@ */ Scalar_UWORD 0 BMS_CM_uint16 0 65535 /end CHARACTERISTIC
/begin CHARACTERISTIC BDM_cBattVoltLoLv2InitTiDeb_U16 "总压过低2故障初始化成熟时间" VALUE 0x0000 /* @ECU_Address@BDM_cBattVoltLoLv2InitTiDeb_U16@ */ Scalar_UWORD 0 BMS_CM_uint16 0 65535 /end CHARACTERISTIC
/begin CHARACTERISTIC BDM_cBattVoltLoLv2TiDeb_U16 "总压过低等级2故障成熟时间" VALUE 0x0000 /* @ECU_Address@BDM_cBattVoltLoLv2TiDeb_U16@ */ Scalar_UWORD 0 BMS_CM_uint16 0 65535 /end CHARACTERISTIC
/begin CHARACTERISTIC BDM_cBattVoltLoLv3En_U8 "总压过低等级3故障诊断使能" VALUE 0x0000 /* @ECU_Address@BDM_cBattVoltLoLv3En_U8@ */ Scalar_UBYTE 0 BMS_CM_uint8 0 255 /end CHARACTERISTIC
/begin CHARACTERISTIC BDM_cBattVoltLoLv3HealEn_U8 "总压过低等级3故障恢复使能" VALUE 0x0000 /* @ECU_Address@BDM_cBattVoltLoLv3HealEn_U8@ */ Scalar_UBYTE 0 BMS_CM_uint8 0 255 /end CHARACTERISTIC
/begin CHARACTERISTIC BDM_cBattVoltLoLv3HealTiDeb_U16 "总压过低等级3故障恢复时间" VALUE 0x0000 /* @ECU_Address@BDM_cBattVoltLoLv3HealTiDeb_U16@ */ Scalar_UWORD 0 BMS_CM_uint16 0 65535 /end CHARACTERISTIC
/begin CHARACTERISTIC BDM_cBattVoltLoLv3InitTiDeb_U16 "总压过低3故障初始化成熟时间" VALUE 0x0000 /* @ECU_Address@BDM_cBattVoltLoLv3InitTiDeb_U16@ */ Scalar_UWORD 0 BMS_CM_uint16 0 65535 /end CHARACTERISTIC
/begin CHARACTERISTIC BDM_cBattVoltLoLv3TiDeb_U16 "总压过低等级3故障成熟时间" VALUE 0x0000 /* @ECU_Address@BDM_cBattVoltLoLv3TiDeb_U16@ */ Scalar_UWORD 0 BMS_CM_uint16 0 65535 /end CHARACTERISTIC
/begin CHARACTERISTIC BDM_cCC2TempHiLv1En_U8 "CC2温度过高等级1故障诊断使能" VALUE 0x0000 /* @ECU_Address@BDM_cCC2TempHiLv1En_U8@ */ Scalar_UBYTE 0 BMS_CM_uint8 0 255 /end CHARACTERISTIC
/begin CHARACTERISTIC BDM_cCC2TempHiLv1HealEn_U8 "CC2温度过高等级1故障恢复使能" VALUE 0x0000 /* @ECU_Address@BDM_cCC2TempHiLv1HealEn_U8@ */ Scalar_UBYTE 0 BMS_CM_uint8 0 255 /end CHARACTERISTIC
/begin CHARACTERISTIC BDM_cCC2TempHiLv1HealTiDeb_U16 "CC2温度过高等级1故障恢复时间" VALUE 0x0000 /* @ECU_Address@BDM_cCC2TempHiLv1HealTiDeb_U16@ */ Scalar_UWORD 0 BMS_CM_uint16 0 65535 /end CHARACTERISTIC
/begin CHARACTERISTIC BDM_cCC2TempHiLv1HealValue_F32 "CC2温度过高等级1恢复阈值" VALUE 0x0000 /* @ECU_Address@BDM_cCC2TempHiLv1HealValue_F32@ */ Scalar_FLOAT32_IEEE 0 BMS_CM_single -3.4e+38 3.4e+38 /end CHARACTERISTIC
/begin CHARACTERISTIC BDM_cCC2TempHiLv1InitTiDeb_U16 "CC2温度过高等级1故障初始化成熟时间" VALUE 0x0000 /* @ECU_Address@BDM_cCC2TempHiLv1InitTiDeb_U16@ */ Scalar_UWORD 0 BMS_CM_uint16 0 65535 /end CHARACTERISTIC
/begin CHARACTERISTIC BDM_cCC2TempHiLv1TiDeb_U16 "CC2温度过高等级1故障成熟时间" VALUE 0x0000 /* @ECU_Address@BDM_cCC2TempHiLv1TiDeb_U16@ */ Scalar_UWORD 0 BMS_CM_uint16 0 65535 /end CHARACTERISTIC
/begin CHARACTERISTIC BDM_cCC2TempHiLv1Value_F32 "CC2温度过高等级1故障阈值" VALUE 0x0000 /* @ECU_Address@BDM_cCC2TempHiLv1Value_F32@ */ Scalar_FLOAT32_IEEE 0 BMS_CM_single -3.4e+38 3.4e+38 /end CHARACTERISTIC
/begin CHARACTERISTIC BDM_cCC2TempHiLv2En_U8 "CC2温度过高等级2故障诊断使能" VALUE 0x0000 /* @ECU_Address@BDM_cCC2TempHiLv2En_U8@ */ Scalar_UBYTE 0 BMS_CM_uint8 0 255 /end CHARACTERISTIC
/begin CHARACTERISTIC BDM_cCC2TempHiLv2HealEn_U8 "CC2温度过高等级2故障恢复使能" VALUE 0x0000 /* @ECU_Address@BDM_cCC2TempHiLv2HealEn_U8@ */ Scalar_UBYTE 0 BMS_CM_uint8 0 255 /end CHARACTERISTIC
/begin CHARACTERISTIC BDM_cCC2TempHiLv2HealTiDeb_U16 "CC2温度过高等级2故障恢复时间" VALUE 0x0000 /* @ECU_Address@BDM_cCC2TempHiLv2HealTiDeb_U16@ */ Scalar_UWORD 0 BMS_CM_uint16 0 65535 /end CHARACTERISTIC
/begin CHARACTERISTIC BDM_cCC2TempHiLv2HealValue_F32 "CC2温度过高等级2恢复阈值" VALUE 0x0000 /* @ECU_Address@BDM_cCC2TempHiLv2HealValue_F32@ */ Scalar_FLOAT32_IEEE 0 BMS_CM_single -3.4e+38 3.4e+38 /end CHARACTERISTIC
/begin CHARACTERISTIC BDM_cCC2TempHiLv2InitTiDeb_U16 "CC2温度过高等级2故障初始化成熟时间" VALUE 0x0000 /* @ECU_Address@BDM_cCC2TempHiLv2InitTiDeb_U16@ */ Scalar_UWORD 0 BMS_CM_uint16 0 65535 /end CHARACTERISTIC
/begin CHARACTERISTIC BDM_cCC2TempHiLv2TiDeb_U16 "CC2温度过高等级2故障成熟时间" VALUE 0x0000 /* @ECU_Address@BDM_cCC2TempHiLv2TiDeb_U16@ */ Scalar_UWORD 0 BMS_CM_uint16 0 65535 /end CHARACTERISTIC
/begin CHARACTERISTIC BDM_cCC2TempHiLv2Value_F32 "CC2温度过高等级2故障阈值" VALUE 0x0000 /* @ECU_Address@BDM_cCC2TempHiLv2Value_F32@ */ Scalar_FLOAT32_IEEE 0 BMS_CM_single -3.4e+38 3.4e+38 /end CHARACTERISTIC
/begin CHARACTERISTIC BDM_cCC2TempHiLv3HealValue_F32 "CC2温度过高等级3恢复阈值" VALUE 0x0000 /* @ECU_Address@BDM_cCC2TempHiLv3HealValue_F32@ */ Scalar_FLOAT32_IEEE 0 BMS_CM_single -3.4e+38 3.4e+38 /end CHARACTERISTIC
/begin CHARACTERISTIC BDM_cCC2TempHiLv3Value_F32 "CC2温度过高等级3故障阈值" VALUE 0x0000 /* @ECU_Address@BDM_cCC2TempHiLv3Value_F32@ */ Scalar_FLOAT32_IEEE 0 BMS_CM_single -3.4e+38 3.4e+38 /end CHARACTERISTIC
/begin CHARACTERISTIC BDM_cCellTempDiffHiLv1En_U8 "单体温差过大等级1故障诊断使能" VALUE 0x0000 /* @ECU_Address@BDM_cCellTempDiffHiLv1En_U8@ */ Scalar_UBYTE 0 BMS_CM_uint8 0 255 /end CHARACTERISTIC
/begin CHARACTERISTIC BDM_cCellTempDiffHiLv1HealEn_U8 "单体温差过大等级1故障恢复使能" VALUE 0x0000 /* @ECU_Address@BDM_cCellTempDiffHiLv1HealEn_U8@ */ Scalar_UBYTE 0 BMS_CM_uint8 0 255 /end CHARACTERISTIC
/begin CHARACTERISTIC BDM_cCellTempDiffHiLv1HealTiDeb_U16 "单体温差过大等级1故障恢复时间" VALUE 0x0000 /* @ECU_Address@BDM_cCellTempDiffHiLv1HealTiDeb_U16@ */ Scalar_UWORD 0 BMS_CM_uint16 0 65535 /end CHARACTERISTIC
/begin CHARACTERISTIC BDM_cCellTempDiffHiLv1HealValue_F32 "单体温差过大等级1恢复阈值" VALUE 0x0000 /* @ECU_Address@BDM_cCellTempDiffHiLv1HealValue_F32@ */ Scalar_FLOAT32_IEEE 0 BMS_CM_single -3.4e+38 3.4e+38 /end CHARACTERISTIC
/begin CHARACTERISTIC BDM_cCellTempDiffHiLv1InitTiDeb_U16 "单体温差过大等级1故障初始化成熟时间" VALUE 0x0000 /* @ECU_Address@BDM_cCellTempDiffHiLv1InitTiDeb_U16@ */ Scalar_UWORD 0 BMS_CM_uint16 0 65535 /end CHARACTERISTIC
/begin CHARACTERISTIC BDM_cCellTempDiffHiLv1TiDeb_U16 "单体温差过大等级1故障成熟时间" VALUE 0x0000 /* @ECU_Address@BDM_cCellTempDiffHiLv1TiDeb_U16@ */ Scalar_UWORD 0 BMS_CM_uint16 0 65535 /end CHARACTERISTIC
/begin CHARACTERISTIC BDM_cCellTempDiffHiLv1Value_F32 "单体温差过大等级1故障阈值" VALUE 0x0000 /* @ECU_Address@BDM_cCellTempDiffHiLv1Value_F32@ */ Scalar_FLOAT32_IEEE 0 BMS_CM_single -3.4e+38 3.4e+38 /end CHARACTERISTIC
/begin CHARACTERISTIC BDM_cCellTempDiffHiLv2En_U8 "单体温差过大等级2故障诊断使能" VALUE 0x0000 /* @ECU_Address@BDM_cCellTempDiffHiLv2En_U8@ */ Scalar_UBYTE 0 BMS_CM_uint8 0 255 /end CHARACTERISTIC
/begin CHARACTERISTIC BDM_cCellTempDiffHiLv2HealEn_U8 "单体温差过大等级2故障恢复使能" VALUE 0x0000 /* @ECU_Address@BDM_cCellTempDiffHiLv2HealEn_U8@ */ Scalar_UBYTE 0 BMS_CM_uint8 0 255 /end CHARACTERISTIC
/begin CHARACTERISTIC BDM_cCellTempDiffHiLv2HealTiDeb_U16 "单体温差过大等级2故障恢复时间" VALUE 0x0000 /* @ECU_Address@BDM_cCellTempDiffHiLv2HealTiDeb_U16@ */ Scalar_UWORD 0 BMS_CM_uint16 0 65535 /end CHARACTERISTIC
/begin CHARACTERISTIC BDM_cCellTempDiffHiLv2HealValue_F32 "单体温差过大等级2恢复阈值" VALUE 0x0000 /* @ECU_Address@BDM_cCellTempDiffHiLv2HealValue_F32@ */ Scalar_FLOAT32_IEEE 0 BMS_CM_single -3.4e+38 3.4e+38 /end CHARACTERISTIC
/begin CHARACTERISTIC BDM_cCellTempDiffHiLv2InitTiDeb_U16 "单体温差过大等级2故障初始化成熟时间" VALUE 0x0000 /* @ECU_Address@BDM_cCellTempDiffHiLv2InitTiDeb_U16@ */ Scalar_UWORD 0 BMS_CM_uint16 0 65535 /end CHARACTERISTIC
/begin CHARACTERISTIC BDM_cCellTempDiffHiLv2TiDeb_U16 "单体温差过大等级2故障成熟时间" VALUE 0x0000 /* @ECU_Address@BDM_cCellTempDiffHiLv2TiDeb_U16@ */ Scalar_UWORD 0 BMS_CM_uint16 0 65535 /end CHARACTERISTIC
/begin CHARACTERISTIC BDM_cCellTempDiffHiLv2Value_F32 "单体温差过大等级2故障阈值" VALUE 0x0000 /* @ECU_Address@BDM_cCellTempDiffHiLv2Value_F32@ */ Scalar_FLOAT32_IEEE 0 BMS_CM_single -3.4e+38 3.4e+38 /end CHARACTERISTIC
/begin CHARACTERISTIC BDM_cCellTempDiffHiLv3En_U8 "单体温差过大等级3故障诊断使能" VALUE 0x0000 /* @ECU_Address@BDM_cCellTempDiffHiLv3En_U8@ */ Scalar_UBYTE 0 BMS_CM_uint8 0 255 /end CHARACTERISTIC
/begin CHARACTERISTIC BDM_cCellTempDiffHiLv3HealEn_U8 "单体温差过大等级3故障恢复使能" VALUE 0x0000 /* @ECU_Address@BDM_cCellTempDiffHiLv3HealEn_U8@ */ Scalar_UBYTE 0 BMS_CM_uint8 0 255 /end CHARACTERISTIC
/begin CHARACTERISTIC BDM_cCellTempDiffHiLv3HealTiDeb_U16 "单体温差过大等级3故障恢复时间" VALUE 0x0000 /* @ECU_Address@BDM_cCellTempDiffHiLv3HealTiDeb_U16@ */ Scalar_UWORD 0 BMS_CM_uint16 0 65535 /end CHARACTERISTIC
/begin CHARACTERISTIC BDM_cCellTempDiffHiLv3HealValue_F32 "单体温差过大等级3恢复阈值" VALUE 0x0000 /* @ECU_Address@BDM_cCellTempDiffHiLv3HealValue_F32@ */ Scalar_FLOAT32_IEEE 0 BMS_CM_single -3.4e+38 3.4e+38 /end CHARACTERISTIC
/begin CHARACTERISTIC BDM_cCellTempDiffHiLv3InitTiDeb_U16 "单体温差过大等级3故障初始化成熟时间" VALUE 0x0000 /* @ECU_Address@BDM_cCellTempDiffHiLv3InitTiDeb_U16@ */ Scalar_UWORD 0 BMS_CM_uint16 0 65535 /end CHARACTERISTIC
/begin CHARACTERISTIC BDM_cCellTempDiffHiLv3TiDeb_U16 "单体温差过大等级3故障成熟时间" VALUE 0x0000 /* @ECU_Address@BDM_cCellTempDiffHiLv3TiDeb_U16@ */ Scalar_UWORD 0 BMS_CM_uint16 0 65535 /end CHARACTERISTIC
/begin CHARACTERISTIC BDM_cCellTempDiffHiLv3Value_F32 "单体温差过大等级3故障阈值" VALUE 0x0000 /* @ECU_Address@BDM_cCellTempDiffHiLv3Value_F32@ */ Scalar_FLOAT32_IEEE 0 BMS_CM_single -3.4e+38 3.4e+38 /end CHARACTERISTIC
/begin CHARACTERISTIC BDM_cCellTempDiffHiLv4En_U8 "单体温差过大等级4故障诊断使能" VALUE 0x0000 /* @ECU_Address@BDM_cCellTempDiffHiLv4En_U8@ */ Scalar_UBYTE 0 BMS_CM_uint8 0 255 /end CHARACTERISTIC
/begin CHARACTERISTIC BDM_cCellTempDiffHiLv4HealEn_U8 "单体温差过大等级4故障恢复使能" VALUE 0x0000 /* @ECU_Address@BDM_cCellTempDiffHiLv4HealEn_U8@ */ Scalar_UBYTE 0 BMS_CM_uint8 0 255 /end CHARACTERISTIC
/begin CHARACTERISTIC BDM_cCellTempDiffHiLv4HealValue_F32 "单体温差过大等级4恢复阈值" VALUE 0x0000 /* @ECU_Address@BDM_cCellTempDiffHiLv4HealValue_F32@ */ Scalar_FLOAT32_IEEE 0 BMS_CM_single -3.4e+38 3.4e+38 /end CHARACTERISTIC
/begin CHARACTERISTIC BDM_cCellTempDiffHiLv4InitTiDeb_U16 "单体温差过大等级4故障初始化成熟时间" VALUE 0x0000 /* @ECU_Address@BDM_cCellTempDiffHiLv4InitTiDeb_U16@ */ Scalar_UWORD 0 BMS_CM_uint16 0 65535 /end CHARACTERISTIC
/begin CHARACTERISTIC BDM_cCellTempDiffHiLv4Value_F32 "单体温差过大等级4故障阈值" VALUE 0x0000 /* @ECU_Address@BDM_cCellTempDiffHiLv4Value_F32@ */ Scalar_FLOAT32_IEEE 0 BMS_CM_single -3.4e+38 3.4e+38 /end CHARACTERISTIC
/begin CHARACTERISTIC BDM_cCellTempHiLv1En_U8 "单体温度过高等级1故障诊断使能" VALUE 0x0000 /* @ECU_Address@BDM_cCellTempHiLv1En_U8@ */ Scalar_UBYTE 0 BMS_CM_uint8 0 255 /end CHARACTERISTIC
/begin CHARACTERISTIC BDM_cCellTempHiLv1HealEn_U8 "单体温度过高等级1故障恢复使能" VALUE 0x0000 /* @ECU_Address@BDM_cCellTempHiLv1HealEn_U8@ */ Scalar_UBYTE 0 BMS_CM_uint8 0 255 /end CHARACTERISTIC
/begin CHARACTERISTIC BDM_cCellTempHiLv1HealValue_F32 "单体温度过高等级1恢复阈值" VALUE 0x0000 /* @ECU_Address@BDM_cCellTempHiLv1HealValue_F32@ */ Scalar_FLOAT32_IEEE 0 BMS_CM_single -3.4e+38 3.4e+38 /end CHARACTERISTIC
/begin CHARACTERISTIC BDM_cCellTempHiLv1InitTiDeb_U16 "单体温度过高等级1故障初始化成熟时间" VALUE 0x0000 /* @ECU_Address@BDM_cCellTempHiLv1InitTiDeb_U16@ */ Scalar_UWORD 0 BMS_CM_uint16 0 65535 /end CHARACTERISTIC
/begin CHARACTERISTIC BDM_cCellTempHiLv1Value_F32 "单体温度过高等级1故障阈值" VALUE 0x0000 /* @ECU_Address@BDM_cCellTempHiLv1Value_F32@ */ Scalar_FLOAT32_IEEE 0 BMS_CM_single -3.4e+38 3.4e+38 /end CHARACTERISTIC
/begin CHARACTERISTIC BDM_cCellTempHiLv2En_U8 "单体温度过高等级2故障诊断使能" VALUE 0x0000 /* @ECU_Address@BDM_cCellTempHiLv2En_U8@ */ Scalar_UBYTE 0 BMS_CM_uint8 0 255 /end CHARACTERISTIC
/begin CHARACTERISTIC BDM_cCellTempHiLv2HealEn_U8 "单体温度过高等级2故障恢复使能" VALUE 0x0000 /* @ECU_Address@BDM_cCellTempHiLv2HealEn_U8@ */ Scalar_UBYTE 0 BMS_CM_uint8 0 255 /end CHARACTERISTIC
/begin CHARACTERISTIC BDM_cCellTempHiLv2HealValue_F32 "单体温度过高等级2恢复阈值" VALUE 0x0000 /* @ECU_Address@BDM_cCellTempHiLv2HealValue_F32@ */ Scalar_FLOAT32_IEEE 0 BMS_CM_single -3.4e+38 3.4e+38 /end CHARACTERISTIC
/begin CHARACTERISTIC BDM_cCellTempHiLv2InitTiDeb_U16 "单体温度过高等级2故障初始化成熟时间" VALUE 0x0000 /* @ECU_Address@BDM_cCellTempHiLv2InitTiDeb_U16@ */ Scalar_UWORD 0 BMS_CM_uint16 0 65535 /end CHARACTERISTIC
/begin CHARACTERISTIC BDM_cCellTempHiLv2Value_F32 "单体温度过高等级2故障阈值" VALUE 0x0000 /* @ECU_Address@BDM_cCellTempHiLv2Value_F32@ */ Scalar_FLOAT32_IEEE 0 BMS_CM_single -3.4e+38 3.4e+38 /end CHARACTERISTIC
/begin CHARACTERISTIC BDM_cCellTempHiLv3En_U8 "单体温度过高等级3故障诊断使能" VALUE 0x0000 /* @ECU_Address@BDM_cCellTempHiLv3En_U8@ */ Scalar_UBYTE 0 BMS_CM_uint8 0 255 /end CHARACTERISTIC
/begin CHARACTERISTIC BDM_cCellTempHiLv3HealEn_U8 "单体温度过高等级3故障恢复使能" VALUE 0x0000 /* @ECU_Address@BDM_cCellTempHiLv3HealEn_U8@ */ Scalar_UBYTE 0 BMS_CM_uint8 0 255 /end CHARACTERISTIC
/begin CHARACTERISTIC BDM_cCellTempHiLv3HealValue_F32 "单体温度过高等级3恢复阈值" VALUE 0x0000 /* @ECU_Address@BDM_cCellTempHiLv3HealValue_F32@ */ Scalar_FLOAT32_IEEE 0 BMS_CM_single -3.4e+38 3.4e+38 /end CHARACTERISTIC
/begin CHARACTERISTIC BDM_cCellTempHiLv3InitTiDeb_U16 "单体温度过高等级3故障初始化成熟时间" VALUE 0x0000 /* @ECU_Address@BDM_cCellTempHiLv3InitTiDeb_U16@ */ Scalar_UWORD 0 BMS_CM_uint16 0 65535 /end CHARACTERISTIC
/begin CHARACTERISTIC BDM_cCellTempHiLv3Value_F32 "单体温度过高等级3故障阈值" VALUE 0x0000 /* @ECU_Address@BDM_cCellTempHiLv3Value_F32@ */ Scalar_FLOAT32_IEEE 0 BMS_CM_single -3.4e+38 3.4e+38 /end CHARACTERISTIC
/begin CHARACTERISTIC BDM_cCellTempHiLv4En_U8 "单体温度过高等级4故障诊断使能" VALUE 0x0000 /* @ECU_Address@BDM_cCellTempHiLv4En_U8@ */ Scalar_UBYTE 0 BMS_CM_uint8 0 255 /end CHARACTERISTIC
/begin CHARACTERISTIC BDM_cCellTempHiLv4HealEn_U8 "单体温度过高等级4故障恢复使能" VALUE 0x0000 /* @ECU_Address@BDM_cCellTempHiLv4HealEn_U8@ */ Scalar_UBYTE 0 BMS_CM_uint8 0 255 /end CHARACTERISTIC
/begin CHARACTERISTIC BDM_cCellTempHiLv4HealValue_F32 "单体温度过高等级4恢复阈值" VALUE 0x0000 /* @ECU_Address@BDM_cCellTempHiLv4HealValue_F32@ */ Scalar_FLOAT32_IEEE 0 BMS_CM_single -3.4e+38 3.4e+38 /end CHARACTERISTIC
/begin CHARACTERISTIC BDM_cCellTempHiLv4InitTiDeb_U16 "单体温度过高等级4故障初始化成熟时间" VALUE 0x0000 /* @ECU_Address@BDM_cCellTempHiLv4InitTiDeb_U16@ */ Scalar_UWORD 0 BMS_CM_uint16 0 65535 /end CHARACTERISTIC
/begin CHARACTERISTIC BDM_cCellTempHiLv4Value_F32 "单体温度过高等级4故障阈值" VALUE 0x0000 /* @ECU_Address@BDM_cCellTempHiLv4Value_F32@ */ Scalar_FLOAT32_IEEE 0 BMS_CM_single -3.4e+38 3.4e+38 /end CHARACTERISTIC
/begin CHARACTERISTIC BDM_cCellTempLoLv1En_U8 "单体温度过低等级1故障诊断使能" VALUE 0x0000 /* @ECU_Address@BDM_cCellTempLoLv1En_U8@ */ Scalar_UBYTE 0 BMS_CM_uint8 0 255 /end CHARACTERISTIC
/begin CHARACTERISTIC BDM_cCellTempLoLv1HealEn_U8 "单体温度过低等级1故障恢复使能" VALUE 0x0000 /* @ECU_Address@BDM_cCellTempLoLv1HealEn_U8@ */ Scalar_UBYTE 0 BMS_CM_uint8 0 255 /end CHARACTERISTIC
/begin CHARACTERISTIC BDM_cCellTempLoLv1HealValueDC_F32 "单体温度过低等级1充电恢复阈值" VALUE 0x0000 /* @ECU_Address@BDM_cCellTempLoLv1HealValueDC_F32@ */ Scalar_FLOAT32_IEEE 0 BMS_CM_single -3.4e+38 3.4e+38 /end CHARACTERISTIC
/begin CHARACTERISTIC BDM_cCellTempLoLv1HealValue_F32 "单体温度过低等级1放电恢复阈值" VALUE 0x0000 /* @ECU_Address@BDM_cCellTempLoLv1HealValue_F32@ */ Scalar_FLOAT32_IEEE 0 BMS_CM_single -3.4e+38 3.4e+38 /end CHARACTERISTIC
/begin CHARACTERISTIC BDM_cCellTempLoLv1InitTiDeb_U16 "单体温度过低等级1故障初始化成熟时间" VALUE 0x0000 /* @ECU_Address@BDM_cCellTempLoLv1InitTiDeb_U16@ */ Scalar_UWORD 0 BMS_CM_uint16 0 65535 /end CHARACTERISTIC
/begin CHARACTERISTIC BDM_cCellTempLoLv1ValueDC_F32 "单体温度过低等级1充电故障阈值" VALUE 0x0000 /* @ECU_Address@BDM_cCellTempLoLv1ValueDC_F32@ */ Scalar_FLOAT32_IEEE 0 BMS_CM_single -3.4e+38 3.4e+38 /end CHARACTERISTIC
/begin CHARACTERISTIC BDM_cCellTempLoLv1Value_F32 "单体温度过低等级1放电故障阈值" VALUE 0x0000 /* @ECU_Address@BDM_cCellTempLoLv1Value_F32@ */ Scalar_FLOAT32_IEEE 0 BMS_CM_single -3.4e+38 3.4e+38 /end CHARACTERISTIC
/begin CHARACTERISTIC BDM_cCellTempLoLv2En_U8 "单体温度过低等级2故障诊断使能" VALUE 0x0000 /* @ECU_Address@BDM_cCellTempLoLv2En_U8@ */ Scalar_UBYTE 0 BMS_CM_uint8 0 255 /end CHARACTERISTIC
/begin CHARACTERISTIC BDM_cCellTempLoLv2HealEn_U8 "单体温度过低等级2故障恢复使能" VALUE 0x0000 /* @ECU_Address@BDM_cCellTempLoLv2HealEn_U8@ */ Scalar_UBYTE 0 BMS_CM_uint8 0 255 /end CHARACTERISTIC
/begin CHARACTERISTIC BDM_cCellTempLoLv2HealValueDC_F32 "单体温度过低等级2充电恢复阈值" VALUE 0x0000 /* @ECU_Address@BDM_cCellTempLoLv2HealValueDC_F32@ */ Scalar_FLOAT32_IEEE 0 BMS_CM_single -3.4e+38 3.4e+38 /end CHARACTERISTIC
/begin CHARACTERISTIC BDM_cCellTempLoLv2HealValue_F32 "单体温度过低等级2放电恢复阈值" VALUE 0x0000 /* @ECU_Address@BDM_cCellTempLoLv2HealValue_F32@ */ Scalar_FLOAT32_IEEE 0 BMS_CM_single -3.4e+38 3.4e+38 /end CHARACTERISTIC
/begin CHARACTERISTIC BDM_cCellTempLoLv2InitTiDeb_U16 "单体温度过低等级2故障初始化成熟时间" VALUE 0x0000 /* @ECU_Address@BDM_cCellTempLoLv2InitTiDeb_U16@ */ Scalar_UWORD 0 BMS_CM_uint16 0 65535 /end CHARACTERISTIC
/begin CHARACTERISTIC BDM_cCellTempLoLv2ValueDC_F32 "单体温度过低等级2充电故障阈值" VALUE 0x0000 /* @ECU_Address@BDM_cCellTempLoLv2ValueDC_F32@ */ Scalar_FLOAT32_IEEE 0 BMS_CM_single -3.4e+38 3.4e+38 /end CHARACTERISTIC
/begin CHARACTERISTIC BDM_cCellTempLoLv2Value_F32 "单体温度过低等级2放电故障阈值" VALUE 0x0000 /* @ECU_Address@BDM_cCellTempLoLv2Value_F32@ */ Scalar_FLOAT32_IEEE 0 BMS_CM_single -3.4e+38 3.4e+38 /end CHARACTERISTIC
/begin CHARACTERISTIC BDM_cCellTempLoLv3En_U8 "单体温度过低等级3故障诊断使能" VALUE 0x0000 /* @ECU_Address@BDM_cCellTempLoLv3En_U8@ */ Scalar_UBYTE 0 BMS_CM_uint8 0 255 /end CHARACTERISTIC
/begin CHARACTERISTIC BDM_cCellTempLoLv3HealEn_U8 "单体温度过低等级3故障恢复使能" VALUE 0x0000 /* @ECU_Address@BDM_cCellTempLoLv3HealEn_U8@ */ Scalar_UBYTE 0 BMS_CM_uint8 0 255 /end CHARACTERISTIC
/begin CHARACTERISTIC BDM_cCellTempLoLv3HealValueDC_F32 "单体温度过低等级3充电恢复阈值" VALUE 0x0000 /* @ECU_Address@BDM_cCellTempLoLv3HealValueDC_F32@ */ Scalar_FLOAT32_IEEE 0 BMS_CM_single -3.4e+38 3.4e+38 /end CHARACTERISTIC
/begin CHARACTERISTIC BDM_cCellTempLoLv3HealValue_F32 "单体温度过低等级3放电恢复阈值" VALUE 0x0000 /* @ECU_Address@BDM_cCellTempLoLv3HealValue_F32@ */ Scalar_FLOAT32_IEEE 0 BMS_CM_single -3.4e+38 3.4e+38 /end CHARACTERISTIC
/begin CHARACTERISTIC BDM_cCellTempLoLv3InitTiDeb_U16 "单体温度过低等级3故障初始化成熟时间" VALUE 0x0000 /* @ECU_Address@BDM_cCellTempLoLv3InitTiDeb_U16@ */ Scalar_UWORD 0 BMS_CM_uint16 0 65535 /end CHARACTERISTIC
/begin CHARACTERISTIC BDM_cCellTempLoLv3ValueDC_F32 "单体温度过低等级3充电故障阈值" VALUE 0x0000 /* @ECU_Address@BDM_cCellTempLoLv3ValueDC_F32@ */ Scalar_FLOAT32_IEEE 0 BMS_CM_single -3.4e+38 3.4e+38 /end CHARACTERISTIC
/begin CHARACTERISTIC BDM_cCellTempLoLv3Value_F32 "单体温度过低等级3放电故障阈值" VALUE 0x0000 /* @ECU_Address@BDM_cCellTempLoLv3Value_F32@ */ Scalar_FLOAT32_IEEE 0 BMS_CM_single -3.4e+38 3.4e+38 /end CHARACTERISTIC
/begin CHARACTERISTIC BDM_cCellTempLoLv4En_U8 "单体温度过低等级4故障诊断使能" VALUE 0x0000 /* @ECU_Address@BDM_cCellTempLoLv4En_U8@ */ Scalar_UBYTE 0 BMS_CM_uint8 0 255 /end CHARACTERISTIC
/begin CHARACTERISTIC BDM_cCellTempLoLv4HealEn_U8 "单体温度过低等级4故障恢复使能" VALUE 0x0000 /* @ECU_Address@BDM_cCellTempLoLv4HealEn_U8@ */ Scalar_UBYTE 0 BMS_CM_uint8 0 255 /end CHARACTERISTIC
/begin CHARACTERISTIC BDM_cCellTempLoLv4HealValueDC_F32 "单体温度过低等级4充电恢复阈值" VALUE 0x0000 /* @ECU_Address@BDM_cCellTempLoLv4HealValueDC_F32@ */ Scalar_FLOAT32_IEEE 0 BMS_CM_single -3.4e+38 3.4e+38 /end CHARACTERISTIC
/begin CHARACTERISTIC BDM_cCellTempLoLv4HealValue_F32 "单体温度过低等级4放电恢复阈值" VALUE 0x0000 /* @ECU_Address@BDM_cCellTempLoLv4HealValue_F32@ */ Scalar_FLOAT32_IEEE 0 BMS_CM_single -3.4e+38 3.4e+38 /end CHARACTERISTIC
/begin CHARACTERISTIC BDM_cCellTempLoLv4InitTiDeb_U16 "单体温度过低等级4故障初始化成熟时间" VALUE 0x0000 /* @ECU_Address@BDM_cCellTempLoLv4InitTiDeb_U16@ */ Scalar_UWORD 0 BMS_CM_uint16 0 65535 /end CHARACTERISTIC
/begin CHARACTERISTIC BDM_cCellTempLoLv4ValueDC_F32 "单体温度过低等级4充电故障阈值" VALUE 0x0000 /* @ECU_Address@BDM_cCellTempLoLv4ValueDC_F32@ */ Scalar_FLOAT32_IEEE 0 BMS_CM_single -3.4e+38 3.4e+38 /end CHARACTERISTIC
/begin CHARACTERISTIC BDM_cCellTempLoLv4Value_F32 "单体温度过低等级4放电故障阈值" VALUE 0x0000 /* @ECU_Address@BDM_cCellTempLoLv4Value_F32@ */ Scalar_FLOAT32_IEEE 0 BMS_CM_single -3.4e+38 3.4e+38 /end CHARACTERISTIC
/begin CHARACTERISTIC BDM_cCellVoltDiffHiLv1En_U8 "单体压差过大等级1故障诊断使能" VALUE 0x0000 /* @ECU_Address@BDM_cCellVoltDiffHiLv1En_U8@ */ Scalar_UBYTE 0 BMS_CM_uint8 0 255 /end CHARACTERISTIC
/begin CHARACTERISTIC BDM_cCellVoltDiffHiLv1HealEn_U8 "单体压差过大等级1故障恢复使能" VALUE 0x0000 /* @ECU_Address@BDM_cCellVoltDiffHiLv1HealEn_U8@ */ Scalar_UBYTE 0 BMS_CM_uint8 0 255 /end CHARACTERISTIC
/begin CHARACTERISTIC BDM_cCellVoltDiffHiLv1HealTiDeb_U16 "单体压差过大等级1故障恢复时间" VALUE 0x0000 /* @ECU_Address@BDM_cCellVoltDiffHiLv1HealTiDeb_U16@ */ Scalar_UWORD 0 BMS_CM_uint16 0 65535 /end CHARACTERISTIC
/begin CHARACTERISTIC BDM_cCellVoltDiffHiLv1HealValueSOC1_U16 "单体温差过大等级1SOC1恢复阈值" VALUE 0x0000 /* @ECU_Address@BDM_cCellVoltDiffHiLv1HealValueSOC1_U16@ */ Scalar_UWORD 0 BMS_CM_uint16 0 65535 /end CHARACTERISTIC
/begin CHARACTERISTIC BDM_cCellVoltDiffHiLv1HealValueSOC2_U16 "单体温差过大等级1SOC2恢复阈值" VALUE 0x0000 /* @ECU_Address@BDM_cCellVoltDiffHiLv1HealValueSOC2_U16@ */ Scalar_UWORD 0 BMS_CM_uint16 0 65535 /end CHARACTERISTIC
/begin CHARACTERISTIC BDM_cCellVoltDiffHiLv1HealValueSOC3_U16 "单体温差过大等级1SOC3恢复阈值" VALUE 0x0000 /* @ECU_Address@BDM_cCellVoltDiffHiLv1HealValueSOC3_U16@ */ Scalar_UWORD 0 BMS_CM_uint16 0 65535 /end CHARACTERISTIC
/begin CHARACTERISTIC BDM_cCellVoltDiffHiLv1HealValue_U16 "单体压差过大等级1恢复阈值" VALUE 0x0000 /* @ECU_Address@BDM_cCellVoltDiffHiLv1HealValue_U16@ */ Scalar_UWORD 0 BMS_CM_uint16 0 65535 /end CHARACTERISTIC
/begin CHARACTERISTIC BDM_cCellVoltDiffHiLv1InitTiDeb_U16 "单体压差过大等级1故障初始化成熟时间" VALUE 0x0000 /* @ECU_Address@BDM_cCellVoltDiffHiLv1InitTiDeb_U16@ */ Scalar_UWORD 0 BMS_CM_uint16 0 65535 /end CHARACTERISTIC
/begin CHARACTERISTIC BDM_cCellVoltDiffHiLv1TiDeb_U16 "单体压差过大等级1故障成熟时间" VALUE 0x0000 /* @ECU_Address@BDM_cCellVoltDiffHiLv1TiDeb_U16@ */ Scalar_UWORD 0 BMS_CM_uint16 0 65535 /end CHARACTERISTIC
/begin CHARACTERISTIC BDM_cCellVoltDiffHiLv1ValueSOC1_U16 "单体温差过大等级1SOC1故障阈值" VALUE 0x0000 /* @ECU_Address@BDM_cCellVoltDiffHiLv1ValueSOC1_U16@ */ Scalar_UWORD 0 BMS_CM_uint16 0 65535 /end CHARACTERISTIC
/begin CHARACTERISTIC BDM_cCellVoltDiffHiLv1ValueSOC2_U16 "单体温差过大等级1SOC2故障阈值" VALUE 0x0000 /* @ECU_Address@BDM_cCellVoltDiffHiLv1ValueSOC2_U16@ */ Scalar_UWORD 0 BMS_CM_uint16 0 65535 /end CHARACTERISTIC
/begin CHARACTERISTIC BDM_cCellVoltDiffHiLv1ValueSOC3_U16 "单体温差过大等级1SOC3故障阈值" VALUE 0x0000 /* @ECU_Address@BDM_cCellVoltDiffHiLv1ValueSOC3_U16@ */ Scalar_UWORD 0 BMS_CM_uint16 0 65535 /end CHARACTERISTIC
/begin CHARACTERISTIC BDM_cCellVoltDiffHiLv1Value_U16 "单体压差过大等级1故障阈值" VALUE 0x0000 /* @ECU_Address@BDM_cCellVoltDiffHiLv1Value_U16@ */ Scalar_UWORD 0 BMS_CM_uint16 0 65535 /end CHARACTERISTIC
/begin CHARACTERISTIC BDM_cCellVoltDiffHiLv2En_U8 "单体压差过大等级2故障诊断使能" VALUE 0x0000 /* @ECU_Address@BDM_cCellVoltDiffHiLv2En_U8@ */ Scalar_UBYTE 0 BMS_CM_uint8 0 255 /end CHARACTERISTIC
/begin CHARACTERISTIC BDM_cCellVoltDiffHiLv2HealEn_U8 "单体压差过大等级2故障恢复使能" VALUE 0x0000 /* @ECU_Address@BDM_cCellVoltDiffHiLv2HealEn_U8@ */ Scalar_UBYTE 0 BMS_CM_uint8 0 255 /end CHARACTERISTIC
/begin CHARACTERISTIC BDM_cCellVoltDiffHiLv2HealTiDeb_U16 "单体压差过大等级2故障恢复时间" VALUE 0x0000 /* @ECU_Address@BDM_cCellVoltDiffHiLv2HealTiDeb_U16@ */ Scalar_UWORD 0 BMS_CM_uint16 0 65535 /end CHARACTERISTIC
/begin CHARACTERISTIC BDM_cCellVoltDiffHiLv2HealValueSOC1_U16 "单体温差过大等级2SOC1恢复阈值" VALUE 0x0000 /* @ECU_Address@BDM_cCellVoltDiffHiLv2HealValueSOC1_U16@ */ Scalar_UWORD 0 BMS_CM_uint16 0 65535 /end CHARACTERISTIC
/begin CHARACTERISTIC BDM_cCellVoltDiffHiLv2HealValueSOC2_U16 "单体温差过大等级2SOC2恢复阈值" VALUE 0x0000 /* @ECU_Address@BDM_cCellVoltDiffHiLv2HealValueSOC2_U16@ */ Scalar_UWORD 0 BMS_CM_uint16 0 65535 /end CHARACTERISTIC
/begin CHARACTERISTIC BDM_cCellVoltDiffHiLv2HealValueSOC3_U16 "单体温差过大等级2SOC3恢复阈值" VALUE 0x0000 /* @ECU_Address@BDM_cCellVoltDiffHiLv2HealValueSOC3_U16@ */ Scalar_UWORD 0 BMS_CM_uint16 0 65535 /end CHARACTERISTIC
/begin CHARACTERISTIC BDM_cCellVoltDiffHiLv2HealValue_U16 "单体压差过大等级2恢复阈值" VALUE 0x0000 /* @ECU_Address@BDM_cCellVoltDiffHiLv2HealValue_U16@ */ Scalar_UWORD 0 BMS_CM_uint16 0 65535 /end CHARACTERISTIC
/begin CHARACTERISTIC BDM_cCellVoltDiffHiLv2InitTiDeb_U16 "单体压差过大等级2故障初始化成熟时间" VALUE 0x0000 /* @ECU_Address@BDM_cCellVoltDiffHiLv2InitTiDeb_U16@ */ Scalar_UWORD 0 BMS_CM_uint16 0 65535 /end CHARACTERISTIC
/begin CHARACTERISTIC BDM_cCellVoltDiffHiLv2TiDeb_U16 "单体压差过大等级2故障成熟时间" VALUE 0x0000 /* @ECU_Address@BDM_cCellVoltDiffHiLv2TiDeb_U16@ */ Scalar_UWORD 0 BMS_CM_uint16 0 65535 /end CHARACTERISTIC
/begin CHARACTERISTIC BDM_cCellVoltDiffHiLv2ValueSOC1_U16 "单体温差过大等级2SOC1故障阈值" VALUE 0x0000 /* @ECU_Address@BDM_cCellVoltDiffHiLv2ValueSOC1_U16@ */ Scalar_UWORD 0 BMS_CM_uint16 0 65535 /end CHARACTERISTIC
/begin CHARACTERISTIC BDM_cCellVoltDiffHiLv2ValueSOC2_U16 "单体温差过大等级2SOC2故障阈值" VALUE 0x0000 /* @ECU_Address@BDM_cCellVoltDiffHiLv2ValueSOC2_U16@ */ Scalar_UWORD 0 BMS_CM_uint16 0 65535 /end CHARACTERISTIC
/begin CHARACTERISTIC BDM_cCellVoltDiffHiLv2ValueSOC3_U16 "单体温差过大等级2SOC3故障阈值" VALUE 0x0000 /* @ECU_Address@BDM_cCellVoltDiffHiLv2ValueSOC3_U16@ */ Scalar_UWORD 0 BMS_CM_uint16 0 65535 /end CHARACTERISTIC
/begin CHARACTERISTIC BDM_cCellVoltDiffHiLv2Value_U16 "单体压差过大等级2故障阈值" VALUE 0x0000 /* @ECU_Address@BDM_cCellVoltDiffHiLv2Value_U16@ */ Scalar_UWORD 0 BMS_CM_uint16 0 65535 /end CHARACTERISTIC
/begin CHARACTERISTIC BDM_cCellVoltDiffHiLv3En_U8 "单体压差过大等级3故障诊断使能" VALUE 0x0000 /* @ECU_Address@BDM_cCellVoltDiffHiLv3En_U8@ */ Scalar_UBYTE 0 BMS_CM_uint8 0 255 /end CHARACTERISTIC
/begin CHARACTERISTIC BDM_cCellVoltDiffHiLv3HealEn_U8 "单体压差过大等级3故障恢复使能" VALUE 0x0000 /* @ECU_Address@BDM_cCellVoltDiffHiLv3HealEn_U8@ */ Scalar_UBYTE 0 BMS_CM_uint8 0 255 /end CHARACTERISTIC
/begin CHARACTERISTIC BDM_cCellVoltDiffHiLv3HealTiDeb_U16 "单体压差过大等级3故障恢复时间" VALUE 0x0000 /* @ECU_Address@BDM_cCellVoltDiffHiLv3HealTiDeb_U16@ */ Scalar_UWORD 0 BMS_CM_uint16 0 65535 /end CHARACTERISTIC
/begin CHARACTERISTIC BDM_cCellVoltDiffHiLv3HealValueSOC1_U16 "单体温差过大等级3SOC1恢复阈值" VALUE 0x0000 /* @ECU_Address@BDM_cCellVoltDiffHiLv3HealValueSOC1_U16@ */ Scalar_UWORD 0 BMS_CM_uint16 0 65535 /end CHARACTERISTIC
/begin CHARACTERISTIC BDM_cCellVoltDiffHiLv3HealValueSOC2_U16 "单体温差过大等级3SOC2恢复阈值" VALUE 0x0000 /* @ECU_Address@BDM_cCellVoltDiffHiLv3HealValueSOC2_U16@ */ Scalar_UWORD 0 BMS_CM_uint16 0 65535 /end CHARACTERISTIC
/begin CHARACTERISTIC BDM_cCellVoltDiffHiLv3HealValueSOC3_U16 "单体温差过大等级3SOC3恢复阈值" VALUE 0x0000 /* @ECU_Address@BDM_cCellVoltDiffHiLv3HealValueSOC3_U16@ */ Scalar_UWORD 0 BMS_CM_uint16 0 65535 /end CHARACTERISTIC
/begin CHARACTERISTIC BDM_cCellVoltDiffHiLv3InitTiDeb_U16 "单体压差过大等级3故障初始化成熟时间" VALUE 0x0000 /* @ECU_Address@BDM_cCellVoltDiffHiLv3InitTiDeb_U16@ */ Scalar_UWORD 0 BMS_CM_uint16 0 65535 /end CHARACTERISTIC
/begin CHARACTERISTIC BDM_cCellVoltDiffHiLv3TiDeb_U16 "单体压差过大等级3故障成熟时间" VALUE 0x0000 /* @ECU_Address@BDM_cCellVoltDiffHiLv3TiDeb_U16@ */ Scalar_UWORD 0 BMS_CM_uint16 0 65535 /end CHARACTERISTIC
/begin CHARACTERISTIC BDM_cCellVoltDiffHiLv3ValueSOC1_U16 "单体温差过大等级3SOC1故障阈值" VALUE 0x0000 /* @ECU_Address@BDM_cCellVoltDiffHiLv3ValueSOC1_U16@ */ Scalar_UWORD 0 BMS_CM_uint16 0 65535 /end CHARACTERISTIC
/begin CHARACTERISTIC BDM_cCellVoltDiffHiLv3ValueSOC2_U16 "单体温差过大等级3SOC2故障阈值" VALUE 0x0000 /* @ECU_Address@BDM_cCellVoltDiffHiLv3ValueSOC2_U16@ */ Scalar_UWORD 0 BMS_CM_uint16 0 65535 /end CHARACTERISTIC
/begin CHARACTERISTIC BDM_cCellVoltDiffHiLv3ValueSOC3_U16 "单体温差过大等级3SOC3故障阈值" VALUE 0x0000 /* @ECU_Address@BDM_cCellVoltDiffHiLv3ValueSOC3_U16@ */ Scalar_UWORD 0 BMS_CM_uint16 0 65535 /end CHARACTERISTIC
/begin CHARACTERISTIC BDM_cCellVoltDiffHiLv4En_U8 "单体压差过大等级4故障诊断使能" VALUE 0x0000 /* @ECU_Address@BDM_cCellVoltDiffHiLv4En_U8@ */ Scalar_UBYTE 0 BMS_CM_uint8 0 255 /end CHARACTERISTIC
/begin CHARACTERISTIC BDM_cCellVoltDiffHiLv4HealEn_U8 "单体压差过大等级4故障恢复使能" VALUE 0x0000 /* @ECU_Address@BDM_cCellVoltDiffHiLv4HealEn_U8@ */ Scalar_UBYTE 0 BMS_CM_uint8 0 255 /end CHARACTERISTIC
/begin CHARACTERISTIC BDM_cCellVoltDiffHiLv4HealTiDeb_U16 "单体压差过大等级4故障恢复时间" VALUE 0x0000 /* @ECU_Address@BDM_cCellVoltDiffHiLv4HealTiDeb_U16@ */ Scalar_UWORD 0 BMS_CM_uint16 0 65535 /end CHARACTERISTIC
/begin CHARACTERISTIC BDM_cCellVoltDiffHiLv4HealValueSOC1_U16 "单体温差过大等级4SOC1恢复阈值" VALUE 0x0000 /* @ECU_Address@BDM_cCellVoltDiffHiLv4HealValueSOC1_U16@ */ Scalar_UWORD 0 BMS_CM_uint16 0 65535 /end CHARACTERISTIC
/begin CHARACTERISTIC BDM_cCellVoltDiffHiLv4HealValueSOC2_U16 "单体温差过大等级4SOC2恢复阈值" VALUE 0x0000 /* @ECU_Address@BDM_cCellVoltDiffHiLv4HealValueSOC2_U16@ */ Scalar_UWORD 0 BMS_CM_uint16 0 65535 /end CHARACTERISTIC
/begin CHARACTERISTIC BDM_cCellVoltDiffHiLv4HealValueSOC3_U16 "单体温差过大等级4SOC3恢复阈值" VALUE 0x0000 /* @ECU_Address@BDM_cCellVoltDiffHiLv4HealValueSOC3_U16@ */ Scalar_UWORD 0 BMS_CM_uint16 0 65535 /end CHARACTERISTIC
/begin CHARACTERISTIC BDM_cCellVoltDiffHiLv4InitTiDeb_U16 "单体压差过大等级4故障初始化成熟时间" VALUE 0x0000 /* @ECU_Address@BDM_cCellVoltDiffHiLv4InitTiDeb_U16@ */ Scalar_UWORD 0 BMS_CM_uint16 0 65535 /end CHARACTERISTIC
/begin CHARACTERISTIC BDM_cCellVoltDiffHiLv4TiDeb_U16 "单体压差过大等级4故障成熟时间" VALUE 0x0000 /* @ECU_Address@BDM_cCellVoltDiffHiLv4TiDeb_U16@ */ Scalar_UWORD 0 BMS_CM_uint16 0 65535 /end CHARACTERISTIC
/begin CHARACTERISTIC BDM_cCellVoltDiffHiLv4ValueSOC1_U16 "单体温差过大等级4SOC1故障阈值" VALUE 0x0000 /* @ECU_Address@BDM_cCellVoltDiffHiLv4ValueSOC1_U16@ */ Scalar_UWORD 0 BMS_CM_uint16 0 65535 /end CHARACTERISTIC
/begin CHARACTERISTIC BDM_cCellVoltDiffHiLv4ValueSOC2_U16 "单体温差过大等级4SOC2故障阈值" VALUE 0x0000 /* @ECU_Address@BDM_cCellVoltDiffHiLv4ValueSOC2_U16@ */ Scalar_UWORD 0 BMS_CM_uint16 0 65535 /end CHARACTERISTIC
/begin CHARACTERISTIC BDM_cCellVoltDiffHiLv4ValueSOC3_U16 "单体温差过大等级4SOC3故障阈值" VALUE 0x0000 /* @ECU_Address@BDM_cCellVoltDiffHiLv4ValueSOC3_U16@ */ Scalar_UWORD 0 BMS_CM_uint16 0 65535 /end CHARACTERISTIC
/begin CHARACTERISTIC BDM_cCellVoltHiLv1En_U8 "单体过高等级1故障诊断使能" VALUE 0x0000 /* @ECU_Address@BDM_cCellVoltHiLv1En_U8@ */ Scalar_UBYTE 0 BMS_CM_uint8 0 255 /end CHARACTERISTIC
/begin CHARACTERISTIC BDM_cCellVoltHiLv1HealEn_U8 "单体过高等级1故障恢复使能" VALUE 0x0000 /* @ECU_Address@BDM_cCellVoltHiLv1HealEn_U8@ */ Scalar_UBYTE 0 BMS_CM_uint8 0 255 /end CHARACTERISTIC
/begin CHARACTERISTIC BDM_cCellVoltHiLv1HealValue_U16 "单体过高等级1恢复阈值" VALUE 0x0000 /* @ECU_Address@BDM_cCellVoltHiLv1HealValue_U16@ */ Scalar_UWORD 0 BMS_CM_uint16 0 65535 /end CHARACTERISTIC
/begin CHARACTERISTIC BDM_cCellVoltHiLv1InitTiDeb_U16 "单体过高等级1故障初始化成熟时间" VALUE 0x0000 /* @ECU_Address@BDM_cCellVoltHiLv1InitTiDeb_U16@ */ Scalar_UWORD 0 BMS_CM_uint16 0 65535 /end CHARACTERISTIC
/begin CHARACTERISTIC BDM_cCellVoltHiLv1Value_U16 "单体过高等级1故障阈值" VALUE 0x0000 /* @ECU_Address@BDM_cCellVoltHiLv1Value_U16@ */ Scalar_UWORD 0 BMS_CM_uint16 0 65535 /end CHARACTERISTIC
/begin CHARACTERISTIC BDM_cCellVoltHiLv2En_U8 "单体过高等级2故障诊断使能" VALUE 0x0000 /* @ECU_Address@BDM_cCellVoltHiLv2En_U8@ */ Scalar_UBYTE 0 BMS_CM_uint8 0 255 /end CHARACTERISTIC
/begin CHARACTERISTIC BDM_cCellVoltHiLv2HealEn_U8 "单体过高等级2故障恢复使能" VALUE 0x0000 /* @ECU_Address@BDM_cCellVoltHiLv2HealEn_U8@ */ Scalar_UBYTE 0 BMS_CM_uint8 0 255 /end CHARACTERISTIC
/begin CHARACTERISTIC BDM_cCellVoltHiLv2HealValue_U16 "单体过高等级2恢复阈值" VALUE 0x0000 /* @ECU_Address@BDM_cCellVoltHiLv2HealValue_U16@ */ Scalar_UWORD 0 BMS_CM_uint16 0 65535 /end CHARACTERISTIC
/begin CHARACTERISTIC BDM_cCellVoltHiLv2InitTiDeb_U16 "单体过高等级2故障初始化成熟时间" VALUE 0x0000 /* @ECU_Address@BDM_cCellVoltHiLv2InitTiDeb_U16@ */ Scalar_UWORD 0 BMS_CM_uint16 0 65535 /end CHARACTERISTIC
/begin CHARACTERISTIC BDM_cCellVoltHiLv2Value_U16 "单体过高等级2故障阈值" VALUE 0x0000 /* @ECU_Address@BDM_cCellVoltHiLv2Value_U16@ */ Scalar_UWORD 0 BMS_CM_uint16 0 65535 /end CHARACTERISTIC
/begin CHARACTERISTIC BDM_cCellVoltHiLv3En_U8 "单体过高等级3故障诊断使能" VALUE 0x0000 /* @ECU_Address@BDM_cCellVoltHiLv3En_U8@ */ Scalar_UBYTE 0 BMS_CM_uint8 0 255 /end CHARACTERISTIC
/begin CHARACTERISTIC BDM_cCellVoltHiLv3HealEn_U8 "单体过高等级3故障恢复使能" VALUE 0x0000 /* @ECU_Address@BDM_cCellVoltHiLv3HealEn_U8@ */ Scalar_UBYTE 0 BMS_CM_uint8 0 255 /end CHARACTERISTIC
/begin CHARACTERISTIC BDM_cCellVoltHiLv3HealValue_U16 "单体过高等级3恢复阈值" VALUE 0x0000 /* @ECU_Address@BDM_cCellVoltHiLv3HealValue_U16@ */ Scalar_UWORD 0 BMS_CM_uint16 0 65535 /end CHARACTERISTIC
/begin CHARACTERISTIC BDM_cCellVoltHiLv3InitTiDeb_U16 "单体过高等级3故障初始化成熟时间" VALUE 0x0000 /* @ECU_Address@BDM_cCellVoltHiLv3InitTiDeb_U16@ */ Scalar_UWORD 0 BMS_CM_uint16 0 65535 /end CHARACTERISTIC
/begin CHARACTERISTIC BDM_cCellVoltHiLv3Value_U16 "单体过高等级3故障阈值" VALUE 0x0000 /* @ECU_Address@BDM_cCellVoltHiLv3Value_U16@ */ Scalar_UWORD 0 BMS_CM_uint16 0 65535 /end CHARACTERISTIC
/begin CHARACTERISTIC BDM_cCellVoltHiLv4En_U8 "单体过高等级4故障诊断使能" VALUE 0x0000 /* @ECU_Address@BDM_cCellVoltHiLv4En_U8@ */ Scalar_UBYTE 0 BMS_CM_uint8 0 255 /end CHARACTERISTIC
/begin CHARACTERISTIC BDM_cCellVoltHiLv4HealEn_U8 "单体过高等级4故障恢复使能" VALUE 0x0000 /* @ECU_Address@BDM_cCellVoltHiLv4HealEn_U8@ */ Scalar_UBYTE 0 BMS_CM_uint8 0 255 /end CHARACTERISTIC
/begin CHARACTERISTIC BDM_cCellVoltHiLv4HealValue_U16 "单体过高等级4恢复阈值" VALUE 0x0000 /* @ECU_Address@BDM_cCellVoltHiLv4HealValue_U16@ */ Scalar_UWORD 0 BMS_CM_uint16 0 65535 /end CHARACTERISTIC
/begin CHARACTERISTIC BDM_cCellVoltHiLv4InitTiDeb_U16 "单体过高等级4故障初始化成熟时间" VALUE 0x0000 /* @ECU_Address@BDM_cCellVoltHiLv4InitTiDeb_U16@ */ Scalar_UWORD 0 BMS_CM_uint16 0 65535 /end CHARACTERISTIC
/begin CHARACTERISTIC BDM_cCellVoltHiLv4Value_U16 "单体过高等级4故障阈值" VALUE 0x0000 /* @ECU_Address@BDM_cCellVoltHiLv4Value_U16@ */ Scalar_UWORD 0 BMS_CM_uint16 0 65535 /end CHARACTERISTIC
/begin CHARACTERISTIC BDM_cCellVoltLoLv1En_U8 "单体过低等级1故障诊断使能" VALUE 0x0000 /* @ECU_Address@BDM_cCellVoltLoLv1En_U8@ */ Scalar_UBYTE 0 BMS_CM_uint8 0 255 /end CHARACTERISTIC
/begin CHARACTERISTIC BDM_cCellVoltLoLv1HealEn_U8 "单体过低等级1故障恢复使能" VALUE 0x0000 /* @ECU_Address@BDM_cCellVoltLoLv1HealEn_U8@ */ Scalar_UBYTE 0 BMS_CM_uint8 0 255 /end CHARACTERISTIC
/begin CHARACTERISTIC BDM_cCellVoltLoLv1HealTiDeb_U16 "单体过低等级1故障恢复时间" VALUE 0x0000 /* @ECU_Address@BDM_cCellVoltLoLv1HealTiDeb_U16@ */ Scalar_UWORD 0 BMS_CM_uint16 0 65535 /end CHARACTERISTIC
/begin CHARACTERISTIC BDM_cCellVoltLoLv1InitTiDeb_U16 "单体过低等级1故障初始化成熟时间" VALUE 0x0000 /* @ECU_Address@BDM_cCellVoltLoLv1InitTiDeb_U16@ */ Scalar_UWORD 0 BMS_CM_uint16 0 65535 /end CHARACTERISTIC
/begin CHARACTERISTIC BDM_cCellVoltLoLv1TiDeb_U16 "单体过低等级1故障成熟时间" VALUE 0x0000 /* @ECU_Address@BDM_cCellVoltLoLv1TiDeb_U16@ */ Scalar_UWORD 0 BMS_CM_uint16 0 65535 /end CHARACTERISTIC
/begin CHARACTERISTIC BDM_cCellVoltLoLv2En_U8 "单体过低等级2故障诊断使能" VALUE 0x0000 /* @ECU_Address@BDM_cCellVoltLoLv2En_U8@ */ Scalar_UBYTE 0 BMS_CM_uint8 0 255 /end CHARACTERISTIC
/begin CHARACTERISTIC BDM_cCellVoltLoLv2HealEn_U8 "单体过低等级2故障恢复使能" VALUE 0x0000 /* @ECU_Address@BDM_cCellVoltLoLv2HealEn_U8@ */ Scalar_UBYTE 0 BMS_CM_uint8 0 255 /end CHARACTERISTIC
/begin CHARACTERISTIC BDM_cCellVoltLoLv2HealTiDeb_U16 "单体过低等级2故障恢复时间" VALUE 0x0000 /* @ECU_Address@BDM_cCellVoltLoLv2HealTiDeb_U16@ */ Scalar_UWORD 0 BMS_CM_uint16 0 65535 /end CHARACTERISTIC
/begin CHARACTERISTIC BDM_cCellVoltLoLv2InitTiDeb_U16 "单体过低等级2故障初始化成熟时间" VALUE 0x0000 /* @ECU_Address@BDM_cCellVoltLoLv2InitTiDeb_U16@ */ Scalar_UWORD 0 BMS_CM_uint16 0 65535 /end CHARACTERISTIC
/begin CHARACTERISTIC BDM_cCellVoltLoLv2TiDeb_U16 "单体过低等级2故障成熟时间" VALUE 0x0000 /* @ECU_Address@BDM_cCellVoltLoLv2TiDeb_U16@ */ Scalar_UWORD 0 BMS_CM_uint16 0 65535 /end CHARACTERISTIC
/begin CHARACTERISTIC BDM_cCellVoltLoLv3En_U8 "单体过低等级3故障诊断使能" VALUE 0x0000 /* @ECU_Address@BDM_cCellVoltLoLv3En_U8@ */ Scalar_UBYTE 0 BMS_CM_uint8 0 255 /end CHARACTERISTIC
/begin CHARACTERISTIC BDM_cCellVoltLoLv3HealEn_U8 "单体过低等级3故障恢复使能" VALUE 0x0000 /* @ECU_Address@BDM_cCellVoltLoLv3HealEn_U8@ */ Scalar_UBYTE 0 BMS_CM_uint8 0 255 /end CHARACTERISTIC
/begin CHARACTERISTIC BDM_cCellVoltLoLv3HealTiDeb_U16 "单体过低等级3故障恢复时间" VALUE 0x0000 /* @ECU_Address@BDM_cCellVoltLoLv3HealTiDeb_U16@ */ Scalar_UWORD 0 BMS_CM_uint16 0 65535 /end CHARACTERISTIC
/begin CHARACTERISTIC BDM_cCellVoltLoLv3InitTiDeb_U16 "单体过低等级3故障初始化成熟时间" VALUE 0x0000 /* @ECU_Address@BDM_cCellVoltLoLv3InitTiDeb_U16@ */ Scalar_UWORD 0 BMS_CM_uint16 0 65535 /end CHARACTERISTIC
/begin CHARACTERISTIC BDM_cCellVoltLoLv3TiDeb_U16 "单体过低等级3故障成熟时间" VALUE 0x0000 /* @ECU_Address@BDM_cCellVoltLoLv3TiDeb_U16@ */ Scalar_UWORD 0 BMS_CM_uint16 0 65535 /end CHARACTERISTIC
/begin CHARACTERISTIC BDM_cCellVoltLoLv4En_U8 "单体过低等级4故障诊断使能" VALUE 0x0000 /* @ECU_Address@BDM_cCellVoltLoLv4En_U8@ */ Scalar_UBYTE 0 BMS_CM_uint8 0 255 /end CHARACTERISTIC
/begin CHARACTERISTIC BDM_cCellVoltLoLv4HealEn_U8 "单体过低等级4故障恢复使能" VALUE 0x0000 /* @ECU_Address@BDM_cCellVoltLoLv4HealEn_U8@ */ Scalar_UBYTE 0 BMS_CM_uint8 0 255 /end CHARACTERISTIC
/begin CHARACTERISTIC BDM_cCellVoltLoLv4HealTiDeb_U16 "单体过低等级4故障恢复时间" VALUE 0x0000 /* @ECU_Address@BDM_cCellVoltLoLv4HealTiDeb_U16@ */ Scalar_UWORD 0 BMS_CM_uint16 0 65535 /end CHARACTERISTIC
/begin CHARACTERISTIC BDM_cCellVoltLoLv4HealValueTemp1_U16 "单体电压过低等级4恢复阈值1" VALUE 0x0000 /* @ECU_Address@BDM_cCellVoltLoLv4HealValueTemp1_U16@ */ Scalar_UWORD 0 BMS_CM_uint16 0 65535 /end CHARACTERISTIC
/begin CHARACTERISTIC BDM_cCellVoltLoLv4HealValueTemp2_U16 "单体电压过低等级4恢复阈值2" VALUE 0x0000 /* @ECU_Address@BDM_cCellVoltLoLv4HealValueTemp2_U16@ */ Scalar_UWORD 0 BMS_CM_uint16 0 65535 /end CHARACTERISTIC
/begin CHARACTERISTIC BDM_cCellVoltLoLv4HealValueTemp3_U16 "单体电压过低等级4恢复阈值3" VALUE 0x0000 /* @ECU_Address@BDM_cCellVoltLoLv4HealValueTemp3_U16@ */ Scalar_UWORD 0 BMS_CM_uint16 0 65535 /end CHARACTERISTIC
/begin CHARACTERISTIC BDM_cCellVoltLoLv4HealValueTemp4_U16 "单体电压过低等级4恢复阈值4" VALUE 0x0000 /* @ECU_Address@BDM_cCellVoltLoLv4HealValueTemp4_U16@ */ Scalar_UWORD 0 BMS_CM_uint16 0 65535 /end CHARACTERISTIC
/begin CHARACTERISTIC BDM_cCellVoltLoLv4InitTiDeb_U16 "单体过低等级4故障初始化成熟时间" VALUE 0x0000 /* @ECU_Address@BDM_cCellVoltLoLv4InitTiDeb_U16@ */ Scalar_UWORD 0 BMS_CM_uint16 0 65535 /end CHARACTERISTIC
/begin CHARACTERISTIC BDM_cCellVoltLoLv4TiDeb_U16 "单体过低等级4故障成熟时间" VALUE 0x0000 /* @ECU_Address@BDM_cCellVoltLoLv4TiDeb_U16@ */ Scalar_UWORD 0 BMS_CM_uint16 0 65535 /end CHARACTERISTIC
/begin CHARACTERISTIC BDM_cCellVoltLoLv4ValueTemp1_U16 "单体电压过低等级4故障阈值1" VALUE 0x0000 /* @ECU_Address@BDM_cCellVoltLoLv4ValueTemp1_U16@ */ Scalar_UWORD 0 BMS_CM_uint16 0 65535 /end CHARACTERISTIC
/begin CHARACTERISTIC BDM_cCellVoltLoLv4ValueTemp2_U16 "单体电压过低等级4故障阈值2" VALUE 0x0000 /* @ECU_Address@BDM_cCellVoltLoLv4ValueTemp2_U16@ */ Scalar_UWORD 0 BMS_CM_uint16 0 65535 /end CHARACTERISTIC
/begin CHARACTERISTIC BDM_cCellVoltOverLoLv1En_U8 "电芯过放等级1故障诊断使能" VALUE 0x0000 /* @ECU_Address@BDM_cCellVoltOverLoLv1En_U8@ */ Scalar_UBYTE 0 BMS_CM_uint8 0 255 /end CHARACTERISTIC
/begin CHARACTERISTIC BDM_cCellVoltOverLoLv1HealEn_U8 "电芯过放等级1故障恢复使能" VALUE 0x0000 /* @ECU_Address@BDM_cCellVoltOverLoLv1HealEn_U8@ */ Scalar_UBYTE 0 BMS_CM_uint8 0 255 /end CHARACTERISTIC
/begin CHARACTERISTIC BDM_cCellVoltOverLoLv1HealTiDeb_U16 "电芯过放等级1故障恢复时间" VALUE 0x0000 /* @ECU_Address@BDM_cCellVoltOverLoLv1HealTiDeb_U16@ */ Scalar_UWORD 0 BMS_CM_uint16 0 65535 /end CHARACTERISTIC
/begin CHARACTERISTIC BDM_cCellVoltOverLoLv1InitTiDeb_U16 "电芯过放等级1故障初始化成熟时间" VALUE 0x0000 /* @ECU_Address@BDM_cCellVoltOverLoLv1InitTiDeb_U16@ */ Scalar_UWORD 0 BMS_CM_uint16 0 65535 /end CHARACTERISTIC
/begin CHARACTERISTIC BDM_cCellVoltOverLoLv1TiDeb_U16 "电芯过放等级1故障成熟时间" VALUE 0x0000 /* @ECU_Address@BDM_cCellVoltOverLoLv1TiDeb_U16@ */ Scalar_UWORD 0 BMS_CM_uint16 0 65535 /end CHARACTERISTIC
/begin CHARACTERISTIC BDM_cChgBattVoltHiLv2En_U8 "充电总压过高等级2故障诊断使能" VALUE 0x0000 /* @ECU_Address@BDM_cChgBattVoltHiLv2En_U8@ */ Scalar_UBYTE 0 BMS_CM_uint8 0 255 /end CHARACTERISTIC
/begin CHARACTERISTIC BDM_cChgBattVoltHiLv2HealEn_U8 "充电总压过高等级2故障恢复使能" VALUE 0x0000 /* @ECU_Address@BDM_cChgBattVoltHiLv2HealEn_U8@ */ Scalar_UBYTE 0 BMS_CM_uint8 0 255 /end CHARACTERISTIC
/begin CHARACTERISTIC BDM_cChgBattVoltHiLv2HealTiDeb_U16 "充电总压过高等级2故障恢复时间" VALUE 0x0000 /* @ECU_Address@BDM_cChgBattVoltHiLv2HealTiDeb_U16@ */ Scalar_UWORD 0 BMS_CM_uint16 0 65535 /end CHARACTERISTIC
/begin CHARACTERISTIC BDM_cChgBattVoltHiLv2HealValue_F32 "充电总压过高等级2恢复阈值" VALUE 0x0000 /* @ECU_Address@BDM_cChgBattVoltHiLv2HealValue_F32@ */ Scalar_FLOAT32_IEEE 0 BMS_CM_single -3.4e+38 3.4e+38 /end CHARACTERISTIC
/begin CHARACTERISTIC BDM_cChgBattVoltHiLv2InitTiDeb_U16 "充电总压过高2故障初始化成熟时间" VALUE 0x0000 /* @ECU_Address@BDM_cChgBattVoltHiLv2InitTiDeb_U16@ */ Scalar_UWORD 0 BMS_CM_uint16 0 65535 /end CHARACTERISTIC
/begin CHARACTERISTIC BDM_cChgBattVoltHiLv2TiDeb_U16 "充电总压过高等级2故障成熟时间" VALUE 0x0000 /* @ECU_Address@BDM_cChgBattVoltHiLv2TiDeb_U16@ */ Scalar_UWORD 0 BMS_CM_uint16 0 65535 /end CHARACTERISTIC
/begin CHARACTERISTIC BDM_cChgBattVoltHiLv2Value_F32 "充电总压过高等级2故障阈值" VALUE 0x0000 /* @ECU_Address@BDM_cChgBattVoltHiLv2Value_F32@ */ Scalar_FLOAT32_IEEE 0 BMS_CM_single -3.4e+38 3.4e+38 /end CHARACTERISTIC
/begin CHARACTERISTIC BDM_cChgBattVoltHiLv3En_U8 "充电总压过高等级3故障诊断使能" VALUE 0x0000 /* @ECU_Address@BDM_cChgBattVoltHiLv3En_U8@ */ Scalar_UBYTE 0 BMS_CM_uint8 0 255 /end CHARACTERISTIC
/begin CHARACTERISTIC BDM_cChgBattVoltHiLv3HealEn_U8 "充电总压过高等级3故障恢复使能" VALUE 0x0000 /* @ECU_Address@BDM_cChgBattVoltHiLv3HealEn_U8@ */ Scalar_UBYTE 0 BMS_CM_uint8 0 255 /end CHARACTERISTIC
/begin CHARACTERISTIC BDM_cChgBattVoltHiLv3HealTiDeb_U16 "充电总压过高等级3故障恢复时间" VALUE 0x0000 /* @ECU_Address@BDM_cChgBattVoltHiLv3HealTiDeb_U16@ */ Scalar_UWORD 0 BMS_CM_uint16 0 65535 /end CHARACTERISTIC
/begin CHARACTERISTIC BDM_cChgBattVoltHiLv3HealValue_F32 "充电总压过高等级3恢复阈值" VALUE 0x0000 /* @ECU_Address@BDM_cChgBattVoltHiLv3HealValue_F32@ */ Scalar_FLOAT32_IEEE 0 BMS_CM_single -3.4e+38 3.4e+38 /end CHARACTERISTIC
/begin CHARACTERISTIC BDM_cChgBattVoltHiLv3InitTiDeb_U16 "充电总压过高3故障初始化成熟时间" VALUE 0x0000 /* @ECU_Address@BDM_cChgBattVoltHiLv3InitTiDeb_U16@ */ Scalar_UWORD 0 BMS_CM_uint16 0 65535 /end CHARACTERISTIC
/begin CHARACTERISTIC BDM_cChgBattVoltHiLv3TiDeb_U16 "充电总压过高等级3故障成熟时间" VALUE 0x0000 /* @ECU_Address@BDM_cChgBattVoltHiLv3TiDeb_U16@ */ Scalar_UWORD 0 BMS_CM_uint16 0 65535 /end CHARACTERISTIC
/begin CHARACTERISTIC BDM_cChgBattVoltHiLv3Value_F32 "充电总压过高等级3故障阈值" VALUE 0x0000 /* @ECU_Address@BDM_cChgBattVoltHiLv3Value_F32@ */ Scalar_FLOAT32_IEEE 0 BMS_CM_single -3.4e+38 3.4e+38 /end CHARACTERISTIC
/begin CHARACTERISTIC BDM_cChgCellTempHiLv3En_U8 "单体充电温度过高等级3故障诊断使能" VALUE 0x0000 /* @ECU_Address@BDM_cChgCellTempHiLv3En_U8@ */ Scalar_UBYTE 0 BMS_CM_uint8 0 255 /end CHARACTERISTIC
/begin CHARACTERISTIC BDM_cChgCellTempHiLv3HealEn_U8 "单体充电温度过高等级3故障恢复使能" VALUE 0x0000 /* @ECU_Address@BDM_cChgCellTempHiLv3HealEn_U8@ */ Scalar_UBYTE 0 BMS_CM_uint8 0 255 /end CHARACTERISTIC
/begin CHARACTERISTIC BDM_cChgCellTempHiLv3HealTiDeb_U16 "单体充电温度过高等级3故障恢复时间" VALUE 0x0000 /* @ECU_Address@BDM_cChgCellTempHiLv3HealTiDeb_U16@ */ Scalar_UWORD 0 BMS_CM_uint16 0 65535 /end CHARACTERISTIC
/begin CHARACTERISTIC BDM_cChgCellTempHiLv3HealValue_F32 "单体充电温度过高等级3恢复阈值" VALUE 0x0000 /* @ECU_Address@BDM_cChgCellTempHiLv3HealValue_F32@ */ Scalar_FLOAT32_IEEE 0 BMS_CM_single -3.4e+38 3.4e+38 /end CHARACTERISTIC
/begin CHARACTERISTIC BDM_cChgCellTempHiLv3InitTiDeb_U16 "单体充电温度过高等级3故障初始化成熟时间" VALUE 0x0000 /* @ECU_Address@BDM_cChgCellTempHiLv3InitTiDeb_U16@ */ Scalar_UWORD 0 BMS_CM_uint16 0 65535 /end CHARACTERISTIC
/begin CHARACTERISTIC BDM_cChgCellTempHiLv3TiDeb_U16 "单体充电温度过高等级3故障成熟时间" VALUE 0x0000 /* @ECU_Address@BDM_cChgCellTempHiLv3TiDeb_U16@ */ Scalar_UWORD 0 BMS_CM_uint16 0 65535 /end CHARACTERISTIC
/begin CHARACTERISTIC BDM_cChgCellTempHiLv3Value_F32 "单体充电温度过高等级3故障阈值" VALUE 0x0000 /* @ECU_Address@BDM_cChgCellTempHiLv3Value_F32@ */ Scalar_FLOAT32_IEEE 0 BMS_CM_single -3.4e+38 3.4e+38 /end CHARACTERISTIC
/begin CHARACTERISTIC BDM_cChgCellTempLoLv1HealTiDeb_U16 "单体充电温度过低等级1故障恢复时间" VALUE 0x0000 /* @ECU_Address@BDM_cChgCellTempLoLv1HealTiDeb_U16@ */ Scalar_UWORD 0 BMS_CM_uint16 0 65535 /end CHARACTERISTIC
/begin CHARACTERISTIC BDM_cChgCellTempLoLv1TiDeb_U16 "单体充电温度过低等级1故障成熟时间" VALUE 0x0000 /* @ECU_Address@BDM_cChgCellTempLoLv1TiDeb_U16@ */ Scalar_UWORD 0 BMS_CM_uint16 0 65535 /end CHARACTERISTIC
/begin CHARACTERISTIC BDM_cChgCellTempLoLv2En_U8 "单体放电温度过高等级2故障诊断使能" VALUE 0x0000 /* @ECU_Address@BDM_cChgCellTempLoLv2En_U8@ */ Scalar_UBYTE 0 BMS_CM_uint8 0 255 /end CHARACTERISTIC
/begin CHARACTERISTIC BDM_cChgCellTempLoLv2HealEn_U8 "单体充电温度过低等级2故障恢复使能" VALUE 0x0000 /* @ECU_Address@BDM_cChgCellTempLoLv2HealEn_U8@ */ Scalar_UBYTE 0 BMS_CM_uint8 0 255 /end CHARACTERISTIC
/begin CHARACTERISTIC BDM_cChgCellTempLoLv2HealTiDeb_U16 "单体充电温度过低等级2故障恢复时间" VALUE 0x0000 /* @ECU_Address@BDM_cChgCellTempLoLv2HealTiDeb_U16@ */ Scalar_UWORD 0 BMS_CM_uint16 0 65535 /end CHARACTERISTIC
/begin CHARACTERISTIC BDM_cChgCellTempLoLv2HealValue_F32 "单体充电温度过低等级2恢复阈值" VALUE 0x0000 /* @ECU_Address@BDM_cChgCellTempLoLv2HealValue_F32@ */ Scalar_FLOAT32_IEEE 0 BMS_CM_single -3.4e+38 3.4e+38 /end CHARACTERISTIC
/begin CHARACTERISTIC BDM_cChgCellTempLoLv2InitTiDeb_U16 "单体充电温度过低等级2故障初始化成熟时间" VALUE 0x0000 /* @ECU_Address@BDM_cChgCellTempLoLv2InitTiDeb_U16@ */ Scalar_UWORD 0 BMS_CM_uint16 0 65535 /end CHARACTERISTIC
/begin CHARACTERISTIC BDM_cChgCellTempLoLv2TiDeb_U16 "单体充电温度过低等级2故障成熟时间" VALUE 0x0000 /* @ECU_Address@BDM_cChgCellTempLoLv2TiDeb_U16@ */ Scalar_UWORD 0 BMS_CM_uint16 0 65535 /end CHARACTERISTIC
/begin CHARACTERISTIC BDM_cChgCellTempLoLv2Value_F32 "单体充电温度过低等级2故障阈值" VALUE 0x0000 /* @ECU_Address@BDM_cChgCellTempLoLv2Value_F32@ */ Scalar_FLOAT32_IEEE 0 BMS_CM_single -3.4e+38 3.4e+38 /end CHARACTERISTIC
/begin CHARACTERISTIC BDM_cChgCurrAbnormErrEn_U8 "充电电流异常等级1故障诊断使能" VALUE 0x0000 /* @ECU_Address@BDM_cChgCurrAbnormErrEn_U8@ */ Scalar_UBYTE 0 BMS_CM_uint8 0 255 /end CHARACTERISTIC
/begin CHARACTERISTIC BDM_cChgCurrAbnormErrHealEn_U8 "充电电流异常等级1故障恢复使能" VALUE 0x0000 /* @ECU_Address@BDM_cChgCurrAbnormErrHealEn_U8@ */ Scalar_UBYTE 0 BMS_CM_uint8 0 255 /end CHARACTERISTIC
/begin CHARACTERISTIC BDM_cChgCurrAbnormErrHealTiDeb_U16 "充电电流异常等级1故障恢复时间" VALUE 0x0000 /* @ECU_Address@BDM_cChgCurrAbnormErrHealTiDeb_U16@ */ Scalar_UWORD 0 BMS_CM_uint16 0 65535 /end CHARACTERISTIC
/begin CHARACTERISTIC BDM_cChgCurrAbnormErrInitTiDeb_U16 "充电电流异常等级1故障初始化成熟时间" VALUE 0x0000 /* @ECU_Address@BDM_cChgCurrAbnormErrInitTiDeb_U16@ */ Scalar_UWORD 0 BMS_CM_uint16 0 65535 /end CHARACTERISTIC
/begin CHARACTERISTIC BDM_cChgCurrAbnormErrTiDeb_U16 "充电电流异常等级1故障成熟时间" VALUE 0x0000 /* @ECU_Address@BDM_cChgCurrAbnormErrTiDeb_U16@ */ Scalar_UWORD 0 BMS_CM_uint16 0 65535 /end CHARACTERISTIC
/begin CHARACTERISTIC BDM_cChgDiscCurrHiLv1En_U8 "充电时放电过流等级1故障诊断使能" VALUE 0x0000 /* @ECU_Address@BDM_cChgDiscCurrHiLv1En_U8@ */ Scalar_UBYTE 0 BMS_CM_uint8 0 255 /end CHARACTERISTIC
/begin CHARACTERISTIC BDM_cChgDiscCurrHiLv1HealEn_U8 "充电时放电过流等级1故障恢复使能" VALUE 0x0000 /* @ECU_Address@BDM_cChgDiscCurrHiLv1HealEn_U8@ */ Scalar_UBYTE 0 BMS_CM_uint8 0 255 /end CHARACTERISTIC
/begin CHARACTERISTIC BDM_cChgDiscCurrHiLv1HealTiDeb_U16 "充电时放电过流等级1故障恢复时间" VALUE 0x0000 /* @ECU_Address@BDM_cChgDiscCurrHiLv1HealTiDeb_U16@ */ Scalar_UWORD 0 BMS_CM_uint16 0 65535 /end CHARACTERISTIC
/begin CHARACTERISTIC BDM_cChgDiscCurrHiLv1InitTiDeb_U16 "充电时放电过流等级1故障初始化成熟时间" VALUE 0x0000 /* @ECU_Address@BDM_cChgDiscCurrHiLv1InitTiDeb_U16@ */ Scalar_UWORD 0 BMS_CM_uint16 0 65535 /end CHARACTERISTIC
/begin CHARACTERISTIC BDM_cChgDiscCurrHiLv1TiDeb_U16 "充电时放电过流等级1故障成熟时间" VALUE 0x0000 /* @ECU_Address@BDM_cChgDiscCurrHiLv1TiDeb_U16@ */ Scalar_UWORD 0 BMS_CM_uint16 0 65535 /end CHARACTERISTIC
/begin CHARACTERISTIC BDM_cChgIResLoLv3En_U8 "充电绝缘阻值过低等级3故障诊断使能" VALUE 0x0000 /* @ECU_Address@BDM_cChgIResLoLv3En_U8@ */ Scalar_UBYTE 0 BMS_CM_uint8 0 255 /end CHARACTERISTIC
/begin CHARACTERISTIC BDM_cChgIResLoLv3HealEn_U8 "充电绝缘阻值过低等级3故障恢复使能" VALUE 0x0000 /* @ECU_Address@BDM_cChgIResLoLv3HealEn_U8@ */ Scalar_UBYTE 0 BMS_CM_uint8 0 255 /end CHARACTERISTIC
/begin CHARACTERISTIC BDM_cChgIResLoLv3HealTiDeb_U16 "充电绝缘阻值过低等级3故障恢复时间" VALUE 0x0000 /* @ECU_Address@BDM_cChgIResLoLv3HealTiDeb_U16@ */ Scalar_UWORD 0 BMS_CM_uint16 0 65535 /end CHARACTERISTIC
/begin CHARACTERISTIC BDM_cChgIResLoLv3HealValue_F32 "充电绝缘阻值过低等级3恢复阈值" VALUE 0x0000 /* @ECU_Address@BDM_cChgIResLoLv3HealValue_F32@ */ Scalar_FLOAT32_IEEE 0 BMS_CM_single -3.4e+38 3.4e+38 /end CHARACTERISTIC
/begin CHARACTERISTIC BDM_cChgIResLoLv3InitTiDeb_U16 "充电绝缘阻值过低等级3故障初始化成熟时间" VALUE 0x0000 /* @ECU_Address@BDM_cChgIResLoLv3InitTiDeb_U16@ */ Scalar_UWORD 0 BMS_CM_uint16 0 65535 /end CHARACTERISTIC
/begin CHARACTERISTIC BDM_cChgIResLoLv3TiDeb_U16 "充电绝缘阻值过低等级3故障成熟时间" VALUE 0x0000 /* @ECU_Address@BDM_cChgIResLoLv3TiDeb_U16@ */ Scalar_UWORD 0 BMS_CM_uint16 0 65535 /end CHARACTERISTIC
/begin CHARACTERISTIC BDM_cChgIResLoLv3Value_F32 "充电绝缘阻值过低等级3故障阈值" VALUE 0x0000 /* @ECU_Address@BDM_cChgIResLoLv3Value_F32@ */ Scalar_FLOAT32_IEEE 0 BMS_CM_single -3.4e+38 3.4e+38 /end CHARACTERISTIC
/begin CHARACTERISTIC BDM_cDCChgCurrHiLv1En_U8 "快充过流等级1故障诊断使能" VALUE 0x0000 /* @ECU_Address@BDM_cDCChgCurrHiLv1En_U8@ */ Scalar_UBYTE 0 BMS_CM_uint8 0 255 /end CHARACTERISTIC
/begin CHARACTERISTIC BDM_cDCChgCurrHiLv1HealEn_U8 "快充过流等级1故障恢复使能" VALUE 0x0000 /* @ECU_Address@BDM_cDCChgCurrHiLv1HealEn_U8@ */ Scalar_UBYTE 0 BMS_CM_uint8 0 255 /end CHARACTERISTIC
/begin CHARACTERISTIC BDM_cDCChgCurrHiLv1HealTiDeb_U16 "快充过流等级1故障恢复时间" VALUE 0x0000 /* @ECU_Address@BDM_cDCChgCurrHiLv1HealTiDeb_U16@ */ Scalar_UWORD 0 BMS_CM_uint16 0 65535 /end CHARACTERISTIC
/begin CHARACTERISTIC BDM_cDCChgCurrHiLv1InitTiDeb_U16 "快充过流等级1故障初始化成熟时间" VALUE 0x0000 /* @ECU_Address@BDM_cDCChgCurrHiLv1InitTiDeb_U16@ */ Scalar_UWORD 0 BMS_CM_uint16 0 65535 /end CHARACTERISTIC
/begin CHARACTERISTIC BDM_cDCChgCurrHiLv1TiDeb_U16 "快充过流等级1故障成熟时间" VALUE 0x0000 /* @ECU_Address@BDM_cDCChgCurrHiLv1TiDeb_U16@ */ Scalar_UWORD 0 BMS_CM_uint16 0 65535 /end CHARACTERISTIC
/begin CHARACTERISTIC BDM_cDCChgCurrHiLv2En_U8 "快充过流等级2故障诊断使能" VALUE 0x0000 /* @ECU_Address@BDM_cDCChgCurrHiLv2En_U8@ */ Scalar_UBYTE 0 BMS_CM_uint8 0 255 /end CHARACTERISTIC
/begin CHARACTERISTIC BDM_cDCChgCurrHiLv2HealEn_U8 "快充过流等级2故障恢复使能" VALUE 0x0000 /* @ECU_Address@BDM_cDCChgCurrHiLv2HealEn_U8@ */ Scalar_UBYTE 0 BMS_CM_uint8 0 255 /end CHARACTERISTIC
/begin CHARACTERISTIC BDM_cDCChgCurrHiLv2HealTiDeb_U16 "快充过流等级2故障恢复时间" VALUE 0x0000 /* @ECU_Address@BDM_cDCChgCurrHiLv2HealTiDeb_U16@ */ Scalar_UWORD 0 BMS_CM_uint16 0 65535 /end CHARACTERISTIC
/begin CHARACTERISTIC BDM_cDCChgCurrHiLv2InitTiDeb_U16 "快充过流等级2故障初始化成熟时间" VALUE 0x0000 /* @ECU_Address@BDM_cDCChgCurrHiLv2InitTiDeb_U16@ */ Scalar_UWORD 0 BMS_CM_uint16 0 65535 /end CHARACTERISTIC
/begin CHARACTERISTIC BDM_cDCChgCurrHiLv2TiDeb_U16 "快充过流等级2故障成熟时间" VALUE 0x0000 /* @ECU_Address@BDM_cDCChgCurrHiLv2TiDeb_U16@ */ Scalar_UWORD 0 BMS_CM_uint16 0 65535 /end CHARACTERISTIC
/begin CHARACTERISTIC BDM_cDCChgCurrHiLv3En_U8 "快充过流等级3故障诊断使能" VALUE 0x0000 /* @ECU_Address@BDM_cDCChgCurrHiLv3En_U8@ */ Scalar_UBYTE 0 BMS_CM_uint8 0 255 /end CHARACTERISTIC
/begin CHARACTERISTIC BDM_cDCChgCurrHiLv3HealEn_U8 "快充过流等级3故障恢复使能" VALUE 0x0000 /* @ECU_Address@BDM_cDCChgCurrHiLv3HealEn_U8@ */ Scalar_UBYTE 0 BMS_CM_uint8 0 255 /end CHARACTERISTIC
/begin CHARACTERISTIC BDM_cDCChgCurrHiLv3HealTiDeb_U16 "快充过流等级3故障恢复时间" VALUE 0x0000 /* @ECU_Address@BDM_cDCChgCurrHiLv3HealTiDeb_U16@ */ Scalar_UWORD 0 BMS_CM_uint16 0 65535 /end CHARACTERISTIC
/begin CHARACTERISTIC BDM_cDCChgCurrHiLv3InitTiDeb_U16 "快充过流等级3故障初始化成熟时间" VALUE 0x0000 /* @ECU_Address@BDM_cDCChgCurrHiLv3InitTiDeb_U16@ */ Scalar_UWORD 0 BMS_CM_uint16 0 65535 /end CHARACTERISTIC
/begin CHARACTERISTIC BDM_cDCChgCurrHiLv3TiDeb_U16 "快充过流等级3故障成熟时间" VALUE 0x0000 /* @ECU_Address@BDM_cDCChgCurrHiLv3TiDeb_U16@ */ Scalar_UWORD 0 BMS_CM_uint16 0 65535 /end CHARACTERISTIC
/begin CHARACTERISTIC BDM_cDCChgCurrHiLv4En_U8 "快充过流等级4故障诊断使能" VALUE 0x0000 /* @ECU_Address@BDM_cDCChgCurrHiLv4En_U8@ */ Scalar_UBYTE 0 BMS_CM_uint8 0 255 /end CHARACTERISTIC
/begin CHARACTERISTIC BDM_cDCChgCurrHiLv4HealEn_U8 "快充过流等级4故障恢复使能" VALUE 0x0000 /* @ECU_Address@BDM_cDCChgCurrHiLv4HealEn_U8@ */ Scalar_UBYTE 0 BMS_CM_uint8 0 255 /end CHARACTERISTIC
/begin CHARACTERISTIC BDM_cDCChgCurrHiLv4HealTiDeb_U16 "快充过流等级4故障恢复时间" VALUE 0x0000 /* @ECU_Address@BDM_cDCChgCurrHiLv4HealTiDeb_U16@ */ Scalar_UWORD 0 BMS_CM_uint16 0 65535 /end CHARACTERISTIC
/begin CHARACTERISTIC BDM_cDCChgCurrHiLv4InitTiDeb_U16 "快充过流等级4故障初始化成熟时间" VALUE 0x0000 /* @ECU_Address@BDM_cDCChgCurrHiLv4InitTiDeb_U16@ */ Scalar_UWORD 0 BMS_CM_uint16 0 65535 /end CHARACTERISTIC
/begin CHARACTERISTIC BDM_cDCChgCurrHiLv4TiDeb_U16 "快充过流等级4故障成熟时间" VALUE 0x0000 /* @ECU_Address@BDM_cDCChgCurrHiLv4TiDeb_U16@ */ Scalar_UWORD 0 BMS_CM_uint16 0 65535 /end CHARACTERISTIC
/begin CHARACTERISTIC BDM_cDiscBattVoltHiLv2En_U8 "放电总压过高等级2故障诊断使能" VALUE 0x0000 /* @ECU_Address@BDM_cDiscBattVoltHiLv2En_U8@ */ Scalar_UBYTE 0 BMS_CM_uint8 0 255 /end CHARACTERISTIC
/begin CHARACTERISTIC BDM_cDiscBattVoltHiLv2HealEn_U8 "放电总压过高等级2故障恢复使能" VALUE 0x0000 /* @ECU_Address@BDM_cDiscBattVoltHiLv2HealEn_U8@ */ Scalar_UBYTE 0 BMS_CM_uint8 0 255 /end CHARACTERISTIC
/begin CHARACTERISTIC BDM_cDiscBattVoltHiLv2HealTiDeb_U16 "放电总压过高等级2故障恢复时间" VALUE 0x0000 /* @ECU_Address@BDM_cDiscBattVoltHiLv2HealTiDeb_U16@ */ Scalar_UWORD 0 BMS_CM_uint16 0 65535 /end CHARACTERISTIC
/begin CHARACTERISTIC BDM_cDiscBattVoltHiLv2HealValue_F32 "放电总压过高等级2恢复阈值" VALUE 0x0000 /* @ECU_Address@BDM_cDiscBattVoltHiLv2HealValue_F32@ */ Scalar_FLOAT32_IEEE 0 BMS_CM_single -3.4e+38 3.4e+38 /end CHARACTERISTIC
/begin CHARACTERISTIC BDM_cDiscBattVoltHiLv2InitTiDeb_U16 "放电总压过高2故障初始化成熟时间" VALUE 0x0000 /* @ECU_Address@BDM_cDiscBattVoltHiLv2InitTiDeb_U16@ */ Scalar_UWORD 0 BMS_CM_uint16 0 65535 /end CHARACTERISTIC
/begin CHARACTERISTIC BDM_cDiscBattVoltHiLv2TiDeb_U16 "放电总压过高等级2故障成熟时间" VALUE 0x0000 /* @ECU_Address@BDM_cDiscBattVoltHiLv2TiDeb_U16@ */ Scalar_UWORD 0 BMS_CM_uint16 0 65535 /end CHARACTERISTIC
/begin CHARACTERISTIC BDM_cDiscBattVoltHiLv2Value_F32 "放电总压过高等级2故障阈值" VALUE 0x0000 /* @ECU_Address@BDM_cDiscBattVoltHiLv2Value_F32@ */ Scalar_FLOAT32_IEEE 0 BMS_CM_single -3.4e+38 3.4e+38 /end CHARACTERISTIC
/begin CHARACTERISTIC BDM_cDiscBattVoltHiLv3En_U8 "放电总压过高等级3故障诊断使能" VALUE 0x0000 /* @ECU_Address@BDM_cDiscBattVoltHiLv3En_U8@ */ Scalar_UBYTE 0 BMS_CM_uint8 0 255 /end CHARACTERISTIC
/begin CHARACTERISTIC BDM_cDiscBattVoltHiLv3HealEn_U8 "放电总压过高等级3故障恢复使能" VALUE 0x0000 /* @ECU_Address@BDM_cDiscBattVoltHiLv3HealEn_U8@ */ Scalar_UBYTE 0 BMS_CM_uint8 0 255 /end CHARACTERISTIC
/begin CHARACTERISTIC BDM_cDiscBattVoltHiLv3HealTiDeb_U16 "放电总压过高等级3故障恢复时间" VALUE 0x0000 /* @ECU_Address@BDM_cDiscBattVoltHiLv3HealTiDeb_U16@ */ Scalar_UWORD 0 BMS_CM_uint16 0 65535 /end CHARACTERISTIC
/begin CHARACTERISTIC BDM_cDiscBattVoltHiLv3HealValue_F32 "放电总压过高等级3恢复阈值" VALUE 0x0000 /* @ECU_Address@BDM_cDiscBattVoltHiLv3HealValue_F32@ */ Scalar_FLOAT32_IEEE 0 BMS_CM_single -3.4e+38 3.4e+38 /end CHARACTERISTIC
/begin CHARACTERISTIC BDM_cDiscBattVoltHiLv3InitTiDeb_U16 "放电总压过高3故障初始化成熟时间" VALUE 0x0000 /* @ECU_Address@BDM_cDiscBattVoltHiLv3InitTiDeb_U16@ */ Scalar_UWORD 0 BMS_CM_uint16 0 65535 /end CHARACTERISTIC
/begin CHARACTERISTIC BDM_cDiscBattVoltHiLv3TiDeb_U16 "放电总压过高等级3故障成熟时间" VALUE 0x0000 /* @ECU_Address@BDM_cDiscBattVoltHiLv3TiDeb_U16@ */ Scalar_UWORD 0 BMS_CM_uint16 0 65535 /end CHARACTERISTIC
/begin CHARACTERISTIC BDM_cDiscBattVoltHiLv3Value_F32 "放电总压过高等级3故障阈值" VALUE 0x0000 /* @ECU_Address@BDM_cDiscBattVoltHiLv3Value_F32@ */ Scalar_FLOAT32_IEEE 0 BMS_CM_single -3.4e+38 3.4e+38 /end CHARACTERISTIC
/begin CHARACTERISTIC BDM_cDiscCellTempHiLv1En_U8 "单体放电温度过高等级1故障诊断使能" VALUE 0x0000 /* @ECU_Address@BDM_cDiscCellTempHiLv1En_U8@ */ Scalar_UBYTE 0 BMS_CM_uint8 0 255 /end CHARACTERISTIC
/begin CHARACTERISTIC BDM_cDiscCellTempHiLv1HealEn_U8 "单体放电温度过高等级1故障恢复使能" VALUE 0x0000 /* @ECU_Address@BDM_cDiscCellTempHiLv1HealEn_U8@ */ Scalar_UBYTE 0 BMS_CM_uint8 0 255 /end CHARACTERISTIC
/begin CHARACTERISTIC BDM_cDiscCellTempHiLv1HealTiDeb_U16 "单体放电温度过高等级1故障恢复时间" VALUE 0x0000 /* @ECU_Address@BDM_cDiscCellTempHiLv1HealTiDeb_U16@ */ Scalar_UWORD 0 BMS_CM_uint16 0 65535 /end CHARACTERISTIC
/begin CHARACTERISTIC BDM_cDiscCellTempHiLv1HealValue_F32 "单体放电温度过高等级1恢复阈值" VALUE 0x0000 /* @ECU_Address@BDM_cDiscCellTempHiLv1HealValue_F32@ */ Scalar_FLOAT32_IEEE 0 BMS_CM_single -3.4e+38 3.4e+38 /end CHARACTERISTIC
/begin CHARACTERISTIC BDM_cDiscCellTempHiLv1InitTiDeb_U16 "单体放电温度过高等级1故障初始化成熟时间" VALUE 0x0000 /* @ECU_Address@BDM_cDiscCellTempHiLv1InitTiDeb_U16@ */ Scalar_UWORD 0 BMS_CM_uint16 0 65535 /end CHARACTERISTIC
/begin CHARACTERISTIC BDM_cDiscCellTempHiLv1TiDeb_U16 "单体放电温度过高等级1故障成熟时间" VALUE 0x0000 /* @ECU_Address@BDM_cDiscCellTempHiLv1TiDeb_U16@ */ Scalar_UWORD 0 BMS_CM_uint16 0 65535 /end CHARACTERISTIC
/begin CHARACTERISTIC BDM_cDiscCellTempHiLv1Value_F32 "单体放电温度过高等级1故障阈值" VALUE 0x0000 /* @ECU_Address@BDM_cDiscCellTempHiLv1Value_F32@ */ Scalar_FLOAT32_IEEE 0 BMS_CM_single -3.4e+38 3.4e+38 /end CHARACTERISTIC
/begin CHARACTERISTIC BDM_cDiscCellTempHiLv2En_U8 "单体放电温度过高等级2故障诊断使能" VALUE 0x0000 /* @ECU_Address@BDM_cDiscCellTempHiLv2En_U8@ */ Scalar_UBYTE 0 BMS_CM_uint8 0 255 /end CHARACTERISTIC
/begin CHARACTERISTIC BDM_cDiscCellTempHiLv2HealEn_U8 "单体放电温度过高等级2故障恢复使能" VALUE 0x0000 /* @ECU_Address@BDM_cDiscCellTempHiLv2HealEn_U8@ */ Scalar_UBYTE 0 BMS_CM_uint8 0 255 /end CHARACTERISTIC
/begin CHARACTERISTIC BDM_cDiscCellTempHiLv2HealTiDeb_U16 "单体放电温度过高等级2故障恢复时间" VALUE 0x0000 /* @ECU_Address@BDM_cDiscCellTempHiLv2HealTiDeb_U16@ */ Scalar_UWORD 0 BMS_CM_uint16 0 65535 /end CHARACTERISTIC
/begin CHARACTERISTIC BDM_cDiscCellTempHiLv2HealValue_F32 "单体放电温度过高等级2恢复阈值" VALUE 0x0000 /* @ECU_Address@BDM_cDiscCellTempHiLv2HealValue_F32@ */ Scalar_FLOAT32_IEEE 0 BMS_CM_single -3.4e+38 3.4e+38 /end CHARACTERISTIC
/begin CHARACTERISTIC BDM_cDiscCellTempHiLv2InitTiDeb_U16 "单体放电温度过高等级2故障初始化成熟时间" VALUE 0x0000 /* @ECU_Address@BDM_cDiscCellTempHiLv2InitTiDeb_U16@ */ Scalar_UWORD 0 BMS_CM_uint16 0 65535 /end CHARACTERISTIC
/begin CHARACTERISTIC BDM_cDiscCellTempHiLv2TiDeb_U16 "单体放电温度过高等级2故障成熟时间" VALUE 0x0000 /* @ECU_Address@BDM_cDiscCellTempHiLv2TiDeb_U16@ */ Scalar_UWORD 0 BMS_CM_uint16 0 65535 /end CHARACTERISTIC
/begin CHARACTERISTIC BDM_cDiscCellTempHiLv2Value_F32 "单体放电温度过高等级2故障阈值" VALUE 0x0000 /* @ECU_Address@BDM_cDiscCellTempHiLv2Value_F32@ */ Scalar_FLOAT32_IEEE 0 BMS_CM_single -3.4e+38 3.4e+38 /end CHARACTERISTIC
/begin CHARACTERISTIC BDM_cDiscCellTempHiLv3En_U8 "单体放电温度过高等级3故障诊断使能" VALUE 0x0000 /* @ECU_Address@BDM_cDiscCellTempHiLv3En_U8@ */ Scalar_UBYTE 0 BMS_CM_uint8 0 255 /end CHARACTERISTIC
/begin CHARACTERISTIC BDM_cDiscCellTempHiLv3HealEn_U8 "单体放电温度过高等级3故障恢复使能" VALUE 0x0000 /* @ECU_Address@BDM_cDiscCellTempHiLv3HealEn_U8@ */ Scalar_UBYTE 0 BMS_CM_uint8 0 255 /end CHARACTERISTIC
/begin COMPU_METHOD BMS_CM_single "Q = V" RAT_FUNC "%8.6" "" COEFFS 0 1 0 0 0 1 /end COMPU_METHOD
/begin COMPU_METHOD BMS_CM_uint32 "Q = V" RAT_FUNC "%10.0" "" COEFFS 0 1 0 0 0 1 /end COMPU_METHOD
/begin COMPU_METHOD BMS_CM_uint16 "Q = V" RAT_FUNC "%5.0" "" COEFFS 0 1 0 0 0 1 /end COMPU_METHOD
/begin COMPU_METHOD BMS_CM_uint8 "Q = V" RAT_FUNC "%3.0" "" COEFFS 0 1 0 0 0 1 /end COMPU_METHOD
/begin GROUP BMS_Calibration "BMS_Calibration" ROOT
 /begin REF_CHARACTERISTIC RCM_cLoadOffCurr OSM_cTiCycOfCtrlUnit_U16 FCM_cMaxAllowUpCurrVaule_F32 OSM_cExtremeLoTemp_F32 OSM_cExtremeHiTemp_F32 cEmerHVOffOutTime CEB_cBatPlatFormAreaMaxSoc_F32 CEB_cBatPlatFormAreaMinSoc_F32 BDM_cBattVoltHiLV4En_U8 BDM_cBattVoltHiLV4HealEn_U8 BDM_cBattVoltHiLV4HealTiDeb_U16 BDM_cBattVoltHiLV4HealValue_F32 BDM_cBattVoltHiLV4InitTiDeb_U16 BDM_cBattVoltHiLV4TiDeb_U16 BDM_cBattVoltHiLV4Value_F32 BDM_cBattVoltHiLv2En_U8 BDM_cBattVoltHiLv2HealEn_U8 BDM_cBattVoltHiLv2HealValue_F32 BDM_cBattVoltHiLv2InitTiDeb_U16 BDM_cBattVoltHiLv2Value_F32 BDM_cBattVoltHiLv3En_U8 BDM_cBattVoltHiLv3HealEn_U8 BDM_cBattVoltHiLv3HealTiDeb_U16 BDM_cBattVoltHiLv3HealValue_F32 BDM_cBattVoltHiLv3InitTiDeb_U16 BDM_cBattVoltHiLv3TiDeb_U16 BDM_cBattVoltHiLv3Value_F32 BDM_cBattVoltLoLv1HealValueTemp1_F32 BDM_cBattVoltLoLv1HealValueTemp2_F32 BDM_cBattVoltLoLv1HealValueTemp3_F32 BDM_cBattVoltLoLv1HealValueTemp4_F32 BDM_cBattVoltLoLv1ValueTemp1_F32 BDM_cBattVoltLoLv1ValueTemp2_F32 BDM_cBattVoltLoLv1ValueTemp3_F32 BDM_cBattVoltLoLv1ValueTemp4_F32 BDM_cBattVoltLoLv2HealValueTemp1_F32 BDM_cBattVoltLoLv2HealValueTemp2_F32 BDM_cBattVoltLoLv2HealValueTemp3_F32 BDM_cBattVoltLoLv2HealValueTemp4_F32 BDM_cBattVoltLoLv2ValueTemp1_F32 BDM_cBattVoltLoLv2ValueTemp2_F32 BDM_cBattVoltLoLv2ValueTemp3_F32 BDM_cBattVoltLoLv2ValueTemp4_F32 BDM_cBattVoltLoLv3HealValueTemp1_F32 BDM_cBattVoltLoLv3HealValueTemp2_F32 BDM_cBattVoltLoLv3HealValueTemp3_F32 BDM_cBattVoltLoLv3HealValueTemp4_F32 BDM_cBattVoltLoLv3ValueTemp1_F32 BDM_cBattVoltLoLv3ValueTemp2_F32 BDM_cBattVoltLoLv3ValueTemp3_F32 BDM_cBattVoltLoLv3ValueTemp4_F32 BDM_cBattVoltLoLv4En_U8 BDM_cBattVoltLoLv4HealEn_U8 BDM_cBattVoltLoLv4HealValueTemp1_F32 BDM_cBattVoltLoLv4HealValueTemp2_F32 BDM_cBattVoltLoLv4HealValueTemp3_F32 BDM_cBattVoltLoLv4HealValueTemp4_F32 BDM_cBattVoltLoLv4InitTiDeb_U16 BDM_cBattVoltLoLv4ValueTemp1_F32 BDM_cBattVoltLoLv4ValueTemp2_F32 BDM_cBattVoltLoLv4ValueTemp3_F32 BDM_cBattVoltLoLv4ValueTemp4_F32 BDM_cCellVoltHiLv4HealTiDeb_U16 BDM_cCellVoltHiLv4TiDeb_U16 BDM_cCellVoltLoLv1HealValueTemp2_F32 BDM_cCellVoltLoLv1HealValueTemp3_F32 BDM_cCellVoltLoLv1HealValueTemp4_F32 BDM_cCellVoltLoLv1ValueTemp1_F32 BDM_cCellVoltLoLv1ValueTemp2_F32 BDM_cCellVoltLoLv1ValueTemp3_F32 BDM_cCellVoltLoLv1ValueTemp4_F32 BDM_cCellVoltLoLv2HealValueTemp1_F32 BDM_cCellVoltLoLv2HealValueTemp2_F32 BDM_cCellVoltLoLv2HealValueTemp3_F32 BDM_cCellVoltLoLv2HealValueTemp4_F32 BDM_cCellVoltLoLv2ValueTemp1_F32 BDM_cCellVoltLoLv2ValueTemp2_F32 BDM_cCellVoltLoLv2ValueTemp3_F32 BDM_cCellVoltLoLv2ValueTemp4_F32 BDM_cCellVoltLoLv3HealValueTemp1_F32 BDM_cCellVoltLoLv3HealValueTemp2_F32 BDM_cCellVoltLoLv3HealValueTemp3_F32 BDM_cCellVoltLoLv3HealValueTemp4_F32 BDM_cCellVoltLoLv3ValueTemp1_F32 BDM_cCellVoltLoLv3ValueTemp2_F32 BDM_cCellVoltLoLv3ValueTemp3_F32 BDM_cCellVoltLoLv3ValueTemp4_F32 BDM_cCellVoltLoLv4HealValueTemp1_F32 BDM_cCellVoltLoLv4HealValueTemp2_F32 BDM_cCellVoltLoLv4HealValueTemp3_F32 BDM_cCellVoltLoLv4HealValueTemp4_F32 BDM_cCellVoltLoLv4ValueTemp1_F32 BDM_cCellVoltLoLv4ValueTemp2_F32 BDM_cCellVoltLoLv4ValueTemp3_F32 BDM_cCellVoltLoLv4ValueTemp4_F32 BDM_cChgCellVoltHiLv2En_U8 BDM_cChgCellVoltHiLv2HealEn_U8 BDM_cChgCellVoltHiLv2HealTiDeb_U16 BDM_cChgCellVoltHiLv2HealValue_F32 BDM_cChgCellVoltHiLv2InitTiDeb_U16 BDM_cChgCellVoltHiLv2TiDeb_U16 BDM_cChgCellVoltHiLv2Value_F32 BDM_cChgCellVoltHiLv3En_U8 BDM_cChgCellVoltHiLv3HealEn_U8 BDM_cChgCellVoltHiLv3HealTiDeb_U16 BDM_cChgCellVoltHiLv3HealValue_F32 BDM_cChgCellVoltHiLv3InitTiDeb_U16 BDM_cChgCellVoltHiLv3TiDeb_U16 BDM_cChgCellVoltHiLv3Value_F32 BDM_cDiscCellVoltHiLv2En_U8 BDM_cDiscCellVoltHiLv2HealEn_U8 BDM_cDiscCellVoltHiLv2HealTiDeb_U16 BDM_cDiscCellVoltHiLv2HealValue_F32 BDM_cDiscCellVoltHiLv2InitTiDeb_U16 BDM_cDiscCellVoltHiLv2TiDeb_U16 BDM_cDiscCellVoltHiLv2Value_F32 BDM_cDiscCellVoltHiLv3En_U8 BDM_cDiscCellVoltHiLv3HealEn_U8 BDM_cDiscCellVoltHiLv3HealTiDeb_U16 BDM_cDiscCellVoltHiLv3HealValue_F32 BDM_cDiscCellVoltHiLv3InitTiDeb_U16 BDM_cDiscCellVoltHiLv3TiDeb_U16 BDM_cDiscCellVoltHiLv3Value_F32 RCC_cBattQuality_F32 RCC_cCalRemainTimeVersion_U8 RCC_cChgCurrChangeRange_F32 RCC_cConstVolChgTime_U32 RCC_cCurConstantQuickJudgeTime_U8 RCC_cDecreaseCurrentSOC_F32 RCC_cPreChgEndSOC_F32 RCC_cPreChgReqCurrent_F32 RCC_cSOCChangeRange_F32 RCC_cSpeHeatCapacity_F32 RCC_cThermalConductivity_F32 CUR_mZerodriftCurThreshold_F32 RCC_cRemainTimeSpeedDecrease_F32 RCC_cRemainTimeSpeedGain_F32 SMC_cEmergencyPowOffTiDeb_U16 SMC_cThermalPowOffTiDeb_U16 HVP_mVoltReasonHighLim_F32 HVP_mVoltReasonLowLim_F32 RLM_cLoadOffCurr TSM_cChgHeatStartMinTemp_U8 TSM_cChgHeatStopMinTemp_U8 TSM_cChgTMSCoolTempHi_U8 TSM_cChgTMSCoolTempLo_U8 TSM_cChgTMSHeatTempHi_U8 TSM_cChgTMSHeatTempLo_U8 TSM_cCirculationStartTemp_U8 TSM_cCirculationStopTemp_U8 TSM_cCoolStartMaxTemp_U8 TSM_cCoolStartMinTemp_U8 TSM_cCoolStopMaxTemp_U8 TSM_cCoolStopMinTemp_U8 TSM_cDiscHeatStartMinTemp_U8 TSM_cDiscHeatStopMinTemp_U8 TSM_cDiscTMSCoolTempHi_U8 TSM_cDiscTMSCoolTempLo_U8 TSM_cDiscTMSHeatTempHi_U8 TSM_cDiscTMSHeatTempLo_U8 TSM_cHeatStartMaxTemp_U8 TSM_cHeatStopMaxTemp_U8 TSM_cStPreHeatStopTemp_U8 FCMGB_cDischgVoltMinReq_F32 BDM_cThermalMagDisChgCurLoLv1TiDeb_U16 RCM_cBattOKVolt RCM_cOpenRlyOKCur RCM_cOpenRlyOKTime RCM_cPreChgTiOutTime RCM_cPreChrgOKRate RCM_cPreChrgOKVolt RCM_cPreChrgOverCur RCM_cRlyClsOKRate RCM_cRlyErrOpenRate RCM_cRlyOpenTime RCM_cRlyOpenWldErrVolt COSP_BattRateVol BCU_AfeNum BCU_Afe_Tote BCU_CAN_CellTNum BCU_CAN_CellVNum BCU_CanNum BCU_CellTNum BCU_CellVNum SOH_tRunTs_C COSP_BattRateCap COSP_BattRateV0l COSP_BattType COSP_CellNum COSP_CellVol COSP_CoolMode COSP_MaxCellVol COSP_MinCellVol COSP_TempNum COSP_CSCNum TRM_cCellVoltChangeSpeed_U16 TRM_cCellVoltMin_U16 TRM_cTempChangeSpeed_F32 TRM_cTempMax_F32 TRM_cConditionA1TiDeb_U16 TRM_cConditionA2TiDeb_U16 TRM_cConditionBTiDeb_U16 TRM_cConditionCTiDeb_U16 TRM_cConditionDTiDeb_U16 TRM_cConditionTimeOut_U16 HVP_mRateTotalV_F32 SOE_tBattRateEnergyRT_C DCOSP_tBatteryType_C SOH_tNCMUpSOC_C SOH_tSOHDownValue_C CEB_cBalanceRatedCurrent_F32 CEB_cBalanceSocMinDiff_F32 CEB_cBattRateCap_F32 CEB_cCellSampDeviation_F32 CEB_cPwmCtrlBalanceMaxTime_F32 CEB_cStaticCalMaxCurrent_F32 CEB_cStaticWaitTempAry_F32 CEB_cVolSOCMaxPlatSlope_F32 CEB_tBalanceContinuousTime_C CHC_cDownDebounceCycle_U8 CHC_cUpDebounceCycle_U8 CHC_mChgCurrMaxReq_F32 CHC_mChgVoltMaxReq_F32 CHC_mDoubleChgCurrMaxReq_F32 CHC_mStationChgCurrMaxReq_F32 CHC_tCurLimitStage1Cycle_C CHC_tCurLimitStage2Cycle_C CHC_tCurLimitStage3Cycle_C CHC_tCurLimitStage4Cycle_C CHC_tDownCompensationEn_C CHC_tDownCompensationPercent_C CHC_tFacFstCurrLv1_C CHC_tFacFstCurrLv2_C CHC_tFacFstCurrLv3_C CHC_tFacFstCurrLv4_C CHC_tFacSlwCurrLv1_C CHC_tFacSlwCurrLv2_C CHC_tFacSlwCurrLv3_C CHC_tFacSlwCurrLv4_C CHC_tMaxChgTemp_C CHC_tMaxCompensation_C CHC_tMinCompensation_C CHC_tTempCompensationLv1Value_C CHC_tTempCompensationLv1_C CHC_tTempCompensationLv2Value_C CHC_tTempCompensationLv2_C CHC_tTempCompensationLv3Value_C CHC_tTempCompensationLv3_C CHC_tUpCompensationEn_C CHC_tUpCompensationPercent_C SOCRC_tKalR_C SOCRC_tKalSOCQ_C SOCRC_tKalUcQ_C SOC_BattType_C SOC_CapUnchangeTempMax_C SOC_CapUnchangeTempMin_C SOC_RealSOCDownSOC_C SOC_RealSOCUpSOC_C SOC_mTempVaryValue_C SOC_tBattRateCap_C SOC_tBeforeEmpCurrentRate_C SOC_tBeforeEmpSOCMarkDown_C SOC_tBeforeEmpSOCMarkUp_C SOC_tBeforeFullCurrentRate_C SOC_tBeforeFullSOCMarkDown_C SOC_tBeforeFullSOCMarkUp_C SOC_tCellVoltHiLim_C SOC_tCellVoltLoLim_C SOC_tChaBeforeFulltime_C SOC_tChrgFullCalVoltLookUp_C SOC_tChrgFullZeroTime_C SOC_tChrgFullZeroVolt_C SOC_tDCchargerMode_C SOC_tDchBeforeEmptime_C SOC_tDchrgEmpZeroVolt_C SOC_tDefaultIniSOC_C SOC_tDefaultIniTemp_C SOC_tFirstPlatDownSOC_C SOC_tFirstPlatUpSOC_C SOC_tFirstSlopeDownSOC_C SOC_tFirstSlopeUpSOC_C SOC_tFollowDownSOC_C SOC_tFollowMaxSpeed_C SOC_tFollowSOCResetTime_C SOC_tFollowUpSOC_C SOC_tNoCalCycleTimes SOC_tReduceStaticTimeCri SOC_tRunTs_C SOC_tSOCBeforeFull_C SOC_tSOCWaitFull_C SOC_tSecondPlatDownSOC_C SOC_tSecondPlatUpSOC_C SOC_tSecondSlopeDownSOC_C SOC_tSecondSlopeUpSOC_C SOC_tStaticCalMaxCurrent_C SOP_tCountclearTime_C SOP_tDecCurLowerRat_C SOP_tDecCurRecoverTime2_C SOP_tDecCurRecoverTime_C SOP_tDecCurTime2_C SOP_tDecCurTime_C SOP_tFacDiscPwrLv1_C SOP_tFacDiscPwrLv2_C SOP_tFacDiscPwrLv3_C SOP_tFacFbPwrLv1_C SOP_tFacFbPwrLv2_C SOP_tFacFbPwrLv3_C SOP_tLowerRat_C SOP_tRatedcapacity_C SOP_tSeveErrLowerRat_C SOP_tUpperRat_C BDM_DCChgCurrHiLv2HealValue_F32 BDM_DCChgCurrHiLv2Value_F32 BDM_DCChgCurrHiLv3HealValue_F32 BDM_DCChgCurrHiLv3Value_F32 BDM_cBDMTiCycle_U16 BDM_cBattVoltHiLv1En_U8 BDM_cBattVoltHiLv1HealEn_U8 BDM_cBattVoltHiLv1HealTiDeb_U16 BDM_cBattVoltHiLv1HealValue_F32 BDM_cBattVoltHiLv1InitTiDeb_U16 BDM_cBattVoltHiLv1TiDeb_U16 BDM_cBattVoltHiLv1Value_F32 BDM_cBattVoltLoLv1En_U8 BDM_cBattVoltLoLv1HealEn_U8 BDM_cBattVoltLoLv1HealTiDeb_U16 BDM_cBattVoltLoLv1InitTiDeb_U16 BDM_cBattVoltLoLv1TiDeb_U16 BDM_cBattVoltLoLv2En_U8 BDM_cBattVoltLoLv2HealEn_U8 BDM_cBattVoltLoLv2HealTiDeb_U16 BDM_cBattVoltLoLv2InitTiDeb_U16 BDM_cBattVoltLoLv2TiDeb_U16 BDM_cBattVoltLoLv3En_U8 BDM_cBattVoltLoLv3HealEn_U8 BDM_cBattVoltLoLv3HealTiDeb_U16 BDM_cBattVoltLoLv3InitTiDeb_U16 BDM_cBattVoltLoLv3TiDeb_U16 BDM_cCC2TempHiLv1En_U8 BDM_cCC2TempHiLv1HealEn_U8 BDM_cCC2TempHiLv1HealTiDeb_U16 BDM_cCC2TempHiLv1HealValue_F32 BDM_cCC2TempHiLv1InitTiDeb_U16 BDM_cCC2TempHiLv1TiDeb_U16 BDM_cCC2TempHiLv1Value_F32 BDM_cCC2TempHiLv2En_U8 BDM_cCC2TempHiLv2HealEn_U8 BDM_cCC2TempHiLv2HealTiDeb_U16 BDM_cCC2TempHiLv2HealValue_F32 BDM_cCC2TempHiLv2InitTiDeb_U16 BDM_cCC2TempHiLv2TiDeb_U16 BDM_cCC2TempHiLv2Value_F32 BDM_cCC2TempHiLv3HealValue_F32 BDM_cCC2TempHiLv3Value_F32 BDM_cCellTempDiffHiLv1En_U8 BDM_cCellTempDiffHiLv1HealEn_U8 BDM_cCellTempDiffHiLv1HealTiDeb_U16 BDM_cCellTempDiffHiLv1HealValue_F32 BDM_cCellTempDiffHiLv1InitTiDeb_U16 BDM_cCellTempDiffHiLv1TiDeb_U16 BDM_cCellTempDiffHiLv1Value_F32 BDM_cCellTempDiffHiLv2En_U8 BDM_cCellTempDiffHiLv2HealEn_U8 BDM_cCellTempDiffHiLv2HealTiDeb_U16 BDM_cCellTempDiffHiLv2HealValue_F32 BDM_cCellTempDiffHiLv2InitTiDeb_U16 BDM_cCellTempDiffHiLv2TiDeb_U16 BDM_cCellTempDiffHiLv2Value_F32 BDM_cCellTempDiffHiLv3En_U8 BDM_cCellTempDiffHiLv3HealEn_U8 BDM_cCellTempDiffHiLv3HealTiDeb_U16 BDM_cCellTempDiffHiLv3HealValue_F32 BDM_cCellTempDiffHiLv3InitTiDeb_U16 BDM_cCellTempDiffHiLv3TiDeb_U16 BDM_cCellTempDiffHiLv3Value_F32 BDM_cCellTempDiffHiLv4En_U8 BDM_cCellTempDiffHiLv4HealEn_U8 BDM_cCellTempDiffHiLv4HealValue_F32 BDM_cCellTempDiffHiLv4InitTiDeb_U16 BDM_cCellTempDiffHiLv4Value_F32 BDM_cCellTempHiLv1En_U8 BDM_cCellTempHiLv1HealEn_U8 BDM_cCellTempHiLv1HealValue_F32 BDM_cCellTempHiLv1InitTiDeb_U16 BDM_cCellTempHiLv1Value_F32 BDM_cCellTempHiLv2En_U8 BDM_cCellTempHiLv2HealEn_U8 BDM_cCellTempHiLv2HealValue_F32 BDM_cCellTempHiLv2InitTiDeb_U16 BDM_cCellTempHiLv2Value_F32 BDM_cCellTempHiLv3En_U8 BDM_cCellTempHiLv3HealEn_U8 BDM_cCellTempHiLv3HealValue_F32 BDM_cCellTempHiLv3InitTiDeb_U16 BDM_cCellTempHiLv3Value_F32 BDM_cCellTempHiLv4En_U8 BDM_cCellTempHiLv4HealEn_U8 BDM_cCellTempHiLv4HealValue_F32 BDM_cCellTempHiLv4InitTiDeb_U16 BDM_cCellTempHiLv4Value_F32 BDM_cCellTempLoLv1En_U8 BDM_cCellTempLoLv1HealEn_U8 BDM_cCellTempLoLv1HealValueDC_F32 BDM_cCellTempLoLv1HealValue_F32 BDM_cCellTempLoLv1InitTiDeb_U16 BDM_cCellTempLoLv1ValueDC_F32 BDM_cCellTempLoLv1Value_F32 BDM_cCellTempLoLv2En_U8 BDM_cCellTempLoLv2HealEn_U8 BDM_cCellTempLoLv2HealValueDC_F32 BDM_cCellTempLoLv2HealValue_F32 BDM_cCellTempLoLv2InitTiDeb_U16 BDM_cCellTempLoLv2ValueDC_F32 BDM_cCellTempLoLv2Value_F32 BDM_cCellTempLoLv3En_U8 BDM_cCellTempLoLv3HealEn_U8 BDM_cCellTempLoLv3HealValueDC_F32 BDM_cCellTempLoLv3HealValue_F32 BDM_cCellTempLoLv3InitTiDeb_U16 BDM_cCellTempLoLv3ValueDC_F32 BDM_cCellTempLoLv3Value_F32 BDM_cCellTempLoLv4En_U8 BDM_cCellTempLoLv4HealEn_U8 BDM_cCellTempLoLv4HealValueDC_F32 BDM_cCellTempLoLv4HealValue_F32 BDM_cCellTempLoLv4InitTiDeb_U16 BDM_cCellTempLoLv4ValueDC_F32 BDM_cCellTempLoLv4Value_F32 BDM_cCellVoltDiffHiLv1En_U8 BDM_cCellVoltDiffHiLv1HealEn_U8 BDM_cCellVoltDiffHiLv1HealTiDeb_U16 BDM_cCellVoltDiffHiLv1HealValueSOC1_U16 BDM_cCellVoltDiffHiLv1HealValueSOC2_U16 BDM_cCellVoltDiffHiLv1HealValueSOC3_U16 BDM_cCellVoltDiffHiLv1HealValue_U16 BDM_cCellVoltDiffHiLv1InitTiDeb_U16 BDM_cCellVoltDiffHiLv1TiDeb_U16 BDM_cCellVoltDiffHiLv1ValueSOC1_U16 BDM_cCellVoltDiffHiLv1ValueSOC2_U16 BDM_cCellVoltDiffHiLv1ValueSOC3_U16 BDM_cCellVoltDiffHiLv1Value_U16 BDM_cCellVoltDiffHiLv2En_U8 BDM_cCellVoltDiffHiLv2HealEn_U8 BDM_cCellVoltDiffHiLv2HealTiDeb_U16 BDM_cCellVoltDiffHiLv2HealValueSOC1_U16 BDM_cCellVoltDiffHiLv2HealValueSOC2_U16 BDM_cCellVoltDiffHiLv2HealValueSOC3_U16 BDM_cCellVoltDiffHiLv2HealValue_U16 BDM_cCellVoltDiffHiLv2InitTiDeb_U16 BDM_cCellVoltDiffHiLv2TiDeb_U16 BDM_cCellVoltDiffHiLv2ValueSOC1_U16 BDM_cCellVoltDiffHiLv2ValueSOC2_U16 BDM_cCellVoltDiffHiLv2ValueSOC3_U16 BDM_cCellVoltDiffHiLv2Value_U16 BDM_cCellVoltDiffHiLv3En_U8 BDM_cCellVoltDiffHiLv3HealEn_U8 BDM_cCellVoltDiffHiLv3HealTiDeb_U16 BDM_cCellVoltDiffHiLv3HealValueSOC1_U16 BDM_cCellVoltDiffHiLv3HealValueSOC2_U16 BDM_cCellVoltDiffHiLv3HealValueSOC3_U16 BDM_cCellVoltDiffHiLv3InitTiDeb_U16 BDM_cCellVoltDiffHiLv3TiDeb_U16 BDM_cCellVoltDiffHiLv3ValueSOC1_U16 BDM_cCellVoltDiffHiLv3ValueSOC2_U16 BDM_cCellVoltDiffHiLv3ValueSOC3_U16 BDM_cCellVoltDiffHiLv4En_U8 BDM_cCellVoltDiffHiLv4HealEn_U8 BDM_cCellVoltDiffHiLv4HealTiDeb_U16 BDM_cCellVoltDiffHiLv4HealValueSOC1_U16 BDM_cCellVoltDiffHiLv4HealValueSOC2_U16 BDM_cCellVoltDiffHiLv4HealValueSOC3_U16 BDM_cCellVoltDiffHiLv4InitTiDeb_U16 BDM_cCellVoltDiffHiLv4TiDeb_U16 BDM_cCellVoltDiffHiLv4ValueSOC1_U16 BDM_cCellVoltDiffHiLv4ValueSOC2_U16 BDM_cCellVoltDiffHiLv4ValueSOC3_U16 BDM_cCellVoltHiLv1En_U8 BDM_cCellVoltHiLv1HealEn_U8 BDM_cCellVoltHiLv1HealValue_U16 BDM_cCellVoltHiLv1InitTiDeb_U16 BDM_cCellVoltHiLv1Value_U16 BDM_cCellVoltHiLv2En_U8 BDM_cCellVoltHiLv2HealEn_U8 BDM_cCellVoltHiLv2HealValue_U16 BDM_cCellVoltHiLv2InitTiDeb_U16 BDM_cCellVoltHiLv2Value_U16 BDM_cCellVoltHiLv3En_U8 BDM_cCellVoltHiLv3HealEn_U8 BDM_cCellVoltHiLv3HealValue_U16 BDM_cCellVoltHiLv3InitTiDeb_U16 BDM_cCellVoltHiLv3Value_U16 BDM_cCellVoltHiLv4En_U8 BDM_cCellVoltHiLv4HealEn_U8 BDM_cCellVoltHiLv4HealValue_U16 BDM_cCellVoltHiLv4InitTiDeb_U16 BDM_cCellVoltHiLv4Value_U16 BDM_cCellVoltLoLv1En_U8 BDM_cCellVoltLoLv1HealEn_U8 BDM_cCellVoltLoLv1HealTiDeb_U16 BDM_cCellVoltLoLv1InitTiDeb_U16 BDM_cCellVoltLoLv1TiDeb_U16 BDM_cCellVoltLoLv2En_U8 BDM_cCellVoltLoLv2HealEn_U8 BDM_cCellVoltLoLv2HealTiDeb_U16 BDM_cCellVoltLoLv2InitTiDeb_U16 BDM_cCellVoltLoLv2TiDeb_U16 BDM_cCellVoltLoLv3En_U8 BDM_cCellVoltLoLv3HealEn_U8 BDM_cCellVoltLoLv3HealTiDeb_U16 BDM_cCellVoltLoLv3InitTiDeb_U16 BDM_cCellVoltLoLv3TiDeb_U16 BDM_cCellVoltLoLv4En_U8 BDM_cCellVoltLoLv4HealEn_U8 BDM_cCellVoltLoLv4HealTiDeb_U16 BDM_cCellVoltLoLv4HealValueTemp1_U16 BDM_cCellVoltLoLv4HealValueTemp2_U16 BDM_cCellVoltLoLv4HealValueTemp3_U16 BDM_cCellVoltLoLv4HealValueTemp4_U16 BDM_cCellVoltLoLv4InitTiDeb_U16 BDM_cCellVoltLoLv4TiDeb_U16 BDM_cCellVoltLoLv4ValueTemp1_U16 BDM_cCellVoltLoLv4ValueTemp2_U16 BDM_cCellVoltOverLoLv1En_U8 BDM_cCellVoltOverLoLv1HealEn_U8 BDM_cCellVoltOverLoLv1HealTiDeb_U16 BDM_cCellVoltOverLoLv1InitTiDeb_U16 BDM_cCellVoltOverLoLv1TiDeb_U16 BDM_cChgBattVoltHiLv2En_U8 BDM_cChgBattVoltHiLv2HealEn_U8 BDM_cChgBattVoltHiLv2HealTiDeb_U16 BDM_cChgBattVoltHiLv2HealValue_F32 BDM_cChgBattVoltHiLv2InitTiDeb_U16 BDM_cChgBattVoltHiLv2TiDeb_U16 BDM_cChgBattVoltHiLv2Value_F32 BDM_cChgBattVoltHiLv3En_U8 BDM_cChgBattVoltHiLv3HealEn_U8 BDM_cChgBattVoltHiLv3HealTiDeb_U16 BDM_cChgBattVoltHiLv3HealValue_F32 BDM_cChgBattVoltHiLv3InitTiDeb_U16 BDM_cChgBattVoltHiLv3TiDeb_U16 BDM_cChgBattVoltHiLv3Value_F32 BDM_cChgCellTempHiLv3En_U8 BDM_cChgCellTempHiLv3HealEn_U8 BDM_cChgCellTempHiLv3HealTiDeb_U16 BDM_cChgCellTempHiLv3HealValue_F32 BDM_cChgCellTempHiLv3InitTiDeb_U16 BDM_cChgCellTempHiLv3TiDeb_U16 BDM_cChgCellTempHiLv3Value_F32 BDM_cChgCellTempLoLv1HealTiDeb_U16 BDM_cChgCellTempLoLv1TiDeb_U16 BDM_cChgCellTempLoLv2En_U8 BDM_cChgCellTempLoLv2HealEn_U8 BDM_cChgCellTempLoLv2HealTiDeb_U16 BDM_cChgCellTempLoLv2HealValue_F32 BDM_cChgCellTempLoLv2InitTiDeb_U16 BDM_cChgCellTempLoLv2TiDeb_U16 BDM_cChgCellTempLoLv2Value_F32 BDM_cChgCurrAbnormErrEn_U8 BDM_cChgCurrAbnormErrHealEn_U8 BDM_cChgCurrAbnormErrHealTiDeb_U16 BDM_cChgCurrAbnormErrInitTiDeb_U16 BDM_cChgCurrAbnormErrTiDeb_U16 BDM_cChgDiscCurrHiLv1En_U8 BDM_cChgDiscCurrHiLv1HealEn_U8 BDM_cChgDiscCurrHiLv1HealTiDeb_U16 BDM_cChgDiscCurrHiLv1InitTiDeb_U16 BDM_cChgDiscCurrHiLv1TiDeb_U16 BDM_cChgIResLoLv3En_U8 BDM_cChgIResLoLv3HealEn_U8 BDM_cChgIResLoLv3HealTiDeb_U16 BDM_cChgIResLoLv3HealValue_F32 BDM_cChgIResLoLv3InitTiDeb_U16 BDM_cChgIResLoLv3TiDeb_U16 BDM_cChgIResLoLv3Value_F32 BDM_cDCChgCurrHiLv1En_U8 BDM_cDCChgCurrHiLv1HealEn_U8 BDM_cDCChgCurrHiLv1HealTiDeb_U16 BDM_cDCChgCurrHiLv1InitTiDeb_U16 BDM_cDCChgCurrHiLv1TiDeb_U16 BDM_cDCChgCurrHiLv2En_U8 BDM_cDCChgCurrHiLv2HealEn_U8 BDM_cDCChgCurrHiLv2HealTiDeb_U16 BDM_cDCChgCurrHiLv2InitTiDeb_U16 BDM_cDCChgCurrHiLv2TiDeb_U16 BDM_cDCChgCurrHiLv3En_U8 BDM_cDCChgCurrHiLv3HealEn_U8 BDM_cDCChgCurrHiLv3HealTiDeb_U16 BDM_cDCChgCurrHiLv3InitTiDeb_U16 BDM_cDCChgCurrHiLv3TiDeb_U16 BDM_cDCChgCurrHiLv4En_U8 BDM_cDCChgCurrHiLv4HealEn_U8 BDM_cDCChgCurrHiLv4HealTiDeb_U16 BDM_cDCChgCurrHiLv4InitTiDeb_U16 BDM_cDCChgCurrHiLv4TiDeb_U16 BDM_cDiscBattVoltHiLv2En_U8 BDM_cDiscBattVoltHiLv2HealEn_U8 BDM_cDiscBattVoltHiLv2HealTiDeb_U16 BDM_cDiscBattVoltHiLv2HealValue_F32 BDM_cDiscBattVoltHiLv2InitTiDeb_U16 BDM_cDiscBattVoltHiLv2TiDeb_U16 BDM_cDiscBattVoltHiLv2Value_F32 BDM_cDiscBattVoltHiLv3En_U8 BDM_cDiscBattVoltHiLv3HealEn_U8 BDM_cDiscBattVoltHiLv3HealTiDeb_U16 BDM_cDiscBattVoltHiLv3HealValue_F32 BDM_cDiscBattVoltHiLv3InitTiDeb_U16 BDM_cDiscBattVoltHiLv3TiDeb_U16 BDM_cDiscBattVoltHiLv3Value_F32 BDM_cDiscCellTempHiLv1En_U8 BDM_cDiscCellTempHiLv1HealEn_U8 BDM_cDiscCellTempHiLv1HealTiDeb_U16 BDM_cDiscCellTempHiLv1HealValue_F32 BDM_cDiscCellTempHiLv1InitTiDeb_U16 BDM_cDiscCellTempHiLv1TiDeb_U16 BDM_cDiscCellTempHiLv1Value_F32 BDM_cDiscCellTempHiLv2En_U8 BDM_cDiscCellTempHiLv2HealEn_U8 BDM_cDiscCellTempHiLv2HealTiDeb_U16 BDM_cDiscCellTempHiLv2HealValue_F32 BDM_cDiscCellTempHiLv2InitTiDeb_U16 BDM_cDiscCellTempHiLv2TiDeb_U16 BDM_cDiscCellTempHiLv2Value_F32 BDM_cDiscCellTempHiLv3En_U8 BDM_cDiscCellTempHiLv3HealEn_U8 /end REF_CHARACTERISTIC
/end GROUP
/end MODULE
/end PROJECT
