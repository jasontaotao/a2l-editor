ASAP2_VERSION 1 61
/begin PROJECT ProjectName "Project Comment Goes Here"
/begin HEADER "Header Comments go here" /end HEADER
/begin MODULE ModuleName "Module Comment Goes Here"
/begin MOD_COMMON "Mod Common Comment Here" BYTE_ORDER MSB_LAST /end MOD_COMMON
/begin RECORD_LAYOUT Scalar_BOOLEAN FNC_VALUES 1 UBYTE COLUMN_DIR DIRECT /end RECORD_LAYOUT
/begin RECORD_LAYOUT Scalar_UBYTE FNC_VALUES 1 UBYTE COLUMN_DIR DIRECT /end RECORD_LAYOUT
/begin RECORD_LAYOUT Scalar_BYTE FNC_VALUES 1 SBYTE COLUMN_DIR DIRECT /end RECORD_LAYOUT
/begin RECORD_LAYOUT Scalar_UWORD FNC_VALUES 1 UWORD COLUMN_DIR DIRECT /end RECORD_LAYOUT
/begin RECORD_LAYOUT Scalar_SWORD FNC_VALUES 1 SWORD COLUMN_DIR DIRECT /end RECORD_LAYOUT
/begin RECORD_LAYOUT Scalar_ULONG FNC_VALUES 1 ULONG COLUMN_DIR DIRECT /end RECORD_LAYOUT
/begin RECORD_LAYOUT Scalar_LONG FNC_VALUES 1 SLONG COLUMN_DIR DIRECT /end RECORD_LAYOUT
/begin RECORD_LAYOUT Scalar_FLOAT32_IEEE FNC_VALUES 1 FLOAT32_IEEE COLUMN_DIR DIRECT /end RECORD_LAYOUT
/begin RECORD_LAYOUT Scalar_FLOAT64_IEEE FNC_VALUES 1 FLOAT64_IEEE COLUMN_DIR DIRECT /end RECORD_LAYOUT
/begin RECORD_LAYOUT Lookup1D_BOOLEAN FNC_VALUES 1 UBYTE COLUMN_DIR DIRECT /end RECORD_LAYOUT
/begin RECORD_LAYOUT Lookup1D_X_BOOLEAN AXIS_PTS_X 1 UBYTE INDEX_INCR DIRECT /end RECORD_LAYOUT
/begin RECORD_LAYOUT Lookup1D_BYTE FNC_VALUES 1 SBYTE COLUMN_DIR DIRECT /end RECORD_LAYOUT
/begin RECORD_LAYOUT Lookup1D_X_BYTE AXIS_PTS_X 1 SBYTE INDEX_INCR DIRECT /end RECORD_LAYOUT
/begin RECORD_LAYOUT Lookup1D_UBYTE FNC_VALUES 1 UBYTE COLUMN_DIR DIRECT /end RECORD_LAYOUT
/begin RECORD_LAYOUT Lookup1D_X_UBYTE AXIS_PTS_X 1 UBYTE INDEX_INCR DIRECT /end RECORD_LAYOUT
/begin RECORD_LAYOUT Lookup1D_UWORD FNC_VALUES 1 UWORD COLUMN_DIR DIRECT /end RECORD_LAYOUT
/begin RECORD_LAYOUT Lookup1D_X_UWORD AXIS_PTS_X 1 UWORD INDEX_INCR DIRECT /end RECORD_LAYOUT
/begin RECORD_LAYOUT Lookup1D_WORD FNC_VALUES 1 SWORD COLUMN_DIR DIRECT /end RECORD_LAYOUT
/begin RECORD_LAYOUT Lookup1D_X_WORD AXIS_PTS_X 1 SWORD INDEX_INCR DIRECT /end RECORD_LAYOUT
/begin RECORD_LAYOUT Lookup1D_ULONG FNC_VALUES 1 ULONG COLUMN_DIR DIRECT /end RECORD_LAYOUT
/begin RECORD_LAYOUT Lookup1D_X_ULONG AXIS_PTS_X 1 ULONG INDEX_INCR DIRECT /end RECORD_LAYOUT
/begin RECORD_LAYOUT Lookup1D_SLONG FNC_VALUES 1 SLONG COLUMN_DIR DIRECT /end RECORD_LAYOUT
/begin RECORD_LAYOUT Lookup1D_X_LONG AXIS_PTS_X 1 SLONG INDEX_INCR DIRECT /end RECORD_LAYOUT
/begin RECORD_LAYOUT Lookup1D_FLOAT32_IEEE FNC_VALUES 1 FLOAT32_IEEE COLUMN_DIR DIRECT /end RECORD_LAYOUT
/begin RECORD_LAYOUT Lookup1D_X_FLOAT32_IEEE AXIS_PTS_X 1 FLOAT32_IEEE INDEX_INCR DIRECT /end RECORD_LAYOUT
/begin RECORD_LAYOUT Lookup1D_FLOAT64_IEEE FNC_VALUES 1 FLOAT64_IEEE COLUMN_DIR DIRECT /end RECORD_LAYOUT
/begin RECORD_LAYOUT Lookup1D_X_FLOAT64_IEEE AXIS_PTS_X 1 FLOAT64_IEEE INDEX_INCR DIRECT /end RECORD_LAYOUT
/begin RECORD_LAYOUT Lookup2D_BOOLEAN FNC_VALUES 1 UBYTE COLUMN_DIR DIRECT /end RECORD_LAYOUT
/begin RECORD_LAYOUT Lookup2D_X_BOOLEAN AXIS_PTS_X 1 UBYTE INDEX_INCR DIRECT /end RECORD_LAYOUT
/begin RECORD_LAYOUT Lookup2D_UBYTE FNC_VALUES 1 UBYTE COLUMN_DIR DIRECT /end RECORD_LAYOUT
/begin RECORD_LAYOUT Lookup2D_X_UBYTE AXIS_PTS_X 1 UBYTE INDEX_INCR DIRECT /end RECORD_LAYOUT
/begin RECORD_LAYOUT Lookup2D_BYTE FNC_VALUES 1 SBYTE COLUMN_DIR DIRECT /end RECORD_LAYOUT
/begin RECORD_LAYOUT Lookup2D_X_BYTE AXIS_PTS_X 1 SBYTE INDEX_INCR DIRECT /end RECORD_LAYOUT
/begin RECORD_LAYOUT Lookup2D_UWORD FNC_VALUES 1 UWORD COLUMN_DIR DIRECT /end RECORD_LAYOUT
/begin RECORD_LAYOUT Lookup2D_X_UWORD AXIS_PTS_X 1 UWORD INDEX_INCR DIRECT /end RECORD_LAYOUT
/begin RECORD_LAYOUT Lookup2D_WORD FNC_VALUES 1 SWORD COLUMN_DIR DIRECT /end RECORD_LAYOUT
/begin RECORD_LAYOUT Lookup2D_X_WORD AXIS_PTS_X 1 SWORD INDEX_INCR DIRECT /end RECORD_LAYOUT
/begin RECORD_LAYOUT Lookup2D_ULONG FNC_VALUES 1 ULONG COLUMN_DIR DIRECT /end RECORD_LAYOUT
/begin RECORD_LAYOUT Lookup2D_X_ULONG AXIS_PTS_X 1 ULONG INDEX_INCR DIRECT /end RECORD_LAYOUT
/begin RECORD_LAYOUT Lookup2D_LONG FNC_VALUES 1 SLONG COLUMN_DIR DIRECT /end RECORD_LAYOUT
/begin RECORD_LAYOUT Lookup2D_X_LONG AXIS_PTS_X 1 SLONG INDEX_INCR DIRECT /end RECORD_LAYOUT
/begin RECORD_LAYOUT Lookup2D_FLOAT32_IEEE FNC_VALUES 1 FLOAT32_IEEE COLUMN_DIR DIRECT /end RECORD_LAYOUT
/begin RECORD_LAYOUT Lookup2D_X_FLOAT32_IEEE AXIS_PTS_X 1 FLOAT32_IEEE INDEX_INCR DIRECT /end RECORD_LAYOUT
/begin RECORD_LAYOUT Lookup2D_FLOAT64_IEEE FNC_VALUES 1 FLOAT64_IEEE COLUMN_DIR DIRECT /end RECORD_LAYOUT
/begin RECORD_LAYOUT Lookup2D_X_FLOAT64_IEEE AXIS_PTS_X 1 FLOAT64_IEEE INDEX_INCR DIRECT /end RECORD_LAYOUT
/begin CHARACTERISTIC BDM_cDiscCellTempHiLv3HealTiDeb_U16 "单体放电温度过高等级3故障恢复时间" VALUE 0x0000 /* @ECU_Address@BDM_cDiscCellTempHiLv3HealTiDeb_U16@ */ Scalar_UWORD 0 BMS_CM_uint16 0 65535 /end CHARACTERISTIC
/begin CHARACTERISTIC BDM_cDiscCellTempHiLv3HealValue_F32 "单体放电温度过高等级3恢复阈值" VALUE 0x0000 /* @ECU_Address@BDM_cDiscCellTempHiLv3HealValue_F32@ */ Scalar_FLOAT32_IEEE 0 BMS_CM_single -3.4e+38 3.4e+38 /end CHARACTERISTIC
/begin CHARACTERISTIC BDM_cDiscCellTempHiLv3InitTiDeb_U16 "单体放电温度过高等级3故障初始化成熟时间" VALUE 0x0000 /* @ECU_Address@BDM_cDiscCellTempHiLv3InitTiDeb_U16@ */ Scalar_UWORD 0 BMS_CM_uint16 0 65535 /end CHARACTERISTIC
/begin CHARACTERISTIC BDM_cDiscCellTempHiLv3TiDeb_U16 "单体放电温度过高等级3故障成熟时间" VALUE 0x0000 /* @ECU_Address@BDM_cDiscCellTempHiLv3TiDeb_U16@ */ Scalar_UWORD 0 BMS_CM_uint16 0 65535 /end CHARACTERISTIC
/begin CHARACTERISTIC BDM_cDiscCellTempHiLv3Value_F32 "单体放电温度过高等级3故障阈值" VALUE 0x0000 /* @ECU_Address@BDM_cDiscCellTempHiLv3Value_F32@ */ Scalar_FLOAT32_IEEE 0 BMS_CM_single -3.4e+38 3.4e+38 /end CHARACTERISTIC
/begin CHARACTERISTIC BDM_cDiscCellTempHiLv4En_U8 "单体放电温度过高等级4故障诊断使能" VALUE 0x0000 /* @ECU_Address@BDM_cDiscCellTempHiLv4En_U8@ */ Scalar_UBYTE 0 BMS_CM_uint8 0 255 /end CHARACTERISTIC
/begin CHARACTERISTIC BDM_cDiscCellTempHiLv4HealEn_U8 "单体放电温度过高等级4故障恢复使能" VALUE 0x0000 /* @ECU_Address@BDM_cDiscCellTempHiLv4HealEn_U8@ */ Scalar_UBYTE 0 BMS_CM_uint8 0 255 /end CHARACTERISTIC
/begin CHARACTERISTIC BDM_cDiscCellTempHiLv4HealTiDeb_U16 "单体放电温度过高等级4故障恢复时间" VALUE 0x0000 /* @ECU_Address@BDM_cDiscCellTempHiLv4HealTiDeb_U16@ */ Scalar_UWORD 0 BMS_CM_uint16 0 65535 /end CHARACTERISTIC
/begin CHARACTERISTIC BDM_cDiscCellTempHiLv4HealValue_F32 "单体放电温度过高等级4恢复阈值" VALUE 0x0000 /* @ECU_Address@BDM_cDiscCellTempHiLv4HealValue_F32@ */ Scalar_FLOAT32_IEEE 0 BMS_CM_single -3.4e+38 3.4e+38 /end CHARACTERISTIC
/begin CHARACTERISTIC BDM_cDiscCellTempHiLv4InitTiDeb_U16 "单体放电温度过高等级4故障初始化成熟时间" VALUE 0x0000 /* @ECU_Address@BDM_cDiscCellTempHiLv4InitTiDeb_U16@ */ Scalar_UWORD 0 BMS_CM_uint16 0 65535 /end CHARACTERISTIC
/begin CHARACTERISTIC BDM_cDiscCellTempHiLv4TiDeb_U16 "单体放电温度过高等级4故障成熟时间" VALUE 0x0000 /* @ECU_Address@BDM_cDiscCellTempHiLv4TiDeb_U16@ */ Scalar_UWORD 0 BMS_CM_uint16 0 65535 /end CHARACTERISTIC
/begin CHARACTERISTIC BDM_cDiscCellTempHiLv4Value_F32 "单体放电温度过高等级4故障阈值" VALUE 0x0000 /* @ECU_Address@BDM_cDiscCellTempHiLv4Value_F32@ */ Scalar_FLOAT32_IEEE 0 BMS_CM_single -3.4e+38 3.4e+38 /end CHARACTERISTIC
/begin CHARACTERISTIC BDM_cDiscCellTempLoLv1HealTiDeb_U16 "单体放电温度过低等级1故障恢复时间" VALUE 0x0000 /* @ECU_Address@BDM_cDiscCellTempLoLv1HealTiDeb_U16@ */ Scalar_UWORD 0 BMS_CM_uint16 0 65535 /end CHARACTERISTIC
/begin CHARACTERISTIC BDM_cDiscCellTempLoLv1TiDeb_U16 "单体放电温度过低等级1故障成熟时间" VALUE 0x0000 /* @ECU_Address@BDM_cDiscCellTempLoLv1TiDeb_U16@ */ Scalar_UWORD 0 BMS_CM_uint16 0 65535 /end CHARACTERISTIC
/begin CHARACTERISTIC BDM_cDiscCellTempLoLv3En_U8 "单体放电温度过低等级3故障诊断使能" VALUE 0x0000 /* @ECU_Address@BDM_cDiscCellTempLoLv3En_U8@ */ Scalar_UBYTE 0 BMS_CM_uint8 0 255 /end CHARACTERISTIC
/begin CHARACTERISTIC BDM_cDiscCellTempLoLv3HealEn_U8 "单体放电温度过低等级3故障恢复使能" VALUE 0x0000 /* @ECU_Address@BDM_cDiscCellTempLoLv3HealEn_U8@ */ Scalar_UBYTE 0 BMS_CM_uint8 0 255 /end CHARACTERISTIC
/begin CHARACTERISTIC BDM_cDiscCellTempLoLv3HealTiDeb_U16 "单体放电温度过低等级3故障恢复时间" VALUE 0x0000 /* @ECU_Address@BDM_cDiscCellTempLoLv3HealTiDeb_U16@ */ Scalar_UWORD 0 BMS_CM_uint16 0 65535 /end CHARACTERISTIC
/begin CHARACTERISTIC BDM_cDiscCellTempLoLv3HealValue_F32 "单体放电温度过低等级3恢复阈值" VALUE 0x0000 /* @ECU_Address@BDM_cDiscCellTempLoLv3HealValue_F32@ */ Scalar_FLOAT32_IEEE 0 BMS_CM_single -3.4e+38 3.4e+38 /end CHARACTERISTIC
/begin CHARACTERISTIC BDM_cDiscCellTempLoLv3InitTiDeb_U16 "单体放电温度过低等级3故障初始化成熟时间" VALUE 0x0000 /* @ECU_Address@BDM_cDiscCellTempLoLv3InitTiDeb_U16@ */ Scalar_UWORD 0 BMS_CM_uint16 0 65535 /end CHARACTERISTIC
/begin CHARACTERISTIC BDM_cDiscCellTempLoLv3TiDeb_U16 "单体放电温度过低等级3故障成熟时间" VALUE 0x0000 /* @ECU_Address@BDM_cDiscCellTempLoLv3TiDeb_U16@ */ Scalar_UWORD 0 BMS_CM_uint16 0 65535 /end CHARACTERISTIC
/begin CHARACTERISTIC BDM_cDiscCellTempLoLv3Value_F32 "单体放电温度过低等级3故障阈值" VALUE 0x0000 /* @ECU_Address@BDM_cDiscCellTempLoLv3Value_F32@ */ Scalar_FLOAT32_IEEE 0 BMS_CM_single -3.4e+38 3.4e+38 /end CHARACTERISTIC
/begin CHARACTERISTIC BDM_cDiscCurrHiLv1En_U8 "放电过流等级1故障诊断使能" VALUE 0x0000 /* @ECU_Address@BDM_cDiscCurrHiLv1En_U8@ */ Scalar_UBYTE 0 BMS_CM_uint8 0 255 /end CHARACTERISTIC
/begin CHARACTERISTIC BDM_cDiscCurrHiLv1HealEn_U8 "放电过流等级1故障恢复使能" VALUE 0x0000 /* @ECU_Address@BDM_cDiscCurrHiLv1HealEn_U8@ */ Scalar_UBYTE 0 BMS_CM_uint8 0 255 /end CHARACTERISTIC
/begin CHARACTERISTIC BDM_cDiscCurrHiLv1HealTiDeb_U16 "放电过流等级1故障恢复时间" VALUE 0x0000 /* @ECU_Address@BDM_cDiscCurrHiLv1HealTiDeb_U16@ */ Scalar_UWORD 0 BMS_CM_uint16 0 65535 /end CHARACTERISTIC
/begin CHARACTERISTIC BDM_cDiscCurrHiLv1InitTiDeb_U16 "放电过流等级1故障初始化成熟时间" VALUE 0x0000 /* @ECU_Address@BDM_cDiscCurrHiLv1InitTiDeb_U16@ */ Scalar_UWORD 0 BMS_CM_uint16 0 65535 /end CHARACTERISTIC
/begin CHARACTERISTIC BDM_cDiscCurrHiLv1TiDeb_U16 "放电过流等级1故障成熟时间" VALUE 0x0000 /* @ECU_Address@BDM_cDiscCurrHiLv1TiDeb_U16@ */ Scalar_UWORD 0 BMS_CM_uint16 0 65535 /end CHARACTERISTIC
/begin CHARACTERISTIC BDM_cDiscCurrHiLv2En_U8 "放电过流等级2故障诊断使能" VALUE 0x0000 /* @ECU_Address@BDM_cDiscCurrHiLv2En_U8@ */ Scalar_UBYTE 0 BMS_CM_uint8 0 255 /end CHARACTERISTIC
/begin CHARACTERISTIC BDM_cDiscCurrHiLv2HealEn_U8 "放电过流等级2故障恢复使能" VALUE 0x0000 /* @ECU_Address@BDM_cDiscCurrHiLv2HealEn_U8@ */ Scalar_UBYTE 0 BMS_CM_uint8 0 255 /end CHARACTERISTIC
/begin CHARACTERISTIC BDM_cDiscCurrHiLv2HealTiDeb_U16 "放电过流等级2故障恢复时间" VALUE 0x0000 /* @ECU_Address@BDM_cDiscCurrHiLv2HealTiDeb_U16@ */ Scalar_UWORD 0 BMS_CM_uint16 0 65535 /end CHARACTERISTIC
/begin CHARACTERISTIC BDM_cDiscCurrHiLv2HealValue_F32 "放电电流过大等级2恢复阈值" VALUE 0x0000 /* @ECU_Address@BDM_cDiscCurrHiLv2HealValue_F32@ */ Scalar_FLOAT32_IEEE 0 BMS_CM_single -3.4e+38 3.4e+38 /end CHARACTERISTIC
/begin CHARACTERISTIC BDM_cDiscCurrHiLv2InitTiDeb_U16 "放电过流等级2故障初始化成熟时间" VALUE 0x0000 /* @ECU_Address@BDM_cDiscCurrHiLv2InitTiDeb_U16@ */ Scalar_UWORD 0 BMS_CM_uint16 0 65535 /end CHARACTERISTIC
/begin CHARACTERISTIC BDM_cDiscCurrHiLv2TiDeb_U16 "放电过流等级2故障成熟时间" VALUE 0x0000 /* @ECU_Address@BDM_cDiscCurrHiLv2TiDeb_U16@ */ Scalar_UWORD 0 BMS_CM_uint16 0 65535 /end CHARACTERISTIC
/begin CHARACTERISTIC BDM_cDiscCurrHiLv2Value_F32 "放电电流过大等级2故障阈值" VALUE 0x0000 /* @ECU_Address@BDM_cDiscCurrHiLv2Value_F32@ */ Scalar_FLOAT32_IEEE 0 BMS_CM_single -3.4e+38 3.4e+38 /end CHARACTERISTIC
/begin CHARACTERISTIC BDM_cDiscCurrHiLv3En_U8 "放电过流等级3故障诊断使能" VALUE 0x0000 /* @ECU_Address@BDM_cDiscCurrHiLv3En_U8@ */ Scalar_UBYTE 0 BMS_CM_uint8 0 255 /end CHARACTERISTIC
/begin CHARACTERISTIC BDM_cDiscCurrHiLv3HealEn_U8 "放电过流等级3故障恢复使能" VALUE 0x0000 /* @ECU_Address@BDM_cDiscCurrHiLv3HealEn_U8@ */ Scalar_UBYTE 0 BMS_CM_uint8 0 255 /end CHARACTERISTIC
/begin CHARACTERISTIC BDM_cDiscCurrHiLv3HealTiDeb_U16 "放电过流等级3故障恢复时间" VALUE 0x0000 /* @ECU_Address@BDM_cDiscCurrHiLv3HealTiDeb_U16@ */ Scalar_UWORD 0 BMS_CM_uint16 0 65535 /end CHARACTERISTIC
/begin CHARACTERISTIC BDM_cDiscCurrHiLv3HealValue_F32 "放电电流过大等级3恢复阈值" VALUE 0x0000 /* @ECU_Address@BDM_cDiscCurrHiLv3HealValue_F32@ */ Scalar_FLOAT32_IEEE 0 BMS_CM_single -3.4e+38 3.4e+38 /end CHARACTERISTIC
/begin CHARACTERISTIC BDM_cDiscCurrHiLv3InitTiDeb_U16 "放电过流等级3故障初始化成熟时间" VALUE 0x0000 /* @ECU_Address@BDM_cDiscCurrHiLv3InitTiDeb_U16@ */ Scalar_UWORD 0 BMS_CM_uint16 0 65535 /end CHARACTERISTIC
/begin CHARACTERISTIC BDM_cDiscCurrHiLv3TiDeb_U16 "放电过流等级3故障成熟时间" VALUE 0x0000 /* @ECU_Address@BDM_cDiscCurrHiLv3TiDeb_U16@ */ Scalar_UWORD 0 BMS_CM_uint16 0 65535 /end CHARACTERISTIC
/begin CHARACTERISTIC BDM_cDiscCurrHiLv3Value_F32 "放电电流过大等级3故障阈值" VALUE 0x0000 /* @ECU_Address@BDM_cDiscCurrHiLv3Value_F32@ */ Scalar_FLOAT32_IEEE 0 BMS_CM_single -3.4e+38 3.4e+38 /end CHARACTERISTIC
/begin CHARACTERISTIC BDM_cDiscCurrHiLv4En_U8 "放电过流等级4故障诊断使能" VALUE 0x0000 /* @ECU_Address@BDM_cDiscCurrHiLv4En_U8@ */ Scalar_UBYTE 0 BMS_CM_uint8 0 255 /end CHARACTERISTIC
/begin CHARACTERISTIC BDM_cDiscCurrHiLv4HealEn_U8 "放电过流等级4故障恢复使能" VALUE 0x0000 /* @ECU_Address@BDM_cDiscCurrHiLv4HealEn_U8@ */ Scalar_UBYTE 0 BMS_CM_uint8 0 255 /end CHARACTERISTIC
/begin CHARACTERISTIC BDM_cDiscCurrHiLv4HealTiDeb_U16 "放电过流等级4故障恢复时间" VALUE 0x0000 /* @ECU_Address@BDM_cDiscCurrHiLv4HealTiDeb_U16@ */ Scalar_UWORD 0 BMS_CM_uint16 0 65535 /end CHARACTERISTIC
/begin CHARACTERISTIC BDM_cDiscCurrHiLv4InitTiDeb_U16 "放电过流等级4故障初始化成熟时间" VALUE 0x0000 /* @ECU_Address@BDM_cDiscCurrHiLv4InitTiDeb_U16@ */ Scalar_UWORD 0 BMS_CM_uint16 0 65535 /end CHARACTERISTIC
/begin CHARACTERISTIC BDM_cDiscCurrHiLv4TiDeb_U16 "放电过流等级4故障成熟时间" VALUE 0x0000 /* @ECU_Address@BDM_cDiscCurrHiLv4TiDeb_U16@ */ Scalar_UWORD 0 BMS_CM_uint16 0 65535 /end CHARACTERISTIC
/begin CHARACTERISTIC BDM_cFBPowHiLv1En_U8 "回馈功率不可控等级1故障诊断使能" VALUE 0x0000 /* @ECU_Address@BDM_cFBPowHiLv1En_U8@ */ Scalar_UBYTE 0 BMS_CM_uint8 0 255 /end CHARACTERISTIC
/begin CHARACTERISTIC BDM_cFBPowHiLv1HealEn_U8 "回馈功率不可控等级1故障恢复使能" VALUE 0x0000 /* @ECU_Address@BDM_cFBPowHiLv1HealEn_U8@ */ Scalar_UBYTE 0 BMS_CM_uint8 0 255 /end CHARACTERISTIC
/begin CHARACTERISTIC BDM_cFBPowHiLv1HealTiDeb_U16 "回馈功率不可控等级1故障恢复时间" VALUE 0x0000 /* @ECU_Address@BDM_cFBPowHiLv1HealTiDeb_U16@ */ Scalar_UWORD 0 BMS_CM_uint16 0 65535 /end CHARACTERISTIC
/begin CHARACTERISTIC BDM_cFBPowHiLv1InitTiDeb_U16 "回馈功率不可控等级1故障初始化成熟时间" VALUE 0x0000 /* @ECU_Address@BDM_cFBPowHiLv1InitTiDeb_U16@ */ Scalar_UWORD 0 BMS_CM_uint16 0 65535 /end CHARACTERISTIC
/begin CHARACTERISTIC BDM_cFBPowHiLv1TiDeb_U16 "回馈功率不可控等级1故障成熟时间" VALUE 0x0000 /* @ECU_Address@BDM_cFBPowHiLv1TiDeb_U16@ */ Scalar_UWORD 0 BMS_CM_uint16 0 65535 /end CHARACTERISTIC
/begin CHARACTERISTIC BDM_cFBPowHiLv2En_U8 "回馈功率不可控等级2故障诊断使能" VALUE 0x0000 /* @ECU_Address@BDM_cFBPowHiLv2En_U8@ */ Scalar_UBYTE 0 BMS_CM_uint8 0 255 /end CHARACTERISTIC
/begin CHARACTERISTIC BDM_cFBPowHiLv2HealEn_U8 "回馈功率不可控等级2故障恢复使能" VALUE 0x0000 /* @ECU_Address@BDM_cFBPowHiLv2HealEn_U8@ */ Scalar_UBYTE 0 BMS_CM_uint8 0 255 /end CHARACTERISTIC
/begin CHARACTERISTIC BDM_cFBPowHiLv2HealTiDeb_U16 "回馈功率不可控等级2故障恢复时间" VALUE 0x0000 /* @ECU_Address@BDM_cFBPowHiLv2HealTiDeb_U16@ */ Scalar_UWORD 0 BMS_CM_uint16 0 65535 /end CHARACTERISTIC
/begin CHARACTERISTIC BDM_cFBPowHiLv2HealValue_F32 "回馈功率不可控等级2恢复阈值" VALUE 0x0000 /* @ECU_Address@BDM_cFBPowHiLv2HealValue_F32@ */ Scalar_FLOAT32_IEEE 0 BMS_CM_single -3.4e+38 3.4e+38 /end CHARACTERISTIC
/begin CHARACTERISTIC BDM_cFBPowHiLv2InitTiDeb_U16 "回馈功率不可控等级2故障初始化成熟时间" VALUE 0x0000 /* @ECU_Address@BDM_cFBPowHiLv2InitTiDeb_U16@ */ Scalar_UWORD 0 BMS_CM_uint16 0 65535 /end CHARACTERISTIC
/begin CHARACTERISTIC BDM_cFBPowHiLv2TiDeb_U16 "回馈功率不可控等级2故障成熟时间" VALUE 0x0000 /* @ECU_Address@BDM_cFBPowHiLv2TiDeb_U16@ */ Scalar_UWORD 0 BMS_CM_uint16 0 65535 /end CHARACTERISTIC
/begin CHARACTERISTIC BDM_cFBPowHiLv2Value_F32 "回馈功率不可控等级2故障阈值" VALUE 0x0000 /* @ECU_Address@BDM_cFBPowHiLv2Value_F32@ */ Scalar_FLOAT32_IEEE 0 BMS_CM_single -3.4e+38 3.4e+38 /end CHARACTERISTIC
/begin CHARACTERISTIC BDM_cFBPowHiLv3En_U8 "回馈功率不可控等级3故障诊断使能" VALUE 0x0000 /* @ECU_Address@BDM_cFBPowHiLv3En_U8@ */ Scalar_UBYTE 0 BMS_CM_uint8 0 255 /end CHARACTERISTIC
/begin CHARACTERISTIC BDM_cFBPowHiLv3HealEn_U8 "回馈功率不可控等级3故障恢复使能" VALUE 0x0000 /* @ECU_Address@BDM_cFBPowHiLv3HealEn_U8@ */ Scalar_UBYTE 0 BMS_CM_uint8 0 255 /end CHARACTERISTIC
/begin CHARACTERISTIC BDM_cFBPowHiLv3HealTiDeb_U16 "回馈功率不可控等级3故障恢复时间" VALUE 0x0000 /* @ECU_Address@BDM_cFBPowHiLv3HealTiDeb_U16@ */ Scalar_UWORD 0 BMS_CM_uint16 0 65535 /end CHARACTERISTIC
/begin CHARACTERISTIC BDM_cFBPowHiLv3HealValue_F32 "回馈功率不可控等级3恢复阈值" VALUE 0x0000 /* @ECU_Address@BDM_cFBPowHiLv3HealValue_F32@ */ Scalar_FLOAT32_IEEE 0 BMS_CM_single -3.4e+38 3.4e+38 /end CHARACTERISTIC
/begin CHARACTERISTIC BDM_cFBPowHiLv3InitTiDeb_U16 "回馈功率不可控等级3故障初始化成熟时间" VALUE 0x0000 /* @ECU_Address@BDM_cFBPowHiLv3InitTiDeb_U16@ */ Scalar_UWORD 0 BMS_CM_uint16 0 65535 /end CHARACTERISTIC
/begin CHARACTERISTIC BDM_cFBPowHiLv3TiDeb_U16 "回馈功率不可控等级3故障成熟时间" VALUE 0x0000 /* @ECU_Address@BDM_cFBPowHiLv3TiDeb_U16@ */ Scalar_UWORD 0 BMS_CM_uint16 0 65535 /end CHARACTERISTIC
/begin CHARACTERISTIC BDM_cFBPowHiLv3Value_F32 "回馈功率不可控等级3故障阈值" VALUE 0x0000 /* @ECU_Address@BDM_cFBPowHiLv3Value_F32@ */ Scalar_FLOAT32_IEEE 0 BMS_CM_single -3.4e+38 3.4e+38 /end CHARACTERISTIC
/begin CHARACTERISTIC BDM_cFBPowHiLv4En_U8 "回馈功率不可控等级4故障诊断使能" VALUE 0x0000 /* @ECU_Address@BDM_cFBPowHiLv4En_U8@ */ Scalar_UBYTE 0 BMS_CM_uint8 0 255 /end CHARACTERISTIC
/begin CHARACTERISTIC BDM_cFBPowHiLv4HealEn_U8 "回馈功率不可控等级4故障恢复使能" VALUE 0x0000 /* @ECU_Address@BDM_cFBPowHiLv4HealEn_U8@ */ Scalar_UBYTE 0 BMS_CM_uint8 0 255 /end CHARACTERISTIC
/begin CHARACTERISTIC BDM_cFBPowHiLv4HealTiDeb_U16 "回馈功率不可控等级4故障恢复时间" VALUE 0x0000 /* @ECU_Address@BDM_cFBPowHiLv4HealTiDeb_U16@ */ Scalar_UWORD 0 BMS_CM_uint16 0 65535 /end CHARACTERISTIC
/begin CHARACTERISTIC BDM_cFBPowHiLv4InitTiDeb_U16 "回馈功率不可控等级4故障初始化成熟时间" VALUE 0x0000 /* @ECU_Address@BDM_cFBPowHiLv4InitTiDeb_U16@ */ Scalar_UWORD 0 BMS_CM_uint16 0 65535 /end CHARACTERISTIC
/begin CHARACTERISTIC BDM_cFBPowHiLv4TiDeb_U16 "回馈功率不可控等级4故障成熟时间" VALUE 0x0000 /* @ECU_Address@BDM_cFBPowHiLv4TiDeb_U16@ */ Scalar_UWORD 0 BMS_CM_uint16 0 65535 /end CHARACTERISTIC
/begin CHARACTERISTIC BDM_cFuseBreakErrLv1En_U8 "Fuse熔断等级1故障诊断使能" VALUE 0x0000 /* @ECU_Address@BDM_cFuseBreakErrLv1En_U8@ */ Scalar_UBYTE 0 BMS_CM_uint8 0 255 /end CHARACTERISTIC
/begin CHARACTERISTIC BDM_cFuseBreakErrLv1HealEn_U8 "Fuse熔断等级1故障恢复使能" VALUE 0x0000 /* @ECU_Address@BDM_cFuseBreakErrLv1HealEn_U8@ */ Scalar_UBYTE 0 BMS_CM_uint8 0 255 /end CHARACTERISTIC
/begin CHARACTERISTIC BDM_cFuseBreakErrLv1HealTiDeb_U16 "Fuse熔断等级1故障恢复时间" VALUE 0x0000 /* @ECU_Address@BDM_cFuseBreakErrLv1HealTiDeb_U16@ */ Scalar_UWORD 0 BMS_CM_uint16 0 65535 /end CHARACTERISTIC
/begin CHARACTERISTIC BDM_cFuseBreakErrLv1HealValue_F32 "Fuse熔断等级1恢复阈值" VALUE 0x0000 /* @ECU_Address@BDM_cFuseBreakErrLv1HealValue_F32@ */ Scalar_FLOAT32_IEEE 0 BMS_CM_single -3.4e+38 3.4e+38 /end CHARACTERISTIC
/begin CHARACTERISTIC BDM_cFuseBreakErrLv1InitTiDeb_U16 "Fuse熔断等级1故障初始化成熟时间" VALUE 0x0000 /* @ECU_Address@BDM_cFuseBreakErrLv1InitTiDeb_U16@ */ Scalar_UWORD 0 BMS_CM_uint16 0 65535 /end CHARACTERISTIC
/begin CHARACTERISTIC BDM_cFuseBreakErrLv1TiDeb_U16 "Fuse熔断等级1故障成熟时间" VALUE 0x0000 /* @ECU_Address@BDM_cFuseBreakErrLv1TiDeb_U16@ */ Scalar_UWORD 0 BMS_CM_uint16 0 65535 /end CHARACTERISTIC
/begin CHARACTERISTIC BDM_cFuseBreakErrLv1Value_F32 "Fuse熔断等级1故障阈值" VALUE 0x0000 /* @ECU_Address@BDM_cFuseBreakErrLv1Value_F32@ */ Scalar_FLOAT32_IEEE 0 BMS_CM_single -3.4e+38 3.4e+38 /end CHARACTERISTIC
/begin CHARACTERISTIC BDM_cHTBattVoltLoLv1HealValue_F32 "总压过低大于等于15℃等级1恢复阈值" VALUE 0x0000 /* @ECU_Address@BDM_cHTBattVoltLoLv1HealValue_F32@ */ Scalar_FLOAT32_IEEE 0 BMS_CM_single -3.4e+38 3.4e+38 /end CHARACTERISTIC
/begin CHARACTERISTIC BDM_cHTBattVoltLoLv1Value_F32 "总压过低大于等于15℃等级1故障阈值" VALUE 0x0000 /* @ECU_Address@BDM_cHTBattVoltLoLv1Value_F32@ */ Scalar_FLOAT32_IEEE 0 BMS_CM_single -3.4e+38 3.4e+38 /end CHARACTERISTIC
/begin CHARACTERISTIC BDM_cHTBattVoltLoLv2HealValue_F32 "总压过低大于等于15℃等级2恢复阈值" VALUE 0x0000 /* @ECU_Address@BDM_cHTBattVoltLoLv2HealValue_F32@ */ Scalar_FLOAT32_IEEE 0 BMS_CM_single -3.4e+38 3.4e+38 /end CHARACTERISTIC
/begin CHARACTERISTIC BDM_cHTBattVoltLoLv2Value_F32 "总压过低大于等于15℃等级2故障阈值" VALUE 0x0000 /* @ECU_Address@BDM_cHTBattVoltLoLv2Value_F32@ */ Scalar_FLOAT32_IEEE 0 BMS_CM_single -3.4e+38 3.4e+38 /end CHARACTERISTIC
/begin CHARACTERISTIC BDM_cHTBattVoltLoLv3HealValue_F32 "总压过低大于等于15℃等级3恢复阈值" VALUE 0x0000 /* @ECU_Address@BDM_cHTBattVoltLoLv3HealValue_F32@ */ Scalar_FLOAT32_IEEE 0 BMS_CM_single -3.4e+38 3.4e+38 /end CHARACTERISTIC
/begin CHARACTERISTIC BDM_cHTBattVoltLoLv3Value_F32 "总压过低大于等于15℃等级3故障阈值" VALUE 0x0000 /* @ECU_Address@BDM_cHTBattVoltLoLv3Value_F32@ */ Scalar_FLOAT32_IEEE 0 BMS_CM_single -3.4e+38 3.4e+38 /end CHARACTERISTIC
/begin CHARACTERISTIC BDM_cHTCellVoltLoLv1HealValue_F32 "单体过低等级1大于等于15℃恢复阈值" VALUE 0x0000 /* @ECU_Address@BDM_cHTCellVoltLoLv1HealValue_F32@ */ Scalar_FLOAT32_IEEE 0 BMS_CM_single -3.4e+38 3.4e+38 /end CHARACTERISTIC
/begin CHARACTERISTIC BDM_cHTCellVoltLoLv1Value_F32 "单体过低等级1大于等于15℃故障阈值" VALUE 0x0000 /* @ECU_Address@BDM_cHTCellVoltLoLv1Value_F32@ */ Scalar_FLOAT32_IEEE 0 BMS_CM_single -3.4e+38 3.4e+38 /end CHARACTERISTIC
/begin CHARACTERISTIC BDM_cHTCellVoltLoLv2HealValue_F32 "单体过低等级2大于等于15℃恢复阈值" VALUE 0x0000 /* @ECU_Address@BDM_cHTCellVoltLoLv2HealValue_F32@ */ Scalar_FLOAT32_IEEE 0 BMS_CM_single -3.4e+38 3.4e+38 /end CHARACTERISTIC
/begin CHARACTERISTIC BDM_cHTCellVoltLoLv2Value_F32 "单体过低等级2大于等于15℃故障阈值" VALUE 0x0000 /* @ECU_Address@BDM_cHTCellVoltLoLv2Value_F32@ */ Scalar_FLOAT32_IEEE 0 BMS_CM_single -3.4e+38 3.4e+38 /end CHARACTERISTIC
/begin CHARACTERISTIC BDM_cHTCellVoltLoLv3HealValue_F32 "单体过低等级3大于等于15℃恢复阈值" VALUE 0x0000 /* @ECU_Address@BDM_cHTCellVoltLoLv3HealValue_F32@ */ Scalar_FLOAT32_IEEE 0 BMS_CM_single -3.4e+38 3.4e+38 /end CHARACTERISTIC
/begin CHARACTERISTIC BDM_cHTCellVoltLoLv3Value_F32 "单体过低等级3大于等于15℃故障阈值" VALUE 0x0000 /* @ECU_Address@BDM_cHTCellVoltLoLv3Value_F32@ */ Scalar_FLOAT32_IEEE 0 BMS_CM_single -3.4e+38 3.4e+38 /end CHARACTERISTIC
/begin CHARACTERISTIC BDM_cHTCellVoltLoLv4HealValue_F32 "单体过低等级4大于等于0℃恢复阈值" VALUE 0x0000 /* @ECU_Address@BDM_cHTCellVoltLoLv4HealValue_F32@ */ Scalar_FLOAT32_IEEE 0 BMS_CM_single -3.4e+38 3.4e+38 /end CHARACTERISTIC
/begin CHARACTERISTIC BDM_cHTCellVoltLoLv4Value_F32 "单体过低等级4大于等于0℃故障阈值" VALUE 0x0000 /* @ECU_Address@BDM_cHTCellVoltLoLv4Value_F32@ */ Scalar_FLOAT32_IEEE 0 BMS_CM_single -3.4e+38 3.4e+38 /end CHARACTERISTIC
/begin CHARACTERISTIC BDM_cHTCellVoltOverLoLv1HealValue_F32 "电芯过放等级1恢复阈值" VALUE 0x0000 /* @ECU_Address@BDM_cHTCellVoltOverLoLv1HealValue_F32@ */ Scalar_FLOAT32_IEEE 0 BMS_CM_single -3.4e+38 3.4e+38 /end CHARACTERISTIC
/begin CHARACTERISTIC BDM_cHTCellVoltOverLoLv1Value_F32 "电芯过放等级1故障阈值" VALUE 0x0000 /* @ECU_Address@BDM_cHTCellVoltOverLoLv1Value_F32@ */ Scalar_FLOAT32_IEEE 0 BMS_CM_single -3.4e+38 3.4e+38 /end CHARACTERISTIC
/begin CHARACTERISTIC BDM_cIResLoLv1En_U8 "绝缘阻值过低等级1故障诊断使能" VALUE 0x0000 /* @ECU_Address@BDM_cIResLoLv1En_U8@ */ Scalar_UBYTE 0 BMS_CM_uint8 0 255 /end CHARACTERISTIC
/begin CHARACTERISTIC BDM_cIResLoLv1HealEn_U8 "绝缘阻值过低等级1故障恢复使能" VALUE 0x0000 /* @ECU_Address@BDM_cIResLoLv1HealEn_U8@ */ Scalar_UBYTE 0 BMS_CM_uint8 0 255 /end CHARACTERISTIC
/begin CHARACTERISTIC BDM_cIResLoLv1HealTiDeb_U16 "绝缘阻值过低等级1故障恢复时间" VALUE 0x0000 /* @ECU_Address@BDM_cIResLoLv1HealTiDeb_U16@ */ Scalar_UWORD 0 BMS_CM_uint16 0 65535 /end CHARACTERISTIC
/begin CHARACTERISTIC BDM_cIResLoLv1HealValue_F32 "绝缘阻值过低等级1恢复阈值" VALUE 0x0000 /* @ECU_Address@BDM_cIResLoLv1HealValue_F32@ */ Scalar_FLOAT32_IEEE 0 BMS_CM_single -3.4e+38 3.4e+38 /end CHARACTERISTIC
/begin CHARACTERISTIC BDM_cIResLoLv1InitTiDeb_U16 "绝缘阻值过低等级1故障初始化成熟时间" VALUE 0x0000 /* @ECU_Address@BDM_cIResLoLv1InitTiDeb_U16@ */ Scalar_UWORD 0 BMS_CM_uint16 0 65535 /end CHARACTERISTIC
/begin CHARACTERISTIC BDM_cIResLoLv1TiDeb_U16 "绝缘阻值过低等级1故障成熟时间" VALUE 0x0000 /* @ECU_Address@BDM_cIResLoLv1TiDeb_U16@ */ Scalar_UWORD 0 BMS_CM_uint16 0 65535 /end CHARACTERISTIC
/begin CHARACTERISTIC BDM_cIResLoLv1Value_F32 "绝缘阻值过低等级1故障阈值" VALUE 0x0000 /* @ECU_Address@BDM_cIResLoLv1Value_F32@ */ Scalar_FLOAT32_IEEE 0 BMS_CM_single -3.4e+38 3.4e+38 /end CHARACTERISTIC
/begin CHARACTERISTIC BDM_cIResLoLv2En_U8 "绝缘阻值过低等级2故障诊断使能" VALUE 0x0000 /* @ECU_Address@BDM_cIResLoLv2En_U8@ */ Scalar_UBYTE 0 BMS_CM_uint8 0 255 /end CHARACTERISTIC
/begin CHARACTERISTIC BDM_cIResLoLv2HealEn_U8 "绝缘阻值过低等级2故障恢复使能" VALUE 0x0000 /* @ECU_Address@BDM_cIResLoLv2HealEn_U8@ */ Scalar_UBYTE 0 BMS_CM_uint8 0 255 /end CHARACTERISTIC
/begin CHARACTERISTIC BDM_cIResLoLv2HealTiDeb_U16 "绝缘阻值过低等级2故障恢复时间" VALUE 0x0000 /* @ECU_Address@BDM_cIResLoLv2HealTiDeb_U16@ */ Scalar_UWORD 0 BMS_CM_uint16 0 65535 /end CHARACTERISTIC
/begin CHARACTERISTIC BDM_cIResLoLv2HealValue_F32 "绝缘阻值过低等级2恢复阈值" VALUE 0x0000 /* @ECU_Address@BDM_cIResLoLv2HealValue_F32@ */ Scalar_FLOAT32_IEEE 0 BMS_CM_single -3.4e+38 3.4e+38 /end CHARACTERISTIC
/begin CHARACTERISTIC BDM_cIResLoLv2InitTiDeb_U16 "绝缘阻值过低等级2故障初始化成熟时间" VALUE 0x0000 /* @ECU_Address@BDM_cIResLoLv2InitTiDeb_U16@ */ Scalar_UWORD 0 BMS_CM_uint16 0 65535 /end CHARACTERISTIC
/begin CHARACTERISTIC BDM_cIResLoLv2TiDeb_U16 "绝缘阻值过低等级2故障成熟时间" VALUE 0x0000 /* @ECU_Address@BDM_cIResLoLv2TiDeb_U16@ */ Scalar_UWORD 0 BMS_CM_uint16 0 65535 /end CHARACTERISTIC
/begin CHARACTERISTIC BDM_cIResLoLv2Value_F32 "绝缘阻值过低等级2故障阈值" VALUE 0x0000 /* @ECU_Address@BDM_cIResLoLv2Value_F32@ */ Scalar_FLOAT32_IEEE 0 BMS_CM_single -3.4e+38 3.4e+38 /end CHARACTERISTIC
/begin CHARACTERISTIC BDM_cIResLoLv3En_U8 "绝缘阻值过低等级3故障诊断使能" VALUE 0x0000 /* @ECU_Address@BDM_cIResLoLv3En_U8@ */ Scalar_UBYTE 0 BMS_CM_uint8 0 255 /end CHARACTERISTIC
/begin CHARACTERISTIC BDM_cIResLoLv3HealEn_U8 "绝缘阻值过低等级3故障恢复使能" VALUE 0x0000 /* @ECU_Address@BDM_cIResLoLv3HealEn_U8@ */ Scalar_UBYTE 0 BMS_CM_uint8 0 255 /end CHARACTERISTIC
/begin CHARACTERISTIC BDM_cIResLoLv3HealTiDeb_U16 "绝缘阻值过低等级3故障恢复时间" VALUE 0x0000 /* @ECU_Address@BDM_cIResLoLv3HealTiDeb_U16@ */ Scalar_UWORD 0 BMS_CM_uint16 0 65535 /end CHARACTERISTIC
/begin CHARACTERISTIC BDM_cIResLoLv3HealValue_F32 "绝缘阻值过低等级3恢复阈值" VALUE 0x0000 /* @ECU_Address@BDM_cIResLoLv3HealValue_F32@ */ Scalar_FLOAT32_IEEE 0 BMS_CM_single -3.4e+38 3.4e+38 /end CHARACTERISTIC
/begin CHARACTERISTIC BDM_cIResLoLv3InitTiDeb_U16 "绝缘阻值过低等级3故障初始化成熟时间" VALUE 0x0000 /* @ECU_Address@BDM_cIResLoLv3InitTiDeb_U16@ */ Scalar_UWORD 0 BMS_CM_uint16 0 65535 /end CHARACTERISTIC
/begin CHARACTERISTIC BDM_cIResLoLv3TiDeb_U16 "绝缘阻值过低等级3故障成熟时间" VALUE 0x0000 /* @ECU_Address@BDM_cIResLoLv3TiDeb_U16@ */ Scalar_UWORD 0 BMS_CM_uint16 0 65535 /end CHARACTERISTIC
/begin CHARACTERISTIC BDM_cIResLoLv3Value_F32 "绝缘阻值过低等级3故障阈值" VALUE 0x0000 /* @ECU_Address@BDM_cIResLoLv3Value_F32@ */ Scalar_FLOAT32_IEEE 0 BMS_CM_single -3.4e+38 3.4e+38 /end CHARACTERISTIC
/begin CHARACTERISTIC BDM_cIResLoLv4En_U8 "绝缘阻值过低等级4故障诊断使能" VALUE 0x0000 /* @ECU_Address@BDM_cIResLoLv4En_U8@ */ Scalar_UBYTE 0 BMS_CM_uint8 0 255 /end CHARACTERISTIC
/begin CHARACTERISTIC BDM_cIResLoLv4HealEn_U8 "绝缘阻值过低等级4故障恢复使能" VALUE 0x0000 /* @ECU_Address@BDM_cIResLoLv4HealEn_U8@ */ Scalar_UBYTE 0 BMS_CM_uint8 0 255 /end CHARACTERISTIC
/begin CHARACTERISTIC BDM_cIResLoLv4HealTiDeb_U16 "绝缘阻值过低等级4故障恢复时间" VALUE 0x0000 /* @ECU_Address@BDM_cIResLoLv4HealTiDeb_U16@ */ Scalar_UWORD 0 BMS_CM_uint16 0 65535 /end CHARACTERISTIC
/begin CHARACTERISTIC BDM_cIResLoLv4HealValue_F32 "绝缘阻值过低等级4恢复阈值" VALUE 0x0000 /* @ECU_Address@BDM_cIResLoLv4HealValue_F32@ */ Scalar_FLOAT32_IEEE 0 BMS_CM_single -3.4e+38 3.4e+38 /end CHARACTERISTIC
/begin CHARACTERISTIC BDM_cIResLoLv4InitTiDeb_U16 "绝缘阻值过低等级4故障初始化成熟时间" VALUE 0x0000 /* @ECU_Address@BDM_cIResLoLv4InitTiDeb_U16@ */ Scalar_UWORD 0 BMS_CM_uint16 0 65535 /end CHARACTERISTIC
/begin CHARACTERISTIC BDM_cIResLoLv4TiDeb_U16 "绝缘阻值过低等级4故障成熟时间" VALUE 0x0000 /* @ECU_Address@BDM_cIResLoLv4TiDeb_U16@ */ Scalar_UWORD 0 BMS_CM_uint16 0 65535 /end CHARACTERISTIC
/begin CHARACTERISTIC BDM_cIResLoLv4Value_F32 "绝缘阻值过低等级4故障阈值" VALUE 0x0000 /* @ECU_Address@BDM_cIResLoLv4Value_F32@ */ Scalar_FLOAT32_IEEE 0 BMS_CM_single -3.4e+38 3.4e+38 /end CHARACTERISTIC
/begin CHARACTERISTIC BDM_cLTBattVoltLoLv1HealValue_F32 "总压过低小于等于0℃等级1恢复阈值" VALUE 0x0000 /* @ECU_Address@BDM_cLTBattVoltLoLv1HealValue_F32@ */ Scalar_FLOAT32_IEEE 0 BMS_CM_single -3.4e+38 3.4e+38 /end CHARACTERISTIC
/begin CHARACTERISTIC BDM_cLTBattVoltLoLv1Value_F32 "总压过低小于等于0℃等级1故障阈值" VALUE 0x0000 /* @ECU_Address@BDM_cLTBattVoltLoLv1Value_F32@ */ Scalar_FLOAT32_IEEE 0 BMS_CM_single -3.4e+38 3.4e+38 /end CHARACTERISTIC
/begin CHARACTERISTIC BDM_cLTBattVoltLoLv2HealValue_F32 "总压过低小于等于0℃等级2恢复阈值" VALUE 0x0000 /* @ECU_Address@BDM_cLTBattVoltLoLv2HealValue_F32@ */ Scalar_FLOAT32_IEEE 0 BMS_CM_single -3.4e+38 3.4e+38 /end CHARACTERISTIC
/begin CHARACTERISTIC BDM_cLTBattVoltLoLv2Value_F32 "总压过低小于等于0℃等级2故障阈值" VALUE 0x0000 /* @ECU_Address@BDM_cLTBattVoltLoLv2Value_F32@ */ Scalar_FLOAT32_IEEE 0 BMS_CM_single -3.4e+38 3.4e+38 /end CHARACTERISTIC
/begin CHARACTERISTIC BDM_cLTBattVoltLoLv3HealValue_F32 "总压过低小于等于0℃等级3恢复阈值" VALUE 0x0000 /* @ECU_Address@BDM_cLTBattVoltLoLv3HealValue_F32@ */ Scalar_FLOAT32_IEEE 0 BMS_CM_single -3.4e+38 3.4e+38 /end CHARACTERISTIC
/begin CHARACTERISTIC BDM_cLTBattVoltLoLv3Value_F32 "总压过低小于等于0℃等级3故障阈值" VALUE 0x0000 /* @ECU_Address@BDM_cLTBattVoltLoLv3Value_F32@ */ Scalar_FLOAT32_IEEE 0 BMS_CM_single -3.4e+38 3.4e+38 /end CHARACTERISTIC
/begin CHARACTERISTIC BDM_cLTCellVoltLoLv1HealValue_F32 "单体过低等级1小于等于0℃恢复阈值" VALUE 0x0000 /* @ECU_Address@BDM_cLTCellVoltLoLv1HealValue_F32@ */ Scalar_FLOAT32_IEEE 0 BMS_CM_single -3.4e+38 3.4e+38 /end CHARACTERISTIC
/begin CHARACTERISTIC BDM_cLTCellVoltLoLv1Value_F32 "单体过低等级1小于等于0℃故障阈值" VALUE 0x0000 /* @ECU_Address@BDM_cLTCellVoltLoLv1Value_F32@ */ Scalar_FLOAT32_IEEE 0 BMS_CM_single -3.4e+38 3.4e+38 /end CHARACTERISTIC
/begin CHARACTERISTIC BDM_cLTCellVoltLoLv2HealValue_F32 "单体过低等级2小于等于0℃恢复阈值" VALUE 0x0000 /* @ECU_Address@BDM_cLTCellVoltLoLv2HealValue_F32@ */ Scalar_FLOAT32_IEEE 0 BMS_CM_single -3.4e+38 3.4e+38 /end CHARACTERISTIC
/begin CHARACTERISTIC BDM_cLTCellVoltLoLv2Value_F32 "单体过低等级2小于等于0℃故障阈值" VALUE 0x0000 /* @ECU_Address@BDM_cLTCellVoltLoLv2Value_F32@ */ Scalar_FLOAT32_IEEE 0 BMS_CM_single -3.4e+38 3.4e+38 /end CHARACTERISTIC
/begin CHARACTERISTIC BDM_cLTCellVoltLoLv3HealValue_F32 "单体过低等级3小于等于0℃恢复阈值" VALUE 0x0000 /* @ECU_Address@BDM_cLTCellVoltLoLv3HealValue_F32@ */ Scalar_FLOAT32_IEEE 0 BMS_CM_single -3.4e+38 3.4e+38 /end CHARACTERISTIC
/begin CHARACTERISTIC BDM_cLTCellVoltLoLv3Value_F32 "单体过低等级3小于等于0℃故障阈值" VALUE 0x0000 /* @ECU_Address@BDM_cLTCellVoltLoLv3Value_F32@ */ Scalar_FLOAT32_IEEE 0 BMS_CM_single -3.4e+38 3.4e+38 /end CHARACTERISTIC
/begin CHARACTERISTIC BDM_cLTCellVoltLoLv4HealValue_F32 "单体过低等级4小于0℃恢复阈值" VALUE 0x0000 /* @ECU_Address@BDM_cLTCellVoltLoLv4HealValue_F32@ */ Scalar_FLOAT32_IEEE 0 BMS_CM_single -3.4e+38 3.4e+38 /end CHARACTERISTIC
/begin CHARACTERISTIC BDM_cLTCellVoltLoLv4Value_F32 "单体过低等级4小于0℃故障阈值" VALUE 0x0000 /* @ECU_Address@BDM_cLTCellVoltLoLv4Value_F32@ */ Scalar_FLOAT32_IEEE 0 BMS_CM_single -3.4e+38 3.4e+38 /end CHARACTERISTIC
/begin CHARACTERISTIC BDM_cMTBattVoltLoLv1HealValue_F32 "总压过低0℃-15℃等级1恢复阈值" VALUE 0x0000 /* @ECU_Address@BDM_cMTBattVoltLoLv1HealValue_F32@ */ Scalar_FLOAT32_IEEE 0 BMS_CM_single -3.4e+38 3.4e+38 /end CHARACTERISTIC
/begin CHARACTERISTIC BDM_cMTBattVoltLoLv1Value_F32 "总压过低0℃-15℃等级1故障阈值" VALUE 0x0000 /* @ECU_Address@BDM_cMTBattVoltLoLv1Value_F32@ */ Scalar_FLOAT32_IEEE 0 BMS_CM_single -3.4e+38 3.4e+38 /end CHARACTERISTIC
/begin CHARACTERISTIC BDM_cMTBattVoltLoLv2HealValue_F32 "总压过低0℃-15℃等级2恢复阈值" VALUE 0x0000 /* @ECU_Address@BDM_cMTBattVoltLoLv2HealValue_F32@ */ Scalar_FLOAT32_IEEE 0 BMS_CM_single -3.4e+38 3.4e+38 /end CHARACTERISTIC
/begin CHARACTERISTIC BDM_cMTBattVoltLoLv2Value_F32 "总压过低0℃-15℃等级2故障阈值" VALUE 0x0000 /* @ECU_Address@BDM_cMTBattVoltLoLv2Value_F32@ */ Scalar_FLOAT32_IEEE 0 BMS_CM_single -3.4e+38 3.4e+38 /end CHARACTERISTIC
/begin CHARACTERISTIC BDM_cMTBattVoltLoLv3HealValue_F32 "总压过低0℃-15℃等级3恢复阈值" VALUE 0x0000 /* @ECU_Address@BDM_cMTBattVoltLoLv3HealValue_F32@ */ Scalar_FLOAT32_IEEE 0 BMS_CM_single -3.4e+38 3.4e+38 /end CHARACTERISTIC
/begin CHARACTERISTIC BDM_cMTBattVoltLoLv3Value_F32 "总压过低0℃-15℃等级3故障阈值" VALUE 0x0000 /* @ECU_Address@BDM_cMTBattVoltLoLv3Value_F32@ */ Scalar_FLOAT32_IEEE 0 BMS_CM_single -3.4e+38 3.4e+38 /end CHARACTERISTIC
/begin CHARACTERISTIC BDM_cMTCellVoltLoLv1HealValue_F32 "单体过低等级10℃-15℃恢复阈值" VALUE 0x0000 /* @ECU_Address@BDM_cMTCellVoltLoLv1HealValue_F32@ */ Scalar_FLOAT32_IEEE 0 BMS_CM_single -3.4e+38 3.4e+38 /end CHARACTERISTIC
/begin CHARACTERISTIC BDM_cMTCellVoltLoLv1Value_F32 "单体过低等级10℃-15℃故障阈值" VALUE 0x0000 /* @ECU_Address@BDM_cMTCellVoltLoLv1Value_F32@ */ Scalar_FLOAT32_IEEE 0 BMS_CM_single -3.4e+38 3.4e+38 /end CHARACTERISTIC
/begin CHARACTERISTIC BDM_cMTCellVoltLoLv2HealValue_F32 "单体过低等级20℃-15℃恢复阈值" VALUE 0x0000 /* @ECU_Address@BDM_cMTCellVoltLoLv2HealValue_F32@ */ Scalar_FLOAT32_IEEE 0 BMS_CM_single -3.4e+38 3.4e+38 /end CHARACTERISTIC
/begin CHARACTERISTIC BDM_cMTCellVoltLoLv2Value_F32 "单体过低等级20℃-15℃故障阈值" VALUE 0x0000 /* @ECU_Address@BDM_cMTCellVoltLoLv2Value_F32@ */ Scalar_FLOAT32_IEEE 0 BMS_CM_single -3.4e+38 3.4e+38 /end CHARACTERISTIC
/begin CHARACTERISTIC BDM_cMTCellVoltLoLv3HealValue_F32 "单体过低等级30℃-15℃恢复阈值" VALUE 0x0000 /* @ECU_Address@BDM_cMTCellVoltLoLv3HealValue_F32@ */ Scalar_FLOAT32_IEEE 0 BMS_CM_single -3.4e+38 3.4e+38 /end CHARACTERISTIC
/begin CHARACTERISTIC BDM_cMTCellVoltLoLv3Value_F32 "单体过低等级30℃-15℃故障阈值" VALUE 0x0000 /* @ECU_Address@BDM_cMTCellVoltLoLv3Value_F32@ */ Scalar_FLOAT32_IEEE 0 BMS_CM_single -3.4e+38 3.4e+38 /end CHARACTERISTIC
/begin CHARACTERISTIC BDM_cPackPoleTempHiLv1En_U8 "PackPole温度过高等级1故障诊断使能" VALUE 0x0000 /* @ECU_Address@BDM_cPackPoleTempHiLv1En_U8@ */ Scalar_UBYTE 0 BMS_CM_uint8 0 255 /end CHARACTERISTIC
/begin CHARACTERISTIC BDM_cPackPoleTempHiLv1HealEn_U8 "PackPole温度过高等级1故障恢复使能" VALUE 0x0000 /* @ECU_Address@BDM_cPackPoleTempHiLv1HealEn_U8@ */ Scalar_UBYTE 0 BMS_CM_uint8 0 255 /end CHARACTERISTIC
/begin CHARACTERISTIC BDM_cPackPoleTempHiLv1HealTiDeb_U16 "PackPole温度过高等级1故障恢复时间" VALUE 0x0000 /* @ECU_Address@BDM_cPackPoleTempHiLv1HealTiDeb_U16@ */ Scalar_UWORD 0 BMS_CM_uint16 0 65535 /end CHARACTERISTIC
/begin CHARACTERISTIC BDM_cPackPoleTempHiLv1HealValue_F32 "PackPole温度过高等级1恢复阈值" VALUE 0x0000 /* @ECU_Address@BDM_cPackPoleTempHiLv1HealValue_F32@ */ Scalar_FLOAT32_IEEE 0 BMS_CM_single -3.4e+38 3.4e+38 /end CHARACTERISTIC
/begin CHARACTERISTIC BDM_cPackPoleTempHiLv1InitTiDeb_U16 "PackPole温度过高等级1故障初始化成熟时间" VALUE 0x0000 /* @ECU_Address@BDM_cPackPoleTempHiLv1InitTiDeb_U16@ */ Scalar_UWORD 0 BMS_CM_uint16 0 65535 /end CHARACTERISTIC
/begin CHARACTERISTIC BDM_cPackPoleTempHiLv1TiDeb_U16 "PackPole温度过高等级1故障成熟时间" VALUE 0x0000 /* @ECU_Address@BDM_cPackPoleTempHiLv1TiDeb_U16@ */ Scalar_UWORD 0 BMS_CM_uint16 0 65535 /end CHARACTERISTIC
/begin CHARACTERISTIC BDM_cPackPoleTempHiLv1Value_F32 "PackPole温度过高等级1故障阈值" VALUE 0x0000 /* @ECU_Address@BDM_cPackPoleTempHiLv1Value_F32@ */ Scalar_FLOAT32_IEEE 0 BMS_CM_single -3.4e+38 3.4e+38 /end CHARACTERISTIC
/begin CHARACTERISTIC BDM_cPackPoleTempHiLv2En_U8 "PackPole温度过高等级2故障诊断使能" VALUE 0x0000 /* @ECU_Address@BDM_cPackPoleTempHiLv2En_U8@ */ Scalar_UBYTE 0 BMS_CM_uint8 0 255 /end CHARACTERISTIC
/begin CHARACTERISTIC BDM_cPackPoleTempHiLv2HealEn_U8 "PackPole温度过高等级2故障恢复使能" VALUE 0x0000 /* @ECU_Address@BDM_cPackPoleTempHiLv2HealEn_U8@ */ Scalar_UBYTE 0 BMS_CM_uint8 0 255 /end CHARACTERISTIC
/begin CHARACTERISTIC BDM_cPackPoleTempHiLv2HealTiDeb_U16 "PackPole温度过高等级2故障恢复时间" VALUE 0x0000 /* @ECU_Address@BDM_cPackPoleTempHiLv2HealTiDeb_U16@ */ Scalar_UWORD 0 BMS_CM_uint16 0 65535 /end CHARACTERISTIC
/begin CHARACTERISTIC BDM_cPackPoleTempHiLv2HealValue_F32 "PackPole温度过高等级2恢复阈值" VALUE 0x0000 /* @ECU_Address@BDM_cPackPoleTempHiLv2HealValue_F32@ */ Scalar_FLOAT32_IEEE 0 BMS_CM_single -3.4e+38 3.4e+38 /end CHARACTERISTIC
/begin CHARACTERISTIC BDM_cPackPoleTempHiLv2InitTiDeb_U16 "PackPole温度过高等级2故障初始化成熟时间" VALUE 0x0000 /* @ECU_Address@BDM_cPackPoleTempHiLv2InitTiDeb_U16@ */ Scalar_UWORD 0 BMS_CM_uint16 0 65535 /end CHARACTERISTIC
/begin CHARACTERISTIC BDM_cPackPoleTempHiLv2TiDeb_U16 "PackPole温度过高等级2故障成熟时间" VALUE 0x0000 /* @ECU_Address@BDM_cPackPoleTempHiLv2TiDeb_U16@ */ Scalar_UWORD 0 BMS_CM_uint16 0 65535 /end CHARACTERISTIC
/begin CHARACTERISTIC BDM_cPackPoleTempHiLv2Value_F32 "PackPole温度过高等级2故障阈值" VALUE 0x0000 /* @ECU_Address@BDM_cPackPoleTempHiLv2Value_F32@ */ Scalar_FLOAT32_IEEE 0 BMS_CM_single -3.4e+38 3.4e+38 /end CHARACTERISTIC
/begin CHARACTERISTIC BDM_cPrChgResErrLv1En_U8 "预充电阻故障等级1故障诊断使能" VALUE 0x0000 /* @ECU_Address@BDM_cPrChgResErrLv1En_U8@ */ Scalar_UBYTE 0 BMS_CM_uint8 0 255 /end CHARACTERISTIC
/begin CHARACTERISTIC BDM_cPrChgResErrLv1HealEn_U8 "预充电阻故障等级1故障恢复使能" VALUE 0x0000 /* @ECU_Address@BDM_cPrChgResErrLv1HealEn_U8@ */ Scalar_UBYTE 0 BMS_CM_uint8 0 255 /end CHARACTERISTIC
/begin CHARACTERISTIC BDM_cPrChgResErrLv1HealTiDeb_U16 "预充电阻故障等级1故障恢复时间" VALUE 0x0000 /* @ECU_Address@BDM_cPrChgResErrLv1HealTiDeb_U16@ */ Scalar_UWORD 0 BMS_CM_uint16 0 65535 /end CHARACTERISTIC
/begin CHARACTERISTIC BDM_cPrChgResErrLv1HealValue_F32 "预充电阻故障等级1恢复阈值" VALUE 0x0000 /* @ECU_Address@BDM_cPrChgResErrLv1HealValue_F32@ */ Scalar_FLOAT32_IEEE 0 BMS_CM_single -3.4e+38 3.4e+38 /end CHARACTERISTIC
/begin CHARACTERISTIC BDM_cPrChgResErrLv1InitTiDeb_U16 "预充电阻故障等级1故障初始化成熟时间" VALUE 0x0000 /* @ECU_Address@BDM_cPrChgResErrLv1InitTiDeb_U16@ */ Scalar_UWORD 0 BMS_CM_uint16 0 65535 /end CHARACTERISTIC
/begin CHARACTERISTIC BDM_cPrChgResErrLv1TiDeb_U16 "预充电阻故障等级1故障成熟时间" VALUE 0x0000 /* @ECU_Address@BDM_cPrChgResErrLv1TiDeb_U16@ */ Scalar_UWORD 0 BMS_CM_uint16 0 65535 /end CHARACTERISTIC
/begin CHARACTERISTIC BDM_cPrChgResErrLv1Value_F32 "预充电阻故障等级1故障阈值" VALUE 0x0000 /* @ECU_Address@BDM_cPrChgResErrLv1Value_F32@ */ Scalar_FLOAT32_IEEE 0 BMS_CM_single -3.4e+38 3.4e+38 /end CHARACTERISTIC
/begin CHARACTERISTIC BDM_cRlyTempHiLv1En_U8 "继电器温度过高等级1故障诊断使能" VALUE 0x0000 /* @ECU_Address@BDM_cRlyTempHiLv1En_U8@ */ Scalar_UBYTE 0 BMS_CM_uint8 0 255 /end CHARACTERISTIC
/begin CHARACTERISTIC BDM_cRlyTempHiLv1HealEn_U8 "继电器温度过高等级1故障恢复使能" VALUE 0x0000 /* @ECU_Address@BDM_cRlyTempHiLv1HealEn_U8@ */ Scalar_UBYTE 0 BMS_CM_uint8 0 255 /end CHARACTERISTIC
/begin CHARACTERISTIC BDM_cRlyTempHiLv1HealTiDeb_U16 "继电器温度过高等级1故障恢复时间" VALUE 0x0000 /* @ECU_Address@BDM_cRlyTempHiLv1HealTiDeb_U16@ */ Scalar_UWORD 0 BMS_CM_uint16 0 65535 /end CHARACTERISTIC
/begin CHARACTERISTIC BDM_cRlyTempHiLv1HealValue_F32 "继电器温度过高等级1恢复阈值" VALUE 0x0000 /* @ECU_Address@BDM_cRlyTempHiLv1HealValue_F32@ */ Scalar_FLOAT32_IEEE 0 BMS_CM_single -3.4e+38 3.4e+38 /end CHARACTERISTIC
/begin CHARACTERISTIC BDM_cRlyTempHiLv1InitTiDeb_U16 "继电器温度过高等级1故障初始化成熟时间" VALUE 0x0000 /* @ECU_Address@BDM_cRlyTempHiLv1InitTiDeb_U16@ */ Scalar_UWORD 0 BMS_CM_uint16 0 65535 /end CHARACTERISTIC
/begin CHARACTERISTIC BDM_cRlyTempHiLv1TiDeb_U16 "继电器温度过高等级1故障成熟时间" VALUE 0x0000 /* @ECU_Address@BDM_cRlyTempHiLv1TiDeb_U16@ */ Scalar_UWORD 0 BMS_CM_uint16 0 65535 /end CHARACTERISTIC
/begin CHARACTERISTIC BDM_cRlyTempHiLv1Value_F32 "继电器温度过高等级1故障阈值" VALUE 0x0000 /* @ECU_Address@BDM_cRlyTempHiLv1Value_F32@ */ Scalar_FLOAT32_IEEE 0 BMS_CM_single -3.4e+38 3.4e+38 /end CHARACTERISTIC
/begin CHARACTERISTIC BDM_cRlyTempHiLv2En_U8 "继电器温度过高等级2故障诊断使能" VALUE 0x0000 /* @ECU_Address@BDM_cRlyTempHiLv2En_U8@ */ Scalar_UBYTE 0 BMS_CM_uint8 0 255 /end CHARACTERISTIC
/begin CHARACTERISTIC BDM_cRlyTempHiLv2HealEn_U8 "继电器温度过高等级2故障恢复使能" VALUE 0x0000 /* @ECU_Address@BDM_cRlyTempHiLv2HealEn_U8@ */ Scalar_UBYTE 0 BMS_CM_uint8 0 255 /end CHARACTERISTIC
/begin CHARACTERISTIC BDM_cRlyTempHiLv2HealTiDeb_U16 "继电器温度过高等级2故障恢复时间" VALUE 0x0000 /* @ECU_Address@BDM_cRlyTempHiLv2HealTiDeb_U16@ */ Scalar_UWORD 0 BMS_CM_uint16 0 65535 /end CHARACTERISTIC
/begin CHARACTERISTIC BDM_cRlyTempHiLv2HealValue_F32 "继电器温度过高等级2恢复阈值" VALUE 0x0000 /* @ECU_Address@BDM_cRlyTempHiLv2HealValue_F32@ */ Scalar_FLOAT32_IEEE 0 BMS_CM_single -3.4e+38 3.4e+38 /end CHARACTERISTIC
/begin CHARACTERISTIC BDM_cRlyTempHiLv2InitTiDeb_U16 "继电器温度过高等级2故障初始化成熟时间" VALUE 0x0000 /* @ECU_Address@BDM_cRlyTempHiLv2InitTiDeb_U16@ */ Scalar_UWORD 0 BMS_CM_uint16 0 65535 /end CHARACTERISTIC
/begin CHARACTERISTIC BDM_cRlyTempHiLv2TiDeb_U16 "继电器温度过高等级2故障成熟时间" VALUE 0x0000 /* @ECU_Address@BDM_cRlyTempHiLv2TiDeb_U16@ */ Scalar_UWORD 0 BMS_CM_uint16 0 65535 /end CHARACTERISTIC
/begin CHARACTERISTIC BDM_cRlyTempHiLv2Value_F32 "继电器温度过高等级2故障阈值" VALUE 0x0000 /* @ECU_Address@BDM_cRlyTempHiLv2Value_F32@ */ Scalar_FLOAT32_IEEE 0 BMS_CM_single -3.4e+38 3.4e+38 /end CHARACTERISTIC
/begin CHARACTERISTIC BDM_cSOCDiffHiLv1En_U8 "SOC差异过大等级1故障诊断使能" VALUE 0x0000 /* @ECU_Address@BDM_cSOCDiffHiLv1En_U8@ */ Scalar_UBYTE 0 BMS_CM_uint8 0 255 /end CHARACTERISTIC
/begin CHARACTERISTIC BDM_cSOCDiffHiLv1HealEn_U8 "SOC差异过大等级1故障恢复使能" VALUE 0x0000 /* @ECU_Address@BDM_cSOCDiffHiLv1HealEn_U8@ */ Scalar_UBYTE 0 BMS_CM_uint8 0 255 /end CHARACTERISTIC
/begin CHARACTERISTIC BDM_cSOCDiffHiLv1HealTiDeb_U16 "SOC差异过大等级1故障恢复时间" VALUE 0x0000 /* @ECU_Address@BDM_cSOCDiffHiLv1HealTiDeb_U16@ */ Scalar_UWORD 0 BMS_CM_uint16 0 65535 /end CHARACTERISTIC
/begin CHARACTERISTIC BDM_cSOCDiffHiLv1HealValue_F32 "SOC差异过大等级1恢复阈值" VALUE 0x0000 /* @ECU_Address@BDM_cSOCDiffHiLv1HealValue_F32@ */ Scalar_FLOAT32_IEEE 0 BMS_CM_single -3.4e+38 3.4e+38 /end CHARACTERISTIC
/begin CHARACTERISTIC BDM_cSOCDiffHiLv1InitTiDeb_U16 "SOC差异过大等级1故障初始化成熟时间" VALUE 0x0000 /* @ECU_Address@BDM_cSOCDiffHiLv1InitTiDeb_U16@ */ Scalar_UWORD 0 BMS_CM_uint16 0 65535 /end CHARACTERISTIC
/begin CHARACTERISTIC BDM_cSOCDiffHiLv1TiDeb_U16 "SOC差异过大等级1故障成熟时间" VALUE 0x0000 /* @ECU_Address@BDM_cSOCDiffHiLv1TiDeb_U16@ */ Scalar_UWORD 0 BMS_CM_uint16 0 65535 /end CHARACTERISTIC
/begin CHARACTERISTIC BDM_cSOCDiffHiLv1Value_F32 "SOC差异过大等级1故障阈值" VALUE 0x0000 /* @ECU_Address@BDM_cSOCDiffHiLv1Value_F32@ */ Scalar_FLOAT32_IEEE 0 BMS_CM_single -3.4e+38 3.4e+38 /end CHARACTERISTIC
/begin CHARACTERISTIC BDM_cSOCHiLv1En_U8 "SOC过高等级1故障诊断使能" VALUE 0x0000 /* @ECU_Address@BDM_cSOCHiLv1En_U8@ */ Scalar_UBYTE 0 BMS_CM_uint8 0 255 /end CHARACTERISTIC
/begin CHARACTERISTIC BDM_cSOCHiLv1HealEn_U8 "SOC过高等级1故障恢复使能" VALUE 0x0000 /* @ECU_Address@BDM_cSOCHiLv1HealEn_U8@ */ Scalar_UBYTE 0 BMS_CM_uint8 0 255 /end CHARACTERISTIC
/begin CHARACTERISTIC BDM_cSOCHiLv1HealTiDeb_U16 "SOC过高等级1故障恢复时间" VALUE 0x0000 /* @ECU_Address@BDM_cSOCHiLv1HealTiDeb_U16@ */ Scalar_UWORD 0 BMS_CM_uint16 0 65535 /end CHARACTERISTIC
/begin CHARACTERISTIC BDM_cSOCHiLv1HealValue_F32 "SOC过高等级1恢复阈值" VALUE 0x0000 /* @ECU_Address@BDM_cSOCHiLv1HealValue_F32@ */ Scalar_FLOAT32_IEEE 0 BMS_CM_single -3.4e+38 3.4e+38 /end CHARACTERISTIC
/begin CHARACTERISTIC BDM_cSOCHiLv1InitTiDeb_U16 "SOC过高等级1故障初始化成熟时间" VALUE 0x0000 /* @ECU_Address@BDM_cSOCHiLv1InitTiDeb_U16@ */ Scalar_UWORD 0 BMS_CM_uint16 0 65535 /end CHARACTERISTIC
/begin CHARACTERISTIC BDM_cSOCHiLv1TiDeb_U16 "SOC过高等级1故障成熟时间" VALUE 0x0000 /* @ECU_Address@BDM_cSOCHiLv1TiDeb_U16@ */ Scalar_UWORD 0 BMS_CM_uint16 0 65535 /end CHARACTERISTIC
/begin CHARACTERISTIC BDM_cSOCHiLv1Value_F32 "SOC过高等级1故障阈值" VALUE 0x0000 /* @ECU_Address@BDM_cSOCHiLv1Value_F32@ */ Scalar_FLOAT32_IEEE 0 BMS_CM_single -3.4e+38 3.4e+38 /end CHARACTERISTIC
/begin CHARACTERISTIC BDM_cSOCJumpHiLv1En_U8 "SOC跳变过大等级1故障诊断使能" VALUE 0x0000 /* @ECU_Address@BDM_cSOCJumpHiLv1En_U8@ */ Scalar_UBYTE 0 BMS_CM_uint8 0 255 /end CHARACTERISTIC
/begin CHARACTERISTIC BDM_cSOCJumpHiLv1HealEn_U8 "SOC跳变过大等级1故障恢复使能" VALUE 0x0000 /* @ECU_Address@BDM_cSOCJumpHiLv1HealEn_U8@ */ Scalar_UBYTE 0 BMS_CM_uint8 0 255 /end CHARACTERISTIC
/begin CHARACTERISTIC BDM_cSOCJumpHiLv1HealTiDeb_U16 "SOC跳变过大等级1故障恢复时间" VALUE 0x0000 /* @ECU_Address@BDM_cSOCJumpHiLv1HealTiDeb_U16@ */ Scalar_UWORD 0 BMS_CM_uint16 0 65535 /end CHARACTERISTIC
/begin CHARACTERISTIC BDM_cSOCJumpHiLv1HealValue_F32 "SOC跳变过大等级1恢复阈值" VALUE 0x0000 /* @ECU_Address@BDM_cSOCJumpHiLv1HealValue_F32@ */ Scalar_FLOAT32_IEEE 0 BMS_CM_single -3.4e+38 3.4e+38 /end CHARACTERISTIC
/begin CHARACTERISTIC BDM_cSOCJumpHiLv1InitTiDeb_U16 "SOC跳变过大等级1故障初始化成熟时间" VALUE 0x0000 /* @ECU_Address@BDM_cSOCJumpHiLv1InitTiDeb_U16@ */ Scalar_UWORD 0 BMS_CM_uint16 0 65535 /end CHARACTERISTIC
/begin CHARACTERISTIC BDM_cSOCJumpHiLv1TiDeb_U16 "SOC跳变过大等级1故障成熟时间" VALUE 0x0000 /* @ECU_Address@BDM_cSOCJumpHiLv1TiDeb_U16@ */ Scalar_UWORD 0 BMS_CM_uint16 0 65535 /end CHARACTERISTIC
/begin CHARACTERISTIC BDM_cSOCJumpHiLv1Value_F32 "SOC跳变过大等级1故障阈值" VALUE 0x0000 /* @ECU_Address@BDM_cSOCJumpHiLv1Value_F32@ */ Scalar_FLOAT32_IEEE 0 BMS_CM_single -3.4e+38 3.4e+38 /end CHARACTERISTIC
/begin CHARACTERISTIC BDM_cSOCLoLv1En_U8 "SOC过低等级1故障诊断使能" VALUE 0x0000 /* @ECU_Address@BDM_cSOCLoLv1En_U8@ */ Scalar_UBYTE 0 BMS_CM_uint8 0 255 /end CHARACTERISTIC
/begin CHARACTERISTIC BDM_cSOCLoLv1HealEn_U8 "SOC过低等级1故障恢复使能" VALUE 0x0000 /* @ECU_Address@BDM_cSOCLoLv1HealEn_U8@ */ Scalar_UBYTE 0 BMS_CM_uint8 0 255 /end CHARACTERISTIC
/begin CHARACTERISTIC BDM_cSOCLoLv1HealTiDeb_U16 "SOC过低等级1故障恢复时间" VALUE 0x0000 /* @ECU_Address@BDM_cSOCLoLv1HealTiDeb_U16@ */ Scalar_UWORD 0 BMS_CM_uint16 0 65535 /end CHARACTERISTIC
/begin CHARACTERISTIC BDM_cSOCLoLv1HealValue_F32 "SOC过低等级1恢复阈值" VALUE 0x0000 /* @ECU_Address@BDM_cSOCLoLv1HealValue_F32@ */ Scalar_FLOAT32_IEEE 0 BMS_CM_single -3.4e+38 3.4e+38 /end CHARACTERISTIC
/begin CHARACTERISTIC BDM_cSOCLoLv1InitTiDeb_U16 "SOC过低等级1故障初始化成熟时间" VALUE 0x0000 /* @ECU_Address@BDM_cSOCLoLv1InitTiDeb_U16@ */ Scalar_UWORD 0 BMS_CM_uint16 0 65535 /end CHARACTERISTIC
/begin CHARACTERISTIC BDM_cSOCLoLv1TiDeb_U16 "SOC过低等级1故障成熟时间" VALUE 0x0000 /* @ECU_Address@BDM_cSOCLoLv1TiDeb_U16@ */ Scalar_UWORD 0 BMS_CM_uint16 0 65535 /end CHARACTERISTIC
/begin CHARACTERISTIC BDM_cSOCLoLv1Value_F32 "SOC过低等级1故障阈值" VALUE 0x0000 /* @ECU_Address@BDM_cSOCLoLv1Value_F32@ */ Scalar_FLOAT32_IEEE 0 BMS_CM_single -3.4e+38 3.4e+38 /end CHARACTERISTIC
/begin CHARACTERISTIC BDM_cSOCLoLv2En_U8 "SOC过低等级2故障诊断使能" VALUE 0x0000 /* @ECU_Address@BDM_cSOCLoLv2En_U8@ */ Scalar_UBYTE 0 BMS_CM_uint8 0 255 /end CHARACTERISTIC
/begin CHARACTERISTIC BDM_cSOCLoLv2HealEn_U8 "SOC过低等级2故障恢复使能" VALUE 0x0000 /* @ECU_Address@BDM_cSOCLoLv2HealEn_U8@ */ Scalar_UBYTE 0 BMS_CM_uint8 0 255 /end CHARACTERISTIC
/begin CHARACTERISTIC BDM_cSOCLoLv2HealTiDeb_U16 "SOC过低等级2故障恢复时间" VALUE 0x0000 /* @ECU_Address@BDM_cSOCLoLv2HealTiDeb_U16@ */ Scalar_UWORD 0 BMS_CM_uint16 0 65535 /end CHARACTERISTIC
/begin CHARACTERISTIC BDM_cSOCLoLv2HealValue_F32 "SOC过低等级2恢复阈值" VALUE 0x0000 /* @ECU_Address@BDM_cSOCLoLv2HealValue_F32@ */ Scalar_FLOAT32_IEEE 0 BMS_CM_single -3.4e+38 3.4e+38 /end CHARACTERISTIC
/begin CHARACTERISTIC BDM_cSOCLoLv2InitTiDeb_U16 "SOC过低等级2故障初始化成熟时间" VALUE 0x0000 /* @ECU_Address@BDM_cSOCLoLv2InitTiDeb_U16@ */ Scalar_UWORD 0 BMS_CM_uint16 0 65535 /end CHARACTERISTIC
/begin CHARACTERISTIC BDM_cSOCLoLv2TiDeb_U16 "SOC过低等级2故障成熟时间" VALUE 0x0000 /* @ECU_Address@BDM_cSOCLoLv2TiDeb_U16@ */ Scalar_UWORD 0 BMS_CM_uint16 0 65535 /end CHARACTERISTIC
/begin CHARACTERISTIC BDM_cSOCLoLv2Value_F32 "SOC过低等级2故障阈值" VALUE 0x0000 /* @ECU_Address@BDM_cSOCLoLv2Value_F32@ */ Scalar_FLOAT32_IEEE 0 BMS_CM_single -3.4e+38 3.4e+38 /end CHARACTERISTIC
/begin CHARACTERISTIC BDM_cSOCLoLv3En_U8 "SOC过低等级3故障诊断使能" VALUE 0x0000 /* @ECU_Address@BDM_cSOCLoLv3En_U8@ */ Scalar_UBYTE 0 BMS_CM_uint8 0 255 /end CHARACTERISTIC
/begin CHARACTERISTIC BDM_cSOCLoLv3HealEn_U8 "SOC过低等级3故障恢复使能" VALUE 0x0000 /* @ECU_Address@BDM_cSOCLoLv3HealEn_U8@ */ Scalar_UBYTE 0 BMS_CM_uint8 0 255 /end CHARACTERISTIC
/begin CHARACTERISTIC BDM_cSOCLoLv3HealTiDeb_U16 "SOC过低等级3故障恢复时间" VALUE 0x0000 /* @ECU_Address@BDM_cSOCLoLv3HealTiDeb_U16@ */ Scalar_UWORD 0 BMS_CM_uint16 0 65535 /end CHARACTERISTIC
/begin CHARACTERISTIC BDM_cSOCLoLv3HealValue_F32 "SOC过低等级3恢复阈值" VALUE 0x0000 /* @ECU_Address@BDM_cSOCLoLv3HealValue_F32@ */ Scalar_FLOAT32_IEEE 0 BMS_CM_single -3.4e+38 3.4e+38 /end CHARACTERISTIC
/begin CHARACTERISTIC BDM_cSOCLoLv3InitTiDeb_U16 "SOC过低等级3故障初始化成熟时间" VALUE 0x0000 /* @ECU_Address@BDM_cSOCLoLv3InitTiDeb_U16@ */ Scalar_UWORD 0 BMS_CM_uint16 0 65535 /end CHARACTERISTIC
/begin CHARACTERISTIC BDM_cSOCLoLv3TiDeb_U16 "SOC过低等级3故障成熟时间" VALUE 0x0000 /* @ECU_Address@BDM_cSOCLoLv3TiDeb_U16@ */ Scalar_UWORD 0 BMS_CM_uint16 0 65535 /end CHARACTERISTIC
/begin CHARACTERISTIC BDM_cSOCLoLv3Value_F32 "SOC过低等级3故障阈值" VALUE 0x0000 /* @ECU_Address@BDM_cSOCLoLv3Value_F32@ */ Scalar_FLOAT32_IEEE 0 BMS_CM_single -3.4e+38 3.4e+38 /end CHARACTERISTIC
/begin CHARACTERISTIC BDM_cSOHLoLv1En_U8 "SOH过低等级1故障诊断使能" VALUE 0x0000 /* @ECU_Address@BDM_cSOHLoLv1En_U8@ */ Scalar_UBYTE 0 BMS_CM_uint8 0 255 /end CHARACTERISTIC
/begin CHARACTERISTIC BDM_cSOHLoLv1HealEn_U8 "SOH过低等级1故障恢复使能" VALUE 0x0000 /* @ECU_Address@BDM_cSOHLoLv1HealEn_U8@ */ Scalar_UBYTE 0 BMS_CM_uint8 0 255 /end CHARACTERISTIC
/begin CHARACTERISTIC BDM_cSOHLoLv1HealTiDeb_U16 "SOH过低等级1故障恢复时间" VALUE 0x0000 /* @ECU_Address@BDM_cSOHLoLv1HealTiDeb_U16@ */ Scalar_UWORD 0 BMS_CM_uint16 0 65535 /end CHARACTERISTIC
/begin CHARACTERISTIC BDM_cSOHLoLv1HealValue_F32 "SOH过低等级1恢复阈值" VALUE 0x0000 /* @ECU_Address@BDM_cSOHLoLv1HealValue_F32@ */ Scalar_FLOAT32_IEEE 0 BMS_CM_single -3.4e+38 3.4e+38 /end CHARACTERISTIC
/begin CHARACTERISTIC BDM_cSOHLoLv1InitTiDeb_U16 "SOH过低等级1故障初始化成熟时间" VALUE 0x0000 /* @ECU_Address@BDM_cSOHLoLv1InitTiDeb_U16@ */ Scalar_UWORD 0 BMS_CM_uint16 0 65535 /end CHARACTERISTIC
/begin CHARACTERISTIC BDM_cSOHLoLv1TiDeb_U16 "SOH过低等级1故障成熟时间" VALUE 0x0000 /* @ECU_Address@BDM_cSOHLoLv1TiDeb_U16@ */ Scalar_UWORD 0 BMS_CM_uint16 0 65535 /end CHARACTERISTIC
/begin CHARACTERISTIC BDM_cSOHLoLv1Value_F32 "SOH过低等级1故障阈值" VALUE 0x0000 /* @ECU_Address@BDM_cSOHLoLv1Value_F32@ */ Scalar_FLOAT32_IEEE 0 BMS_CM_single -3.4e+38 3.4e+38 /end CHARACTERISTIC
/begin CHARACTERISTIC BDM_cSOHLoLv2En_U8 "SOH过低等级2故障诊断使能" VALUE 0x0000 /* @ECU_Address@BDM_cSOHLoLv2En_U8@ */ Scalar_UBYTE 0 BMS_CM_uint8 0 255 /end CHARACTERISTIC
/begin CHARACTERISTIC BDM_cSOHLoLv2HealEn_U8 "SOH过低等级2故障恢复使能" VALUE 0x0000 /* @ECU_Address@BDM_cSOHLoLv2HealEn_U8@ */ Scalar_UBYTE 0 BMS_CM_uint8 0 255 /end CHARACTERISTIC
/begin CHARACTERISTIC BDM_cSOHLoLv2HealTiDeb_U16 "SOH过低等级2故障恢复时间" VALUE 0x0000 /* @ECU_Address@BDM_cSOHLoLv2HealTiDeb_U16@ */ Scalar_UWORD 0 BMS_CM_uint16 0 65535 /end CHARACTERISTIC
/begin CHARACTERISTIC BDM_cSOHLoLv2HealValue_F32 "SOH过低等级2恢复阈值" VALUE 0x0000 /* @ECU_Address@BDM_cSOHLoLv2HealValue_F32@ */ Scalar_FLOAT32_IEEE 0 BMS_CM_single -3.4e+38 3.4e+38 /end CHARACTERISTIC
/begin CHARACTERISTIC BDM_cSOHLoLv2InitTiDeb_U16 "SOH过低等级2故障初始化成熟时间" VALUE 0x0000 /* @ECU_Address@BDM_cSOHLoLv2InitTiDeb_U16@ */ Scalar_UWORD 0 BMS_CM_uint16 0 65535 /end CHARACTERISTIC
/begin CHARACTERISTIC BDM_cSOHLoLv2TiDeb_U16 "SOH过低等级2故障成熟时间" VALUE 0x0000 /* @ECU_Address@BDM_cSOHLoLv2TiDeb_U16@ */ Scalar_UWORD 0 BMS_CM_uint16 0 65535 /end CHARACTERISTIC
/begin CHARACTERISTIC BDM_cSOHLoLv2Value_F32 "SOH过低等级2故障阈值" VALUE 0x0000 /* @ECU_Address@BDM_cSOHLoLv2Value_F32@ */ Scalar_FLOAT32_IEEE 0 BMS_CM_single -3.4e+38 3.4e+38 /end CHARACTERISTIC
/begin CHARACTERISTIC BDM_cThermalMagDisChgCurLoLv1En_U8 "放电热管理电流过低等级1故障诊断使能" VALUE 0x0000 /* @ECU_Address@BDM_cThermalMagDisChgCurLoLv1En_U8@ */ Scalar_UBYTE 0 BMS_CM_uint8 0 255 /end CHARACTERISTIC
/begin CHARACTERISTIC BDM_cThermalMagDisChgCurLoLv1HealEn_U8 "放电热管理电流过低等级1故障恢复使能" VALUE 0x0000 /* @ECU_Address@BDM_cThermalMagDisChgCurLoLv1HealEn_U8@ */ Scalar_UBYTE 0 BMS_CM_uint8 0 255 /end CHARACTERISTIC
/begin CHARACTERISTIC BDM_cThermalMagDisChgCurLoLv1HealTiDeb_U16 "放电热管理电流过低等级1故障恢复时间" VALUE 0x0000 /* @ECU_Address@BDM_cThermalMagDisChgCurLoLv1HealTiDeb_U16@ */ Scalar_UWORD 0 BMS_CM_uint16 0 65535 /end CHARACTERISTIC
/begin CHARACTERISTIC BDM_cThermalMagDisChgCurLoLv1InitTiDeb_U16 "放电热管理电流过低等级1故障初始化成熟时间" VALUE 0x0000 /* @ECU_Address@BDM_cThermalMagDisChgCurLoLv1InitTiDeb_U16@ */ Scalar_UWORD 0 BMS_CM_uint16 0 65535 /end CHARACTERISTIC
/begin CHARACTERISTIC BDM_cThermalMagDisChgCurLoLv1TiDeb_U32 "放电热管理电流过低等级1故障成熟时间" VALUE 0x0000 /* @ECU_Address@BDM_cThermalMagDisChgCurLoLv1TiDeb_U32@ */ Scalar_ULONG 0 BMS_CM_uint32 0 4.29497e+09 /end CHARACTERISTIC
/begin CHARACTERISTIC BDM_cWtrInTempHiLv1En_U8 "进水口温度过高等级1故障诊断使能" VALUE 0x0000 /* @ECU_Address@BDM_cWtrInTempHiLv1En_U8@ */ Scalar_UBYTE 0 BMS_CM_uint8 0 255 /end CHARACTERISTIC
/begin CHARACTERISTIC BDM_cWtrInTempHiLv1HealEn_U8 "进水口温度过高等级1故障恢复使能" VALUE 0x0000 /* @ECU_Address@BDM_cWtrInTempHiLv1HealEn_U8@ */ Scalar_UBYTE 0 BMS_CM_uint8 0 255 /end CHARACTERISTIC
/begin CHARACTERISTIC BDM_cWtrInTempHiLv1HealTiDeb_U16 "进水口温度过高等级1故障恢复时间" VALUE 0x0000 /* @ECU_Address@BDM_cWtrInTempHiLv1HealTiDeb_U16@ */ Scalar_UWORD 0 BMS_CM_uint16 0 65535 /end CHARACTERISTIC
/begin CHARACTERISTIC BDM_cWtrInTempHiLv1HealValue_F32 "进水口温度过高等级1恢复阈值" VALUE 0x0000 /* @ECU_Address@BDM_cWtrInTempHiLv1HealValue_F32@ */ Scalar_FLOAT32_IEEE 0 BMS_CM_single -3.4e+38 3.4e+38 /end CHARACTERISTIC
/begin CHARACTERISTIC BDM_cWtrInTempHiLv1InitTiDeb_U16 "进水口温度过高等级1故障初始化成熟时间" VALUE 0x0000 /* @ECU_Address@BDM_cWtrInTempHiLv1InitTiDeb_U16@ */ Scalar_UWORD 0 BMS_CM_uint16 0 65535 /end CHARACTERISTIC
/begin CHARACTERISTIC BDM_cWtrInTempHiLv1TiDeb_U16 "进水口温度过高等级1故障成熟时间" VALUE 0x0000 /* @ECU_Address@BDM_cWtrInTempHiLv1TiDeb_U16@ */ Scalar_UWORD 0 BMS_CM_uint16 0 65535 /end CHARACTERISTIC
/begin CHARACTERISTIC BDM_cWtrInTempHiLv1Value_F32 "进水口温度过高等级1故障阈值" VALUE 0x0000 /* @ECU_Address@BDM_cWtrInTempHiLv1Value_F32@ */ Scalar_FLOAT32_IEEE 0 BMS_CM_single -3.4e+38 3.4e+38 /end CHARACTERISTIC
/begin CHARACTERISTIC BDM_cWtrInTempLoLv1En_U8 "进水口温度过低等级1故障诊断使能" VALUE 0x0000 /* @ECU_Address@BDM_cWtrInTempLoLv1En_U8@ */ Scalar_UBYTE 0 BMS_CM_uint8 0 255 /end CHARACTERISTIC
/begin CHARACTERISTIC BDM_cWtrInTempLoLv1HealEn_U8 "进水口温度过低等级1故障恢复使能" VALUE 0x0000 /* @ECU_Address@BDM_cWtrInTempLoLv1HealEn_U8@ */ Scalar_UBYTE 0 BMS_CM_uint8 0 255 /end CHARACTERISTIC
/begin CHARACTERISTIC BDM_cWtrInTempLoLv1HealTiDeb_U16 "进水口温度过低等级1故障恢复时间" VALUE 0x0000 /* @ECU_Address@BDM_cWtrInTempLoLv1HealTiDeb_U16@ */ Scalar_UWORD 0 BMS_CM_uint16 0 65535 /end CHARACTERISTIC
/begin CHARACTERISTIC BDM_cWtrInTempLoLv1HealValue_F32 "进水口温度过低等级1恢复阈值" VALUE 0x0000 /* @ECU_Address@BDM_cWtrInTempLoLv1HealValue_F32@ */ Scalar_FLOAT32_IEEE 0 BMS_CM_single -3.4e+38 3.4e+38 /end CHARACTERISTIC
/begin CHARACTERISTIC BDM_cWtrInTempLoLv1InitTiDeb_U16 "进水口温度过低等级1故障初始化成熟时间" VALUE 0x0000 /* @ECU_Address@BDM_cWtrInTempLoLv1InitTiDeb_U16@ */ Scalar_UWORD 0 BMS_CM_uint16 0 65535 /end CHARACTERISTIC
/begin CHARACTERISTIC BDM_cWtrInTempLoLv1TiDeb_U16 "进水口温度过低等级1故障成熟时间" VALUE 0x0000 /* @ECU_Address@BDM_cWtrInTempLoLv1TiDeb_U16@ */ Scalar_UWORD 0 BMS_CM_uint16 0 65535 /end CHARACTERISTIC
/begin CHARACTERISTIC BDM_cWtrInTempLoLv1Value_F32 "进水口温度过低等级1故障阈值" VALUE 0x0000 /* @ECU_Address@BDM_cWtrInTempLoLv1Value_F32@ */ Scalar_FLOAT32_IEEE 0 BMS_CM_single -3.4e+38 3.4e+38 /end CHARACTERISTIC
/begin CHARACTERISTIC BDM_cWtrOutTempHiLv1En_U8 "出水口温度过高等级1故障诊断使能" VALUE 0x0000 /* @ECU_Address@BDM_cWtrOutTempHiLv1En_U8@ */ Scalar_UBYTE 0 BMS_CM_uint8 0 255 /end CHARACTERISTIC
/begin CHARACTERISTIC BDM_cWtrOutTempHiLv1HealEn_U8 "出水口温度过高等级1故障恢复使能" VALUE 0x0000 /* @ECU_Address@BDM_cWtrOutTempHiLv1HealEn_U8@ */ Scalar_UBYTE 0 BMS_CM_uint8 0 255 /end CHARACTERISTIC
/begin CHARACTERISTIC BDM_cWtrOutTempHiLv1HealTiDeb_U16 "出水口温度过高等级1故障恢复时间" VALUE 0x0000 /* @ECU_Address@BDM_cWtrOutTempHiLv1HealTiDeb_U16@ */ Scalar_UWORD 0 BMS_CM_uint16 0 65535 /end CHARACTERISTIC
/begin CHARACTERISTIC BDM_cWtrOutTempHiLv1HealValue_F32 "出水口温度过高等级1恢复阈值" VALUE 0x0000 /* @ECU_Address@BDM_cWtrOutTempHiLv1HealValue_F32@ */ Scalar_FLOAT32_IEEE 0 BMS_CM_single -3.4e+38 3.4e+38 /end CHARACTERISTIC
/begin CHARACTERISTIC BDM_cWtrOutTempHiLv1InitTiDeb_U16 "出水口温度过高等级1故障初始化成熟时间" VALUE 0x0000 /* @ECU_Address@BDM_cWtrOutTempHiLv1InitTiDeb_U16@ */ Scalar_UWORD 0 BMS_CM_uint16 0 65535 /end CHARACTERISTIC
/begin CHARACTERISTIC BDM_cWtrOutTempHiLv1TiDeb_U16 "出水口温度过高等级1故障成熟时间" VALUE 0x0000 /* @ECU_Address@BDM_cWtrOutTempHiLv1TiDeb_U16@ */ Scalar_UWORD 0 BMS_CM_uint16 0 65535 /end CHARACTERISTIC
/begin CHARACTERISTIC BDM_cWtrOutTempHiLv1Value_F32 "出水口温度过高等级1故障阈值" VALUE 0x0000 /* @ECU_Address@BDM_cWtrOutTempHiLv1Value_F32@ */ Scalar_FLOAT32_IEEE 0 BMS_CM_single -3.4e+38 3.4e+38 /end CHARACTERISTIC
/begin CHARACTERISTIC BDM_cWtrOutTempLoLv1En_U8 "出水口温度过低等级1故障诊断使能" VALUE 0x0000 /* @ECU_Address@BDM_cWtrOutTempLoLv1En_U8@ */ Scalar_UBYTE 0 BMS_CM_uint8 0 255 /end CHARACTERISTIC
/begin CHARACTERISTIC BDM_cWtrOutTempLoLv1HealEn_U8 "出水口温度过低等级1故障恢复使能" VALUE 0x0000 /* @ECU_Address@BDM_cWtrOutTempLoLv1HealEn_U8@ */ Scalar_UBYTE 0 BMS_CM_uint8 0 255 /end CHARACTERISTIC
/begin CHARACTERISTIC BDM_cWtrOutTempLoLv1HealTiDeb_U16 "出水口温度过低等级1故障恢复时间" VALUE 0x0000 /* @ECU_Address@BDM_cWtrOutTempLoLv1HealTiDeb_U16@ */ Scalar_UWORD 0 BMS_CM_uint16 0 65535 /end CHARACTERISTIC
/begin CHARACTERISTIC BDM_cWtrOutTempLoLv1HealValue_F32 "出水口温度过低等级1恢复阈值" VALUE 0x0000 /* @ECU_Address@BDM_cWtrOutTempLoLv1HealValue_F32@ */ Scalar_FLOAT32_IEEE 0 BMS_CM_single -3.4e+38 3.4e+38 /end CHARACTERISTIC
/begin CHARACTERISTIC BDM_cWtrOutTempLoLv1InitTiDeb_U16 "出水口温度过低等级1故障初始化成熟时间" VALUE 0x0000 /* @ECU_Address@BDM_cWtrOutTempLoLv1InitTiDeb_U16@ */ Scalar_UWORD 0 BMS_CM_uint16 0 65535 /end CHARACTERISTIC
/begin CHARACTERISTIC BDM_cWtrOutTempLoLv1TiDeb_U16 "出水口温度过低等级1故障成熟时间" VALUE 0x0000 /* @ECU_Address@BDM_cWtrOutTempLoLv1TiDeb_U16@ */ Scalar_UWORD 0 BMS_CM_uint16 0 65535 /end CHARACTERISTIC
/begin CHARACTERISTIC BDM_cWtrOutTempLoLv1Value_F32 "出水口温度过低等级1故障阈值" VALUE 0x0000 /* @ECU_Address@BDM_cWtrOutTempLoLv1Value_F32@ */ Scalar_FLOAT32_IEEE 0 BMS_CM_single -3.4e+38 3.4e+38 /end CHARACTERISTIC
/begin CHARACTERISTIC BDM_ccCellVoltHiLv1HealTiDeb_U16 "单体电压过高等级1故障恢复时间" VALUE 0x0000 /* @ECU_Address@BDM_ccCellVoltHiLv1HealTiDeb_U16@ */ Scalar_UWORD 0 BMS_CM_uint16 0 65535 /end CHARACTERISTIC
/begin CHARACTERISTIC BDM_ccCellVoltHiLv1TiDeb_U16 "单体电压过高等级1故障成熟时间" VALUE 0x0000 /* @ECU_Address@BDM_ccCellVoltHiLv1TiDeb_U16@ */ Scalar_UWORD 0 BMS_CM_uint16 0 65535 /end CHARACTERISTIC
/begin CHARACTERISTIC BDM_ccCellVoltHiLv2HealTiDeb_U16 "单体电压过高等级2故障恢复时间" VALUE 0x0000 /* @ECU_Address@BDM_ccCellVoltHiLv2HealTiDeb_U16@ */ Scalar_UWORD 0 BMS_CM_uint16 0 65535 /end CHARACTERISTIC
/begin CHARACTERISTIC BDM_ccCellVoltHiLv2TiDeb_U16 "单体电压过高等级2故障成熟时间" VALUE 0x0000 /* @ECU_Address@BDM_ccCellVoltHiLv2TiDeb_U16@ */ Scalar_UWORD 0 BMS_CM_uint16 0 65535 /end CHARACTERISTIC
/begin CHARACTERISTIC BDM_ccCellVoltHiLv3HealTiDeb_U16 "单体电压过高等级3故障恢复时间" VALUE 0x0000 /* @ECU_Address@BDM_ccCellVoltHiLv3HealTiDeb_U16@ */ Scalar_UWORD 0 BMS_CM_uint16 0 65535 /end CHARACTERISTIC
/begin CHARACTERISTIC BDM_ccCellVoltHiLv3TiDeb_U16 "单体电压过高等级3故障成熟时间" VALUE 0x0000 /* @ECU_Address@BDM_ccCellVoltHiLv3TiDeb_U16@ */ Scalar_UWORD 0 BMS_CM_uint16 0 65535 /end CHARACTERISTIC
/begin CHARACTERISTIC BDM_ccCellVoltHiLv4HealTiDeb_U16 "单体电压过高等级4故障恢复时间" VALUE 0x0000 /* @ECU_Address@BDM_ccCellVoltHiLv4HealTiDeb_U16@ */ Scalar_UWORD 0 BMS_CM_uint16 0 65535 /end CHARACTERISTIC
/begin CHARACTERISTIC BDM_ccCellVoltHiLv4TiDeb_U16 "单体电压过高等级4故障成熟时间" VALUE 0x0000 /* @ECU_Address@BDM_ccCellVoltHiLv4TiDeb_U16@ */ Scalar_UWORD 0 BMS_CM_uint16 0 65535 /end CHARACTERISTIC
/begin MEASUREMENT ACM_tDebugACChgEn "SMC慢充模式判断，用于上位机观察" UBYTE BMS_CM_uint8 0 0 0 255 ECU_ADDRESS 0x0000 /* @ECU_Address@ACM_tDebugACChgEn@ */ /end MEASUREMENT
/begin MEASUREMENT ACM_tDebugACChgModeSt_U8 "慢充模式状态，用于上位机观察" UBYTE BMS_CM_uint8 0 0 0 255 ECU_ADDRESS 0x0000 /* @ECU_Address@ACM_tDebugACChgModeSt_U8@ */ /end MEASUREMENT
/begin MEASUREMENT ACM_tDebugChrgLckOp "电子锁状态，用于上位机观察" UBYTE BMS_CM_uint8 0 0 0 255 ECU_ADDRESS 0x0000 /* @ECU_Address@ACM_tDebugChrgLckOp@ */ /end MEASUREMENT
/begin MEASUREMENT SDM_tHVIL1Cycle "高压互锁1PWM频率，用于上位机观察" ULONG BMS_CM_uint32 0 0 0 4.29497e+09 ECU_ADDRESS 0x0000 /* @ECU_Address@SDM_tHVIL1Cycle@ */ /end MEASUREMENT
/begin MEASUREMENT SDM_tHVIL1Duty "高压互锁1PWM占空比，用于上位机观察" ULONG BMS_CM_uint32 0 0 0 4.29497e+09 ECU_ADDRESS 0x0000 /* @ECU_Address@SDM_tHVIL1Duty@ */ /end MEASUREMENT
/begin MEASUREMENT SDM_tHVIL2Cycle "高压互锁2PWM频率，用于上位机观察" ULONG BMS_CM_uint32 0 0 0 4.29497e+09 ECU_ADDRESS 0x0000 /* @ECU_Address@SDM_tHVIL2Cycle@ */ /end MEASUREMENT
/begin MEASUREMENT SDM_tHVIL2Duty "高压互锁2PWM占空比，用于上位机观察" ULONG BMS_CM_uint32 0 0 0 4.29497e+09 ECU_ADDRESS 0x0000 /* @ECU_Address@SDM_tHVIL2Duty@ */ /end MEASUREMENT
/begin MEASUREMENT FCM_tDebugDCChgMod "直流充电状态，用于上位机观察" UBYTE BMS_CM_uint8 0 0 0 255 ECU_ADDRESS 0x0000 /* @ECU_Address@FCM_tDebugDCChgMod@ */ /end MEASUREMENT
/begin MEASUREMENT EEP_tPowerOffOnTime "下电到上电的时间，用于上位机观察" ULONG BMS_CM_uint32 0 0 0 4.29497e+09 ECU_ADDRESS 0x0000 /* @ECU_Address@EEP_tPowerOffOnTime@ */ /end MEASUREMENT
/begin MEASUREMENT LVM_ChangeConnector_CANTimeOut_U8 "换电控制器CAN信息超时，用于上位机观察" UBYTE BMS_CM_uint8 0 0 0 255 ECU_ADDRESS 0x0000 /* @ECU_Address@LVM_ChangeConnector_CANTimeOut_U8@ */ /end MEASUREMENT
/begin MEASUREMENT LVM_ChangeConnector_ConnectErr_U8 "换电连接器连接故障，用于上位机观察" UBYTE BMS_CM_uint8 0 0 0 255 ECU_ADDRESS 0x0000 /* @ECU_Address@LVM_ChangeConnector_ConnectErr_U8@ */ /end MEASUREMENT
/begin MEASUREMENT LVM_ChangeConnector_LockErr_U8 "换电连接器锁止故障，用于上位机观察" UBYTE BMS_CM_uint8 0 0 0 255 ECU_ADDRESS 0x0000 /* @ECU_Address@LVM_ChangeConnector_LockErr_U8@ */ /end MEASUREMENT
/begin MEASUREMENT LVM_ChangeConnector_TempErr_U8 "换电连接器开路故障，用于上位机观察" UBYTE BMS_CM_uint8 0 0 0 255 ECU_ADDRESS 0x0000 /* @ECU_Address@LVM_ChangeConnector_TempErr_U8@ */ /end MEASUREMENT
/begin MEASUREMENT LVM_ChangeConnector_TempHi_U8 "换电连接器过温故障，用于上位机观察" UBYTE BMS_CM_uint8 0 0 0 255 ECU_ADDRESS 0x0000 /* @ECU_Address@LVM_ChangeConnector_TempHi_U8@ */ /end MEASUREMENT
/begin MEASUREMENT LVM_mVehCANErr_U8 "整车CAN通讯故障，用于上位机观察" UBYTE BMS_CM_uint8 0 0 0 255 ECU_ADDRESS 0x0000 /* @ECU_Address@LVM_mVehCANErr_U8@ */ /end MEASUREMENT
/begin MEASUREMENT CDP_PECErr_U8 "PEC（内部通讯）故障，用于上位机观察" UBYTE BMS_CM_uint8 0 0 0 255 ECU_ADDRESS 0x0000 /* @ECU_Address@CDP_PECErr_U8@ */ /end MEASUREMENT
/begin MEASUREMENT SMC_tDebugACChgOffReqSt_U8 "交流充电下电请求，用于上位机观察" UBYTE BMS_CM_uint8 0 0 0 255 ECU_ADDRESS 0x0000 /* @ECU_Address@SMC_tDebugACChgOffReqSt_U8@ */ /end MEASUREMENT
/begin MEASUREMENT SMC_tDebugACChgReqSt_U8 "交流充电请求，用于上位机观察" UBYTE BMS_CM_uint8 0 0 0 255 ECU_ADDRESS 0x0000 /* @ECU_Address@SMC_tDebugACChgReqSt_U8@ */ /end MEASUREMENT
/begin MEASUREMENT SMC_tDebugBMSModeSt_U8 "SMC状态，用于上位机观察" UBYTE BMS_CM_uint8 0 0 0 255 ECU_ADDRESS 0x0000 /* @ECU_Address@SMC_tDebugBMSModeSt_U8@ */ /end MEASUREMENT
/begin MEASUREMENT SMC_tDebugDCChgReqSt_U8 "直流充电上高压请求，用于上位机观察" UBYTE BMS_CM_uint8 0 0 0 255 ECU_ADDRESS 0x0000 /* @ECU_Address@SMC_tDebugDCChgReqSt_U8@ */ /end MEASUREMENT
/begin MEASUREMENT SMC_tDebugDcChgOffReqSt_U8 "直流充电正常下高压请求，用于上位机观察" UBYTE BMS_CM_uint8 0 0 0 255 ECU_ADDRESS 0x0000 /* @ECU_Address@SMC_tDebugDcChgOffReqSt_U8@ */ /end MEASUREMENT
/begin MEASUREMENT SMC_tDebugDiscReqOffSt_U8 "放电正常下电请求，用于上位机观察" UBYTE BMS_CM_uint8 0 0 0 255 ECU_ADDRESS 0x0000 /* @ECU_Address@SMC_tDebugDiscReqOffSt_U8@ */ /end MEASUREMENT
/begin MEASUREMENT SMC_tDebugDiscReqSt_U8 "高压上电请求，用于上位机观察" UBYTE BMS_CM_uint8 0 0 0 255 ECU_ADDRESS 0x0000 /* @ECU_Address@SMC_tDebugDiscReqSt_U8@ */ /end MEASUREMENT
/begin MEASUREMENT SMC_tDebugErrHvOffReqSt_U8 "故障下高压请求，用于上位机观察" UBYTE BMS_CM_uint8 0 0 0 255 ECU_ADDRESS 0x0000 /* @ECU_Address@SMC_tDebugErrHvOffReqSt_U8@ */ /end MEASUREMENT
/begin MEASUREMENT SMC_tDebugSelfCheckSt_U8 "自检状态，用于上位机观察" UBYTE BMS_CM_uint8 0 0 0 255 ECU_ADDRESS 0x0000 /* @ECU_Address@SMC_tDebugSelfCheckSt_U8@ */ /end MEASUREMENT
/begin MEASUREMENT SMC_tDebugStandbyErrOffReq_U8 "Stanby模式下故障请求，用于上位机观察" UBYTE BMS_CM_uint8 0 0 0 255 ECU_ADDRESS 0x0000 /* @ECU_Address@SMC_tDebugStandbyErrOffReq_U8@ */ /end MEASUREMENT
/begin MEASUREMENT SMC_tDebugStationChgReqOffSt_U8 "充电站充电下电请求，用于上位机观察" UBYTE BMS_CM_uint8 0 0 0 255 ECU_ADDRESS 0x0000 /* @ECU_Address@SMC_tDebugStationChgReqOffSt_U8@ */ /end MEASUREMENT
/begin MEASUREMENT SMC_tDebugStationChgReqSt_U8 "充电站充电请求，用于上位机观察" UBYTE BMS_CM_uint8 0 0 0 255 ECU_ADDRESS 0x0000 /* @ECU_Address@SMC_tDebugStationChgReqSt_U8@ */ /end MEASUREMENT
/begin MEASUREMENT SMC_tDebugRlyReqSt_U8 "继电器闭合断开请求，用于上位机观察" UBYTE BMS_CM_uint8 0 0 0 255 ECU_ADDRESS 0x0000 /* @ECU_Address@SMC_tDebugRlyReqSt_U8@ */ /end MEASUREMENT
/begin MEASUREMENT SMC_tDebugThermalReqOffSt_U8 "热管理下电请求，用于上位机观察" UBYTE BMS_CM_uint8 0 0 0 255 ECU_ADDRESS 0x0000 /* @ECU_Address@SMC_tDebugThermalReqOffSt_U8@ */ /end MEASUREMENT
/begin MEASUREMENT SMC_tDebugThermalReqSt_U8 "热管理上电请求，用于上位机观察" UBYTE BMS_CM_uint8 0 0 0 255 ECU_ADDRESS 0x0000 /* @ECU_Address@SMC_tDebugThermalReqSt_U8@ */ /end MEASUREMENT
/begin MEASUREMENT CDP_mCellTempException_U8 "单体温度断线故障，用于上位机观察" UBYTE BMS_CM_uint8 0 0 0 255 ECU_ADDRESS 0x0000 /* @ECU_Address@CDP_mCellTempException_U8@ */ /end MEASUREMENT
/begin MEASUREMENT CDP_mCellVoltException_U8 "单体电压断线故障，用于上位机观察" UBYTE BMS_CM_uint8 0 0 0 255 ECU_ADDRESS 0x0000 /* @ECU_Address@CDP_mCellVoltException_U8@ */ /end MEASUREMENT
/begin MEASUREMENT FCMGB_tChgFinish "充电结束标志位，用于上位机观察" UBYTE BMS_CM_uint8 0 0 0 255 ECU_ADDRESS 0x0000 /* @ECU_Address@FCMGB_tChgFinish@ */ /end MEASUREMENT
/begin MEASUREMENT FCMGB_tGBDebugSt_U8 "国标流程Debug状态，用于上位机观察" UBYTE BMS_CM_uint8 0 0 0 255 ECU_ADDRESS 0x0000 /* @ECU_Address@FCMGB_tGBDebugSt_U8@ */ /end MEASUREMENT
/begin MEASUREMENT FCMGB_tChrgStpRasn "充电停止原因，用于上位机观察" UBYTE BMS_CM_uint8 0 0 0 255 ECU_ADDRESS 0x0000 /* @ECU_Address@FCMGB_tChrgStpRasn@ */ /end MEASUREMENT
/begin MEASUREMENT FCMGB_tChgVoltMaxReq_F32 "国标CML报文充电机最大允许充电电压，用于上位机观察" FLOAT32_IEEE BMS_CM_single 0 0 -3.4e+38 3.4e+38 ECU_ADDRESS 0x0000 /* @ECU_Address@FCMGB_tChgVoltMaxReq_F32@ */ /end MEASUREMENT
/begin MEASUREMENT FCMGB_tChgCurrMaxReq_F32 "国标CML报文充电机最大允许充电电流，用于上位机观察" FLOAT32_IEEE BMS_CM_single 0 0 -3.4e+38 3.4e+38 ECU_ADDRESS 0x0000 /* @ECU_Address@FCMGB_tChgCurrMaxReq_F32@ */ /end MEASUREMENT
/begin MEASUREMENT FCMGB_tAPlusLoss_U8 "A+信号丢失故障，用于上位机观察" UBYTE BMS_CM_uint8 0 0 0 255 ECU_ADDRESS 0x0000 /* @ECU_Address@FCMGB_tAPlusLoss_U8@ */ /end MEASUREMENT
/begin MEASUREMENT RCM_tDebug_U8 "RCM的Debug状态，用于上位机观察" UBYTE BMS_CM_uint8 0 0 0 255 ECU_ADDRESS 0x0000 /* @ECU_Address@RCM_tDebug_U8@ */ /end MEASUREMENT
/begin MEASUREMENT B2T_ChgSt "充电状态，用于上位机观察" UBYTE BMS_CM_uint8 0 0 0 255 ECU_ADDRESS 0x0000 /* @ECU_Address@B2T_ChgSt@ */ /end MEASUREMENT
/begin MEASUREMENT B2T_HVRequest "高压请求，用于上位机观察" UBYTE BMS_CM_uint8 0 0 0 255 ECU_ADDRESS 0x0000 /* @ECU_Address@B2T_HVRequest@ */ /end MEASUREMENT
/begin MEASUREMENT B2T_HVRlySt "BMS 高压继电器状态，用于上位机观察" UBYTE BMS_CM_uint8 0 0 0 255 ECU_ADDRESS 0x0000 /* @ECU_Address@B2T_HVRlySt@ */ /end MEASUREMENT
/begin MEASUREMENT B2T_SetTemp "设定温度，用于上位机观察" UBYTE BMS_CM_uint8 0 0 0 255 ECU_ADDRESS 0x0000 /* @ECU_Address@B2T_SetTemp@ */ /end MEASUREMENT
/begin MEASUREMENT B2V_ST0_ChgNegRly1St "充负继电器1状态，用于上位机观察" UBYTE BMS_CM_uint8 0 0 0 255 ECU_ADDRESS 0x0000 /* @ECU_Address@B2V_ST0_ChgNegRly1St@ */ /end MEASUREMENT
/begin MEASUREMENT B2V_ST0_ChgNegRly2St "充负继电器2状态，用于上位机观察" UBYTE BMS_CM_uint8 0 0 0 255 ECU_ADDRESS 0x0000 /* @ECU_Address@B2V_ST0_ChgNegRly2St@ */ /end MEASUREMENT
/begin MEASUREMENT B2V_ST0_ChgPosRly1St "充正继电器1状态，用于上位机观察" UBYTE BMS_CM_uint8 0 0 0 255 ECU_ADDRESS 0x0000 /* @ECU_Address@B2V_ST0_ChgPosRly1St@ */ /end MEASUREMENT
/begin MEASUREMENT B2V_ST0_ChgPosRly2St "充正继电器2状态，用于上位机观察" UBYTE BMS_CM_uint8 0 0 0 255 ECU_ADDRESS 0x0000 /* @ECU_Address@B2V_ST0_ChgPosRly2St@ */ /end MEASUREMENT
/begin MEASUREMENT B2V_ST0_NegRlySt "主负继电器状态，用于上位机观察" UBYTE BMS_CM_uint8 0 0 0 255 ECU_ADDRESS 0x0000 /* @ECU_Address@B2V_ST0_NegRlySt@ */ /end MEASUREMENT
/begin MEASUREMENT B2V_ST0_PosRlySt "主正继电器状态，用于上位机观察" UBYTE BMS_CM_uint8 0 0 0 255 ECU_ADDRESS 0x0000 /* @ECU_Address@B2V_ST0_PosRlySt@ */ /end MEASUREMENT
/begin MEASUREMENT B2V_ST0_PreChgRlySt "预充继电器状态，用于上位机观察" UBYTE BMS_CM_uint8 0 0 0 255 ECU_ADDRESS 0x0000 /* @ECU_Address@B2V_ST0_PreChgRlySt@ */ /end MEASUREMENT
/begin MEASUREMENT B2V_ST2_BattSOC "显示SOC，用于上位机观察" UBYTE BMS_CM_uint8 0 0 0 255 ECU_ADDRESS 0x0000 /* @ECU_Address@B2V_ST2_BattSOC@ */ /end MEASUREMENT
/begin MEASUREMENT B2V_ST2_BattSOH "显示SOH，用于上位机观察" UBYTE BMS_CM_uint8 0 0 0 255 ECU_ADDRESS 0x0000 /* @ECU_Address@B2V_ST2_BattSOH@ */ /end MEASUREMENT
/begin MEASUREMENT B2V_ST4_AvgCellTemp "电芯温度平均值，用于上位机观察" UBYTE BMS_CM_uint8 0 0 0 255 ECU_ADDRESS 0x0000 /* @ECU_Address@B2V_ST4_AvgCellTemp@ */ /end MEASUREMENT
/begin MEASUREMENT B2V_ST5_AvgCellVolt "电芯电压平均值，用于上位机观察" UWORD BMS_CM_uint16 0 0 0 65535 ECU_ADDRESS 0x0000 /* @ECU_Address@B2V_ST5_AvgCellVolt@ */ /end MEASUREMENT
/begin MEASUREMENT B2V_ST7_BranchCur1 "支路1电流，用于上位机观察" UWORD BMS_CM_uint16 0 0 0 65535 ECU_ADDRESS 0x0000 /* @ECU_Address@B2V_ST7_BranchCur1@ */ /end MEASUREMENT
/begin MEASUREMENT B2V_ST7_BranchCur2 "支路2电流，用于上位机观察" UWORD BMS_CM_uint16 0 0 0 65535 ECU_ADDRESS 0x0000 /* @ECU_Address@B2V_ST7_BranchCur2@ */ /end MEASUREMENT
/begin MEASUREMENT B2V_ST7_BranchCur3 "支路3电流，用于上位机观察" UWORD BMS_CM_uint16 0 0 0 65535 ECU_ADDRESS 0x0000 /* @ECU_Address@B2V_ST7_BranchCur3@ */ /end MEASUREMENT
/begin MEASUREMENT B2V_ST7_BranchCur4 "支路4电流，用于上位机观察" UWORD BMS_CM_uint16 0 0 0 65535 ECU_ADDRESS 0x0000 /* @ECU_Address@B2V_ST7_BranchCur4@ */ /end MEASUREMENT
/begin MEASUREMENT B2V_ST8_Version1 "版本信息1，用于上位机观察" UBYTE BMS_CM_uint8 0 0 0 255 ECU_ADDRESS 0x0000 /* @ECU_Address@B2V_ST8_Version1@ */ /end MEASUREMENT
/begin MEASUREMENT B2V_ST8_Version2 "版本信息2，用于上位机观察" UBYTE BMS_CM_uint8 0 0 0 255 ECU_ADDRESS 0x0000 /* @ECU_Address@B2V_ST8_Version2@ */ /end MEASUREMENT
/begin MEASUREMENT B2V_ST8_Version3 "版本信息3，用于上位机观察" UBYTE BMS_CM_uint8 0 0 0 255 ECU_ADDRESS 0x0000 /* @ECU_Address@B2V_ST8_Version3@ */ /end MEASUREMENT
/begin MEASUREMENT B2V_ST8_Version4 "版本信息4，用于上位机观察" UBYTE BMS_CM_uint8 0 0 0 255 ECU_ADDRESS 0x0000 /* @ECU_Address@B2V_ST8_Version4@ */ /end MEASUREMENT
/begin MEASUREMENT B2V_ST8_Version5 "版本信息5，用于上位机观察" UBYTE BMS_CM_uint8 0 0 0 255 ECU_ADDRESS 0x0000 /* @ECU_Address@B2V_ST8_Version5@ */ /end MEASUREMENT
/begin MEASUREMENT B2V_ST8_Version6 "版本信息6，用于上位机观察" UBYTE BMS_CM_uint8 0 0 0 255 ECU_ADDRESS 0x0000 /* @ECU_Address@B2V_ST8_Version6@ */ /end MEASUREMENT
/begin MEASUREMENT B2V_ST8_Version7 "版本信息7，用于上位机观察" UBYTE BMS_CM_uint8 0 0 0 255 ECU_ADDRESS 0x0000 /* @ECU_Address@B2V_ST8_Version7@ */ /end MEASUREMENT
/begin MEASUREMENT B2V_ST8_Version8 "版本信息8，用于上位机观察" UBYTE BMS_CM_uint8 0 0 0 255 ECU_ADDRESS 0x0000 /* @ECU_Address@B2V_ST8_Version8@ */ /end MEASUREMENT
/begin MEASUREMENT BMU_RealSOC "真实SOC，用于上位机观察" UBYTE BMS_CM_uint8 0 0 0 255 ECU_ADDRESS 0x0000 /* @ECU_Address@BMU_RealSOC@ */ /end MEASUREMENT
/begin MEASUREMENT BMU_RealSOH "真实SOH，用于上位机观察" UBYTE BMS_CM_uint8 0 0 0 255 ECU_ADDRESS 0x0000 /* @ECU_Address@BMU_RealSOH@ */ /end MEASUREMENT
/begin MEASUREMENT TRM_mPack1A1_U8 "A包热失控条件A1" UBYTE BMS_CM_uint8 0 0 0 255 ECU_ADDRESS 0x0000 /* @ECU_Address@TRM_mPack1A1_U8@ */ /end MEASUREMENT
/begin MEASUREMENT TRM_mPack1A2_U8 "A包热失控条件A2" UBYTE BMS_CM_uint8 0 0 0 255 ECU_ADDRESS 0x0000 /* @ECU_Address@TRM_mPack1A2_U8@ */ /end MEASUREMENT
/begin MEASUREMENT TRM_mPack2A1_U8 "B包热失控条件A1" UBYTE BMS_CM_uint8 0 0 0 255 ECU_ADDRESS 0x0000 /* @ECU_Address@TRM_mPack2A1_U8@ */ /end MEASUREMENT
/begin MEASUREMENT TRM_mPack2A2_U8 "B包热失控条件A2" UBYTE BMS_CM_uint8 0 0 0 255 ECU_ADDRESS 0x0000 /* @ECU_Address@TRM_mPack2A2_U8@ */ /end MEASUREMENT
/begin MEASUREMENT TRM_mPack3A1_U8 "C包热失控条件A1" UBYTE BMS_CM_uint8 0 0 0 255 ECU_ADDRESS 0x0000 /* @ECU_Address@TRM_mPack3A1_U8@ */ /end MEASUREMENT
/begin MEASUREMENT TRM_mPack3A2_U8 "C包热失控条件A2" UBYTE BMS_CM_uint8 0 0 0 255 ECU_ADDRESS 0x0000 /* @ECU_Address@TRM_mPack3A2_U8@ */ /end MEASUREMENT
/begin MEASUREMENT TRM_mPack4A1_U8 "D包热失控条件A1" UBYTE BMS_CM_uint8 0 0 0 255 ECU_ADDRESS 0x0000 /* @ECU_Address@TRM_mPack4A1_U8@ */ /end MEASUREMENT
/begin MEASUREMENT TRM_mPack4A2_U8 "D包热失控条件A2" UBYTE BMS_CM_uint8 0 0 0 255 ECU_ADDRESS 0x0000 /* @ECU_Address@TRM_mPack4A2_U8@ */ /end MEASUREMENT
/begin MEASUREMENT TRM_mPack1B_U8 "A包热失控条件B" UBYTE BMS_CM_uint8 0 0 0 255 ECU_ADDRESS 0x0000 /* @ECU_Address@TRM_mPack1B_U8@ */ /end MEASUREMENT
/begin MEASUREMENT TRM_mPack2B_U8 "B包热失控条件B" UBYTE BMS_CM_uint8 0 0 0 255 ECU_ADDRESS 0x0000 /* @ECU_Address@TRM_mPack2B_U8@ */ /end MEASUREMENT
/begin MEASUREMENT TRM_mPack3B_U8 "C包热失控条件B" UBYTE BMS_CM_uint8 0 0 0 255 ECU_ADDRESS 0x0000 /* @ECU_Address@TRM_mPack3B_U8@ */ /end MEASUREMENT
/begin MEASUREMENT TRM_mPack4B_U8 "D包热失控条件B" UBYTE BMS_CM_uint8 0 0 0 255 ECU_ADDRESS 0x0000 /* @ECU_Address@TRM_mPack4B_U8@ */ /end MEASUREMENT
/begin MEASUREMENT TRM_mPack1C_U8 "A包热失控条件C" UBYTE BMS_CM_uint8 0 0 0 255 ECU_ADDRESS 0x0000 /* @ECU_Address@TRM_mPack1C_U8@ */ /end MEASUREMENT
/begin MEASUREMENT TRM_mPack2C_U8 "B包热失控条件C" UBYTE BMS_CM_uint8 0 0 0 255 ECU_ADDRESS 0x0000 /* @ECU_Address@TRM_mPack2C_U8@ */ /end MEASUREMENT
/begin MEASUREMENT TRM_mPack3C_U8 "C包热失控条件C" UBYTE BMS_CM_uint8 0 0 0 255 ECU_ADDRESS 0x0000 /* @ECU_Address@TRM_mPack3C_U8@ */ /end MEASUREMENT
/begin MEASUREMENT TRM_mPack4C_U8 "D包热失控条件C" UBYTE BMS_CM_uint8 0 0 0 255 ECU_ADDRESS 0x0000 /* @ECU_Address@TRM_mPack4C_U8@ */ /end MEASUREMENT
/begin MEASUREMENT TRM_mPack1D_U8 "A包热失控条件D" UBYTE BMS_CM_uint8 0 0 0 255 ECU_ADDRESS 0x0000 /* @ECU_Address@TRM_mPack1D_U8@ */ /end MEASUREMENT
/begin MEASUREMENT TRM_mPack2D_U8 "B包热失控条件D" UBYTE BMS_CM_uint8 0 0 0 255 ECU_ADDRESS 0x0000 /* @ECU_Address@TRM_mPack2D_U8@ */ /end MEASUREMENT
/begin MEASUREMENT TRM_mPack3D_U8 "C包热失控条件D" UBYTE BMS_CM_uint8 0 0 0 255 ECU_ADDRESS 0x0000 /* @ECU_Address@TRM_mPack3D_U8@ */ /end MEASUREMENT
/begin MEASUREMENT TRM_mPack4D_U8 "D包热失控条件D" UBYTE BMS_CM_uint8 0 0 0 255 ECU_ADDRESS 0x0000 /* @ECU_Address@TRM_mPack4D_U8@ */ /end MEASUREMENT
/begin MEASUREMENT SOC_tDebugPack3BeforeFullEmpCaledMax "Pack3最大SOC满电前校准完成，用于上位机观察" UBYTE BMS_CM_uint8 0 0 0 255 ECU_ADDRESS 0x0000 /* @ECU_Address@SOC_tDebugPack3BeforeFullEmpCaledMax@ */ /end MEASUREMENT
/begin MEASUREMENT SOC_tDebugPack3BeforeFullEmpCaledMin "Pack3最小SOC满电前校准完成，用于上位机观察" UBYTE BMS_CM_uint8 0 0 0 255 ECU_ADDRESS 0x0000 /* @ECU_Address@SOC_tDebugPack3BeforeFullEmpCaledMin@ */ /end MEASUREMENT
/begin MEASUREMENT SOC_tDebugPack4BeforeFullEmpCaledMax "Pack4最大SOC满电前校准完成，用于上位机观察" UBYTE BMS_CM_uint8 0 0 0 255 ECU_ADDRESS 0x0000 /* @ECU_Address@SOC_tDebugPack4BeforeFullEmpCaledMax@ */ /end MEASUREMENT
/begin MEASUREMENT SOC_tDebugPack4BeforeFullEmpCaledMin "Pack4最小SOC满电前校准完成，用于上位机观察" UBYTE BMS_CM_uint8 0 0 0 255 ECU_ADDRESS 0x0000 /* @ECU_Address@SOC_tDebugPack4BeforeFullEmpCaledMin@ */ /end MEASUREMENT
/begin MEASUREMENT SOC_tDebugPack3StaticCalFlg "Pack3SOC静态校准完成，用于上位机观察" UBYTE BMS_CM_uint8 0 0 0 255 ECU_ADDRESS 0x0000 /* @ECU_Address@SOC_tDebugPack3StaticCalFlg@ */ /end MEASUREMENT
/begin MEASUREMENT SOC_tDebugPack4StaticCalFlg "Pack4SOC静态校准完成，用于上位机观察" UBYTE BMS_CM_uint8 0 0 0 255 ECU_ADDRESS 0x0000 /* @ECU_Address@SOC_tDebugPack4StaticCalFlg@ */ /end MEASUREMENT
/begin MEASUREMENT SDM_mHVIL1OpenErr_U8 "高压互锁1故障，用于上位机观察" UBYTE BMS_CM_uint8 0 0 0 255 ECU_ADDRESS 0x0000 /* @ECU_Address@SDM_mHVIL1OpenErr_U8@ */ /end MEASUREMENT
/begin MEASUREMENT SDM_mHVIL2OpenErr_U8 "高压互锁2故障，用于上位机观察" UBYTE BMS_CM_uint8 0 0 0 255 ECU_ADDRESS 0x0000 /* @ECU_Address@SDM_mHVIL2OpenErr_U8@ */ /end MEASUREMENT
/begin MEASUREMENT SDM_mHVIL3OpenErr_U8 "高压互锁3故障，用于上位机观察" UBYTE BMS_CM_uint8 0 0 0 255 ECU_ADDRESS 0x0000 /* @ECU_Address@SDM_mHVIL3OpenErr_U8@ */ /end MEASUREMENT
/begin MEASUREMENT SDM_mHVIL4OpenErr_U8 "高压互锁4故障，用于上位机观察" UBYTE BMS_CM_uint8 0 0 0 255 ECU_ADDRESS 0x0000 /* @ECU_Address@SDM_mHVIL4OpenErr_U8@ */ /end MEASUREMENT
/begin MEASUREMENT SDM_mHVIL5OpenErr_U8 "高压互锁5故障，用于上位机观察" UBYTE BMS_CM_uint8 0 0 0 255 ECU_ADDRESS 0x0000 /* @ECU_Address@SDM_mHVIL5OpenErr_U8@ */ /end MEASUREMENT
/begin MEASUREMENT SDM_mHVILOpenErr_U8 "高压互锁故障，用于上位机观察" UBYTE BMS_CM_uint8 0 0 0 255 ECU_ADDRESS 0x0000 /* @ECU_Address@SDM_mHVILOpenErr_U8@ */ /end MEASUREMENT
/begin MEASUREMENT SDM_mHVILSt_U8 "高压互锁状态，用于上位机观察" UBYTE BMS_CM_uint8 0 0 0 255 ECU_ADDRESS 0x0000 /* @ECU_Address@SDM_mHVILSt_U8@ */ /end MEASUREMENT
/begin MEASUREMENT SDM_mInsulationResErr_U8 "绝缘检测故障，用于上位机观察" UBYTE BMS_CM_uint8 0 0 0 255 ECU_ADDRESS 0x0000 /* @ECU_Address@SDM_mInsulationResErr_U8@ */ /end MEASUREMENT
/begin MEASUREMENT HVIL1Cycle_IN "高压互锁1输入频率，用于上位机观察" UBYTE BMS_CM_uint8 0 0 0 255 ECU_ADDRESS 0x0000 /* @ECU_Address@HVIL1Cycle_IN@ */ /end MEASUREMENT
/begin MEASUREMENT HVIL1Cycle_Out "高压互锁1输出频率，用于上位机观察" UBYTE BMS_CM_uint8 0 0 0 255 ECU_ADDRESS 0x0000 /* @ECU_Address@HVIL1Cycle_Out@ */ /end MEASUREMENT
/begin MEASUREMENT HVIL1Duty_IN "高压互锁1输入占空比，用于上位机观察" UBYTE BMS_CM_uint8 0 0 0 255 ECU_ADDRESS 0x0000 /* @ECU_Address@HVIL1Duty_IN@ */ /end MEASUREMENT
/begin MEASUREMENT HVIL1Duty_Out "高压互锁1输出占空比，用于上位机观察" UBYTE BMS_CM_uint8 0 0 0 255 ECU_ADDRESS 0x0000 /* @ECU_Address@HVIL1Duty_Out@ */ /end MEASUREMENT
/begin MEASUREMENT HVIL2Cycle_IN "高压互锁2输入频率，用于上位机观察" UBYTE BMS_CM_uint8 0 0 0 255 ECU_ADDRESS 0x0000 /* @ECU_Address@HVIL2Cycle_IN@ */ /end MEASUREMENT
/begin MEASUREMENT HVIL2Cycle_Out "高压互锁2输出频率，用于上位机观察" UBYTE BMS_CM_uint8 0 0 0 255 ECU_ADDRESS 0x0000 /* @ECU_Address@HVIL2Cycle_Out@ */ /end MEASUREMENT
/begin MEASUREMENT HVIL2Duty_IN "高压互锁2输入占空比，用于上位机观察" UBYTE BMS_CM_uint8 0 0 0 255 ECU_ADDRESS 0x0000 /* @ECU_Address@HVIL2Duty_IN@ */ /end MEASUREMENT
/begin MEASUREMENT HVIL2Duty_Out "高压互锁2输出占空比，用于上位机观察" UBYTE BMS_CM_uint8 0 0 0 255 ECU_ADDRESS 0x0000 /* @ECU_Address@HVIL2Duty_Out@ */ /end MEASUREMENT
/begin MEASUREMENT HVIL3Cycle_IN "高压互锁3输入频率，用于上位机观察" UBYTE BMS_CM_uint8 0 0 0 255 ECU_ADDRESS 0x0000 /* @ECU_Address@HVIL3Cycle_IN@ */ /end MEASUREMENT
/begin MEASUREMENT HVIL3Cycle_Out "高压互锁3输出频率，用于上位机观察" UBYTE BMS_CM_uint8 0 0 0 255 ECU_ADDRESS 0x0000 /* @ECU_Address@HVIL3Cycle_Out@ */ /end MEASUREMENT
/begin MEASUREMENT HVIL3Duty_IN "高压互锁3输入占空比，用于上位机观察" UBYTE BMS_CM_uint8 0 0 0 255 ECU_ADDRESS 0x0000 /* @ECU_Address@HVIL3Duty_IN@ */ /end MEASUREMENT
/begin MEASUREMENT HVIL3Duty_Out "高压互锁3输出占空比，用于上位机观察" UBYTE BMS_CM_uint8 0 0 0 255 ECU_ADDRESS 0x0000 /* @ECU_Address@HVIL3Duty_Out@ */ /end MEASUREMENT
/begin MEASUREMENT HVIL4Cycle_IN "高压互锁4输入频率，用于上位机观察" UBYTE BMS_CM_uint8 0 0 0 255 ECU_ADDRESS 0x0000 /* @ECU_Address@HVIL4Cycle_IN@ */ /end MEASUREMENT
/begin MEASUREMENT HVIL4Cycle_Out "高压互锁4输出频率，用于上位机观察" UBYTE BMS_CM_uint8 0 0 0 255 ECU_ADDRESS 0x0000 /* @ECU_Address@HVIL4Cycle_Out@ */ /end MEASUREMENT
/begin MEASUREMENT HVIL4Duty_IN "高压互锁4输入占空比，用于上位机观察" UBYTE BMS_CM_uint8 0 0 0 255 ECU_ADDRESS 0x0000 /* @ECU_Address@HVIL4Duty_IN@ */ /end MEASUREMENT
/begin MEASUREMENT HVIL4Duty_Out "高压互锁4输出占空比，用于上位机观察" UBYTE BMS_CM_uint8 0 0 0 255 ECU_ADDRESS 0x0000 /* @ECU_Address@HVIL4Duty_Out@ */ /end MEASUREMENT
/begin MEASUREMENT HVIL5Volt_IN "高压互锁5输出电压，用于上位机观察" UWORD BMS_CM_uint16 0 0 0 65535 ECU_ADDRESS 0x0000 /* @ECU_Address@HVIL5Volt_IN@ */ /end MEASUREMENT
/begin MEASUREMENT HVIL5Volt_OUT "高压互锁5输出电压，用于上位机观察" UWORD BMS_CM_uint16 0 0 0 65535 ECU_ADDRESS 0x0000 /* @ECU_Address@HVIL5Volt_OUT@ */ /end MEASUREMENT
/begin MEASUREMENT BAU_info1_Count "BAU的报文1计数，用于上位机观察" UBYTE BMS_CM_uint8 0 0 0 255 ECU_ADDRESS 0x0000 /* @ECU_Address@BAU_info1_Count@ */ /end MEASUREMENT
/begin MEASUREMENT BAU_info2_Count "BAU的报文2计数，用于上位机观察" UBYTE BMS_CM_uint8 0 0 0 255 ECU_ADDRESS 0x0000 /* @ECU_Address@BAU_info2_Count@ */ /end MEASUREMENT
/begin MEASUREMENT BAU_info3_Count "BAU的报文3计数，用于上位机观察" UBYTE BMS_CM_uint8 0 0 0 255 ECU_ADDRESS 0x0000 /* @ECU_Address@BAU_info3_Count@ */ /end MEASUREMENT
/begin MEASUREMENT BAU_info4_Count "BAU的报文4计数，用于上位机观察" UBYTE BMS_CM_uint8 0 0 0 255 ECU_ADDRESS 0x0000 /* @ECU_Address@BAU_info4_Count@ */ /end MEASUREMENT
/begin MEASUREMENT BAU_info5_Count "BAU的报文5计数，用于上位机观察" UBYTE BMS_CM_uint8 0 0 0 255 ECU_ADDRESS 0x0000 /* @ECU_Address@BAU_info5_Count@ */ /end MEASUREMENT
/begin MEASUREMENT BAU_info6_Count "BAU的报文6计数，用于上位机观察" UBYTE BMS_CM_uint8 0 0 0 255 ECU_ADDRESS 0x0000 /* @ECU_Address@BAU_info6_Count@ */ /end MEASUREMENT
/begin MEASUREMENT BAU_info7_Count "BAU的报文7计数，用于上位机观察" UBYTE BMS_CM_uint8 0 0 0 255 ECU_ADDRESS 0x0000 /* @ECU_Address@BAU_info7_Count@ */ /end MEASUREMENT
/begin MEASUREMENT BAU_info7_Version_Day "BAU的版本日，用于上位机观察" UBYTE BMS_CM_uint8 0 0 0 255 ECU_ADDRESS 0x0000 /* @ECU_Address@BAU_info7_Version_Day@ */ /end MEASUREMENT
/begin MEASUREMENT BAU_info7_Version_Month "BAU的版本月，用于上位机观察" UBYTE BMS_CM_uint8 0 0 0 255 ECU_ADDRESS 0x0000 /* @ECU_Address@BAU_info7_Version_Month@ */ /end MEASUREMENT
/begin MEASUREMENT BAU_info7_Version_Num "当日版本，用于上位机观察" UBYTE BMS_CM_uint8 0 0 0 255 ECU_ADDRESS 0x0000 /* @ECU_Address@BAU_info7_Version_Num@ */ /end MEASUREMENT
/begin MEASUREMENT BAU_info7_Version_Year "BAU的版本年，用于上位机观察" UBYTE BMS_CM_uint8 0 0 0 255 ECU_ADDRESS 0x0000 /* @ECU_Address@BAU_info7_Version_Year@ */ /end MEASUREMENT
/begin MEASUREMENT DCNeg1Temp "快充插座负极温度1，用于上位机观察" UBYTE BMS_CM_uint8 0 0 0 255 ECU_ADDRESS 0x0000 /* @ECU_Address@DCNeg1Temp@ */ /end MEASUREMENT
/begin MEASUREMENT DCNeg2Temp "快充插座负极温度2，用于上位机观察" UBYTE BMS_CM_uint8 0 0 0 255 ECU_ADDRESS 0x0000 /* @ECU_Address@DCNeg2Temp@ */ /end MEASUREMENT
/begin MEASUREMENT DCNeg3Temp "快充插座负极温度3，用于上位机观察" UBYTE BMS_CM_uint8 0 0 0 255 ECU_ADDRESS 0x0000 /* @ECU_Address@DCNeg3Temp@ */ /end MEASUREMENT
/begin MEASUREMENT DCNeg4Temp "快充插座负极温度4，用于上位机观察" UBYTE BMS_CM_uint8 0 0 0 255 ECU_ADDRESS 0x0000 /* @ECU_Address@DCNeg4Temp@ */ /end MEASUREMENT
/begin MEASUREMENT DCPos1Temp "快充插座正极温度1，用于上位机观察" UBYTE BMS_CM_uint8 0 0 0 255 ECU_ADDRESS 0x0000 /* @ECU_Address@DCPos1Temp@ */ /end MEASUREMENT
/begin MEASUREMENT DCPos2Temp "快充插座正极温度2，用于上位机观察" UBYTE BMS_CM_uint8 0 0 0 255 ECU_ADDRESS 0x0000 /* @ECU_Address@DCPos2Temp@ */ /end MEASUREMENT
/begin MEASUREMENT DCPos3Temp "快充插座正极温度3，用于上位机观察" UBYTE BMS_CM_uint8 0 0 0 255 ECU_ADDRESS 0x0000 /* @ECU_Address@DCPos3Temp@ */ /end MEASUREMENT
/begin MEASUREMENT DCPos4Temp "快充插座正极温度4，用于上位机观察" UBYTE BMS_CM_uint8 0 0 0 255 ECU_ADDRESS 0x0000 /* @ECU_Address@DCPos4Temp@ */ /end MEASUREMENT
/begin MEASUREMENT LVM_info6_AplusVolt "BAU的A+唤醒电压值，用于上位机观察" FLOAT32_IEEE BMS_CM_single 0 0 -3.4e+38 3.4e+38 ECU_ADDRESS 0x0000 /* @ECU_Address@LVM_info6_AplusVolt@ */ /end MEASUREMENT
/begin MEASUREMENT LVM_info6_CCUSupplyVolt "BAU的CCU供电电压值，用于上位机观察" FLOAT32_IEEE BMS_CM_single 0 0 -3.4e+38 3.4e+38 ECU_ADDRESS 0x0000 /* @ECU_Address@LVM_info6_CCUSupplyVolt@ */ /end MEASUREMENT
/begin MEASUREMENT LVM_info6_HallSupplyVolt "BAU霍尔供电电压值，用于上位机观察" FLOAT32_IEEE BMS_CM_single 0 0 -3.4e+38 3.4e+38 ECU_ADDRESS 0x0000 /* @ECU_Address@LVM_info6_HallSupplyVolt@ */ /end MEASUREMENT
/begin MEASUREMENT LVM_info6_KL15Volt "BAU的KL15唤醒电压值，用于上位机观察" FLOAT32_IEEE BMS_CM_single 0 0 -3.4e+38 3.4e+38 ECU_ADDRESS 0x0000 /* @ECU_Address@LVM_info6_KL15Volt@ */ /end MEASUREMENT
/begin MEASUREMENT LVM_info6_KL30Volt "BAU的KL30供电电压值，用于上位机观察" FLOAT32_IEEE BMS_CM_single 0 0 -3.4e+38 3.4e+38 ECU_ADDRESS 0x0000 /* @ECU_Address@LVM_info6_KL30Volt@ */ /end MEASUREMENT
/begin MEASUREMENT LVM_mBMSSupplyVoltHiLv_U8 "供电电压过高故障，用于上位机观察" UBYTE BMS_CM_uint8 0 0 0 255 ECU_ADDRESS 0x0000 /* @ECU_Address@LVM_mBMSSupplyVoltHiLv_U8@ */ /end MEASUREMENT
/begin MEASUREMENT LVM_mBMSSupplyVoltLoLv_U8 "供电电压过低故障，用于上位机观察" UBYTE BMS_CM_uint8 0 0 0 255 ECU_ADDRESS 0x0000 /* @ECU_Address@LVM_mBMSSupplyVoltLoLv_U8@ */ /end MEASUREMENT
/begin MEASUREMENT LVM_mBMSToTMS_WakeSt_U8 "BMS到TMS的唤醒状态，用于上位机观察" UBYTE BMS_CM_uint8 0 0 0 255 ECU_ADDRESS 0x0000 /* @ECU_Address@LVM_mBMSToTMS_WakeSt_U8@ */ /end MEASUREMENT
/begin MEASUREMENT LVM_mCC2ConnectErr_U8 "CC2_1连接故障，用于上位机观察" UBYTE BMS_CM_uint8 0 0 0 255 ECU_ADDRESS 0x0000 /* @ECU_Address@LVM_mCC2ConnectErr_U8@ */ /end MEASUREMENT
/begin MEASUREMENT LVM_mCC2_2ConnectErr_U8 "CC2_2连接故障，用于上位机观察" UBYTE BMS_CM_uint8 0 0 0 255 ECU_ADDRESS 0x0000 /* @ECU_Address@LVM_mCC2_2ConnectErr_U8@ */ /end MEASUREMENT
/begin MEASUREMENT LVM_mDCNegTempErr_U8 "快充负极插座温度1异常故障，用于上位机观察" UBYTE BMS_CM_uint8 0 0 0 255 ECU_ADDRESS 0x0000 /* @ECU_Address@LVM_mDCNegTempErr_U8@ */ /end MEASUREMENT
/begin MEASUREMENT LVM_mDCPosTempErr_U8 "快充正极插座温度1异常故障，用于上位机观察" UBYTE BMS_CM_uint8 0 0 0 255 ECU_ADDRESS 0x0000 /* @ECU_Address@LVM_mDCPosTempErr_U8@ */ /end MEASUREMENT
/begin MEASUREMENT LVM_mDC_2NegTempErr_U8 "快充负极插座温度2异常故障，用于上位机观察" UBYTE BMS_CM_uint8 0 0 0 255 ECU_ADDRESS 0x0000 /* @ECU_Address@LVM_mDC_2NegTempErr_U8@ */ /end MEASUREMENT
/begin MEASUREMENT LVM_mDC_2PosTempErr_U8 "快充正极插座温度2异常故障，用于上位机观察" UBYTE BMS_CM_uint8 0 0 0 255 ECU_ADDRESS 0x0000 /* @ECU_Address@LVM_mDC_2PosTempErr_U8@ */ /end MEASUREMENT
/begin MEASUREMENT LVM_mDC_3NegTempErr_U8 "快充负极插座温度3异常故障，用于上位机观察" UBYTE BMS_CM_uint8 0 0 0 255 ECU_ADDRESS 0x0000 /* @ECU_Address@LVM_mDC_3NegTempErr_U8@ */ /end MEASUREMENT
/begin MEASUREMENT LVM_mDC_3PosTempErr_U8 "快充正极插座温度3异常故障，用于上位机观察" UBYTE BMS_CM_uint8 0 0 0 255 ECU_ADDRESS 0x0000 /* @ECU_Address@LVM_mDC_3PosTempErr_U8@ */ /end MEASUREMENT
/begin MEASUREMENT LVM_mDC_4NegTempErr_U8 "快充负极插座温度4异常故障，用于上位机观察" UBYTE BMS_CM_uint8 0 0 0 255 ECU_ADDRESS 0x0000 /* @ECU_Address@LVM_mDC_4NegTempErr_U8@ */ /end MEASUREMENT
/begin MEASUREMENT LVM_mDC_4PosTempErr_U8 "快充正极插座温度4异常故障，用于上位机观察" UBYTE BMS_CM_uint8 0 0 0 255 ECU_ADDRESS 0x0000 /* @ECU_Address@LVM_mDC_4PosTempErr_U8@ */ /end MEASUREMENT
/begin MEASUREMENT LVM_mWtrInTempErr_U8 "进水口温度1异常，用于上位机观察" UBYTE BMS_CM_uint8 0 0 0 255 ECU_ADDRESS 0x0000 /* @ECU_Address@LVM_mWtrInTempErr_U8@ */ /end MEASUREMENT
/begin MEASUREMENT LVM_mWtrIn_2TempErr_U8 "进水口温度2异常，用于上位机观察" UBYTE BMS_CM_uint8 0 0 0 255 ECU_ADDRESS 0x0000 /* @ECU_Address@LVM_mWtrIn_2TempErr_U8@ */ /end MEASUREMENT
/begin MEASUREMENT LVM_mWtrIn_3TempErr_U8 "进水口温度3异常，用于上位机观察" UBYTE BMS_CM_uint8 0 0 0 255 ECU_ADDRESS 0x0000 /* @ECU_Address@LVM_mWtrIn_3TempErr_U8@ */ /end MEASUREMENT
/begin MEASUREMENT LVM_mWtrIn_4TempErr_U8 "进水口温度4异常，用于上位机观察" UBYTE BMS_CM_uint8 0 0 0 255 ECU_ADDRESS 0x0000 /* @ECU_Address@LVM_mWtrIn_4TempErr_U8@ */ /end MEASUREMENT
/begin MEASUREMENT LVM_mWtrOutTempErr_U8 "出水口温度1异常，用于上位机观察" UBYTE BMS_CM_uint8 0 0 0 255 ECU_ADDRESS 0x0000 /* @ECU_Address@LVM_mWtrOutTempErr_U8@ */ /end MEASUREMENT
/begin MEASUREMENT LVM_mWtrOut_2TempErr_U8 "出水口温度2异常，用于上位机观察" UBYTE BMS_CM_uint8 0 0 0 255 ECU_ADDRESS 0x0000 /* @ECU_Address@LVM_mWtrOut_2TempErr_U8@ */ /end MEASUREMENT
/begin MEASUREMENT LVM_mWtrOut_3TempErr_U8 "出水口温度3异常，用于上位机观察" UBYTE BMS_CM_uint8 0 0 0 255 ECU_ADDRESS 0x0000 /* @ECU_Address@LVM_mWtrOut_3TempErr_U8@ */ /end MEASUREMENT
/begin MEASUREMENT LVM_mWtrOut_4TempErr_U8 "出水口温度4异常，用于上位机观察" UBYTE BMS_CM_uint8 0 0 0 255 ECU_ADDRESS 0x0000 /* @ECU_Address@LVM_mWtrOut_4TempErr_U8@ */ /end MEASUREMENT
/begin MEASUREMENT WtrIn_3Temp "包3进水口温度，用于上位机观察" UWORD BMS_CM_uint16 0 0 0 65535 ECU_ADDRESS 0x0000 /* @ECU_Address@WtrIn_3Temp@ */ /end MEASUREMENT
/begin MEASUREMENT WtrIn_4Temp "包4进水口温度，用于上位机观察" UWORD BMS_CM_uint16 0 0 0 65535 ECU_ADDRESS 0x0000 /* @ECU_Address@WtrIn_4Temp@ */ /end MEASUREMENT
/begin MEASUREMENT WtrOUT_3Temp "包3出水口温度，用于上位机观察" UWORD BMS_CM_uint16 0 0 0 65535 ECU_ADDRESS 0x0000 /* @ECU_Address@WtrOUT_3Temp@ */ /end MEASUREMENT
/begin MEASUREMENT WtrOUT_4Temp "包4出水口温度，用于上位机观察" UWORD BMS_CM_uint16 0 0 0 65535 ECU_ADDRESS 0x0000 /* @ECU_Address@WtrOUT_4Temp@ */ /end MEASUREMENT
/begin MEASUREMENT RSP_mAChgPosRlySt "用于上位机观察" UBYTE BMS_CM_uint8 0 0 0 255 ECU_ADDRESS 0x0000 /* @ECU_Address@RSP_mAChgPosRlySt@ */ /end MEASUREMENT
/begin MEASUREMENT RSP_mBChgPosRlySt "用于上位机观察" UBYTE BMS_CM_uint8 0 0 0 255 ECU_ADDRESS 0x0000 /* @ECU_Address@RSP_mBChgPosRlySt@ */ /end MEASUREMENT
/begin MEASUREMENT RSP_mCChgPosRlySt "用于上位机观察" UBYTE BMS_CM_uint8 0 0 0 255 ECU_ADDRESS 0x0000 /* @ECU_Address@RSP_mCChgPosRlySt@ */ /end MEASUREMENT
/begin MEASUREMENT RSP_mDChgPosRlySt "用于上位机观察" UBYTE BMS_CM_uint8 0 0 0 255 ECU_ADDRESS 0x0000 /* @ECU_Address@RSP_mDChgPosRlySt@ */ /end MEASUREMENT
/begin MEASUREMENT RSP_mHeatRlySt "用于上位机观察" UBYTE BMS_CM_uint8 0 0 0 255 ECU_ADDRESS 0x0000 /* @ECU_Address@RSP_mHeatRlySt@ */ /end MEASUREMENT
/begin MEASUREMENT RSP_mNegRlySt "用于上位机观察" UBYTE BMS_CM_uint8 0 0 0 255 ECU_ADDRESS 0x0000 /* @ECU_Address@RSP_mNegRlySt@ */ /end MEASUREMENT
/begin MEASUREMENT RSP_mNegRlySt2 "用于上位机观察" UBYTE BMS_CM_uint8 0 0 0 255 ECU_ADDRESS 0x0000 /* @ECU_Address@RSP_mNegRlySt2@ */ /end MEASUREMENT
/begin MEASUREMENT RSP_mPosRlySt "用于上位机观察" UBYTE BMS_CM_uint8 0 0 0 255 ECU_ADDRESS 0x0000 /* @ECU_Address@RSP_mPosRlySt@ */ /end MEASUREMENT
/begin MEASUREMENT RSP_mPosRlySt2 "用于上位机观察" UBYTE BMS_CM_uint8 0 0 0 255 ECU_ADDRESS 0x0000 /* @ECU_Address@RSP_mPosRlySt2@ */ /end MEASUREMENT
/begin MEASUREMENT mTMSFaultCodeLv_U8 "热管理故障码等级，用于上位机观察" UBYTE BMS_CM_uint8 0 0 0 255 ECU_ADDRESS 0x0000 /* @ECU_Address@mTMSFaultCodeLv_U8@ */ /end MEASUREMENT
/begin MEASUREMENT SDM_DisableIso "绝缘关闭状态，用于上位机观察" ULONG BMS_CM_uint32 0 0 0 4.29497e+09 ECU_ADDRESS 0x0000 /* @ECU_Address@SDM_DisableIso@ */ /end MEASUREMENT
/begin MEASUREMENT LVM_mCC2_3ConnectErr_U8 "CC2_3连接故障，用于上位机观察" UBYTE BMS_CM_uint8 0 0 0 255 ECU_ADDRESS 0x0000 /* @ECU_Address@LVM_mCC2_3ConnectErr_U8@ */ /end MEASUREMENT
/begin MEASUREMENT LVM_mCC2_4ConnectErr_U8 "CC2_4连接故障，用于上位机观察" UBYTE BMS_CM_uint8 0 0 0 255 ECU_ADDRESS 0x0000 /* @ECU_Address@LVM_mCC2_4ConnectErr_U8@ */ /end MEASUREMENT
/begin MEASUREMENT DCOSP_tDebugBcsCur_U16 "BCS报文电流观测" UWORD BMS_CM_uint16 0 0 0 65535 ECU_ADDRESS 0x0000 /* @ECU_Address@DCOSP_tDebugBcsCur_U16@ */ /end MEASUREMENT
/begin MEASUREMENT SOH_Pack1DebugCycIndex_F32 "包1循环次数，用于上位机观察" FLOAT32_IEEE BMS_CM_single 0 0 -3.4e+38 3.4e+38 ECU_ADDRESS 0x0000 /* @ECU_Address@SOH_Pack1DebugCycIndex_F32@ */ /end MEASUREMENT
/begin MEASUREMENT SOH_Pack1DebugRealSOH_F32 "包1真实SOH，用于上位机观察" FLOAT32_IEEE BMS_CM_single 0 0 -3.4e+38 3.4e+38 ECU_ADDRESS 0x0000 /* @ECU_Address@SOH_Pack1DebugRealSOH_F32@ */ /end MEASUREMENT
/begin MEASUREMENT SOH_Pack2DebugCycIndex_F32 "包2循环次数，用于上位机观察" FLOAT32_IEEE BMS_CM_single 0 0 -3.4e+38 3.4e+38 ECU_ADDRESS 0x0000 /* @ECU_Address@SOH_Pack2DebugCycIndex_F32@ */ /end MEASUREMENT
/begin MEASUREMENT SOH_Pack2DebugRealSOH_F32 "包2真实SOH，用于上位机观察" FLOAT32_IEEE BMS_CM_single 0 0 -3.4e+38 3.4e+38 ECU_ADDRESS 0x0000 /* @ECU_Address@SOH_Pack2DebugRealSOH_F32@ */ /end MEASUREMENT
/begin MEASUREMENT SOH_Pack3DebugCycIndex_F32 "包3循环次数，用于上位机观察" FLOAT32_IEEE BMS_CM_single 0 0 -3.4e+38 3.4e+38 ECU_ADDRESS 0x0000 /* @ECU_Address@SOH_Pack3DebugCycIndex_F32@ */ /end MEASUREMENT
/begin MEASUREMENT SOH_Pack3DebugRealSOH_F32 "包3真实SOH，用于上位机观察" FLOAT32_IEEE BMS_CM_single 0 0 -3.4e+38 3.4e+38 ECU_ADDRESS 0x0000 /* @ECU_Address@SOH_Pack3DebugRealSOH_F32@ */ /end MEASUREMENT
/begin MEASUREMENT SOH_Pack4DebugCycIndex_F32 "包4循环次数，用于上位机观察" FLOAT32_IEEE BMS_CM_single 0 0 -3.4e+38 3.4e+38 ECU_ADDRESS 0x0000 /* @ECU_Address@SOH_Pack4DebugCycIndex_F32@ */ /end MEASUREMENT
/begin MEASUREMENT SOH_Pack4DebugRealSOH_F32 "包4真实SOH，用于上位机观察" FLOAT32_IEEE BMS_CM_single 0 0 -3.4e+38 3.4e+38 ECU_ADDRESS 0x0000 /* @ECU_Address@SOH_Pack4DebugRealSOH_F32@ */ /end MEASUREMENT
/begin MEASUREMENT CEB_mBMUCellBalancePositionAry_U8 "均衡控制位观测量" UBYTE BMS_CM_uint8 0 0 0 255 ECU_ADDRESS 0x0000 /* @ECU_Address@CEB_mBMUCellBalancePositionAry_U8@ */ /end MEASUREMENT
/begin MEASUREMENT CEB_mBalanceCtrlAry_U8 "压差均衡控制数组观测量（状态跳转之后）" UBYTE BMS_CM_uint8 0 0 0 255 ECU_ADDRESS 0x0000 /* @ECU_Address@CEB_mBalanceCtrlAry_U8@ */ /end MEASUREMENT
/begin MEASUREMENT CEB_mBalanceOffDiffVol_U16 "压差均衡关闭压差阈值观测量" UWORD BMS_CM_uint16 0 0 0 65535 ECU_ADDRESS 0x0000 /* @ECU_Address@CEB_mBalanceOffDiffVol_U16@ */ /end MEASUREMENT
/begin MEASUREMENT CEB_mBalanceOnDiffVol_U16 "压差均衡开启压差阈值观测量" UWORD BMS_CM_uint16 0 0 0 65535 ECU_ADDRESS 0x0000 /* @ECU_Address@CEB_mBalanceOnDiffVol_U16@ */ /end MEASUREMENT
/begin MEASUREMENT CEB_mCellBalanceState_U8 "均衡状态机跳转观测量" UBYTE BMS_CM_uint8 0 0 0 255 ECU_ADDRESS 0x0000 /* @ECU_Address@CEB_mCellBalanceState_U8@ */ /end MEASUREMENT
/begin MEASUREMENT CEB_mCellBalanceWorkReminTimeAry_U16 "均衡开启剩余时间观测量" UWORD BMS_CM_uint16 0 0 0 65535 ECU_ADDRESS 0x0000 /* @ECU_Address@CEB_mCellBalanceWorkReminTimeAry_U16@ */ /end MEASUREMENT
/begin MEASUREMENT CEB_mStaticFlag_U8 "压差均衡静态标志位观测量" UBYTE BMS_CM_uint8 0 0 0 255 ECU_ADDRESS 0x0000 /* @ECU_Address@CEB_mStaticFlag_U8@ */ /end MEASUREMENT
/begin MEASUREMENT CEB_tBalanceMaxTime_U16 "均衡最大时间观测量" UWORD BMS_CM_uint16 0 0 0 65535 ECU_ADDRESS 0x0000 /* @ECU_Address@CEB_tBalanceMaxTime_U16@ */ /end MEASUREMENT
/begin MEASUREMENT CEB_tCellRealSOCAry_F32 "所有单体SOC观测量" FLOAT32_IEEE BMS_CM_single 0 0 -3.4e+38 3.4e+38 ECU_ADDRESS 0x0000 /* @ECU_Address@CEB_tCellRealSOCAry_F32@ */ /end MEASUREMENT
/begin MEASUREMENT CEB_tDebug_U8 "CEB的Debug状态，用于上位机观察" UBYTE BMS_CM_uint8 0 0 0 255 ECU_ADDRESS 0x0000 /* @ECU_Address@CEB_tDebug_U8@ */ /end MEASUREMENT
/begin MEASUREMENT CEB_tDiffBalanceCtrlAry_U8 "压差均衡控制数组观测量" UBYTE BMS_CM_uint8 0 0 0 255 ECU_ADDRESS 0x0000 /* @ECU_Address@CEB_tDiffBalanceCtrlAry_U8@ */ /end MEASUREMENT
/begin MEASUREMENT CEB_tDiffBalanceCtrlReq_U8 "压差均衡控制请求观测量" UBYTE BMS_CM_uint8 0 0 0 255 ECU_ADDRESS 0x0000 /* @ECU_Address@CEB_tDiffBalanceCtrlReq_U8@ */ /end MEASUREMENT
/begin MEASUREMENT CEB_tDiffOfCompleteStaticSocAry_F32 "ΔSOC观测量" FLOAT32_IEEE BMS_CM_single 0 0 -3.4e+38 3.4e+38 ECU_ADDRESS 0x0000 /* @ECU_Address@CEB_tDiffOfCompleteStaticSocAry_F32@ */ /end MEASUREMENT
/begin MEASUREMENT CEB_tMaxCalSoc_F32 "最大单体SOC观测量" FLOAT32_IEEE BMS_CM_single 0 0 -3.4e+38 3.4e+38 ECU_ADDRESS 0x0000 /* @ECU_Address@CEB_tMaxCalSoc_F32@ */ /end MEASUREMENT
/begin MEASUREMENT CEB_tMinCalSoc_F32 "最小单体SOC观测量" FLOAT32_IEEE BMS_CM_single 0 0 -3.4e+38 3.4e+38 ECU_ADDRESS 0x0000 /* @ECU_Address@CEB_tMinCalSoc_F32@ */ /end MEASUREMENT
/begin MEASUREMENT CEB_tMinSocIndex_U32 "最小单体SOC所在位置观测量" ULONG BMS_CM_uint32 0 0 0 4.29497e+09 ECU_ADDRESS 0x0000 /* @ECU_Address@CEB_tMinSocIndex_U32@ */ /end MEASUREMENT
/begin MEASUREMENT CEB_tOCVAdjustFlag_U8 "OCV判定标志位观测量" UBYTE BMS_CM_uint8 0 0 0 255 ECU_ADDRESS 0x0000 /* @ECU_Address@CEB_tOCVAdjustFlag_U8@ */ /end MEASUREMENT
/begin MEASUREMENT CEB_tPwmCalInit_U8 "占空比计算初始化观测量" UBYTE BMS_CM_uint8 0 0 0 255 ECU_ADDRESS 0x0000 /* @ECU_Address@CEB_tPwmCalInit_U8@ */ /end MEASUREMENT
/begin MEASUREMENT CEB_tStaticBalanceReqLv_U8 "静态均衡控制请求等级观测量" UBYTE BMS_CM_uint8 0 0 0 255 ECU_ADDRESS 0x0000 /* @ECU_Address@CEB_tStaticBalanceReqLv_U8@ */ /end MEASUREMENT
/begin MEASUREMENT CEB_tStaticBalanceTimeAry_U16 "静态均衡剩余时间数组观测量" UWORD BMS_CM_uint16 0 0 0 65535 ECU_ADDRESS 0x0000 /* @ECU_Address@CEB_tStaticBalanceTimeAry_U16@ */ /end MEASUREMENT
/begin MEASUREMENT CHC_tDeBugCellVoltEnd "末端降流Debug状态，用于上位机观察" UBYTE BMS_CM_uint8 0 0 0 255 ECU_ADDRESS 0x0000 /* @ECU_Address@CHC_tDeBugCellVoltEnd@ */ /end MEASUREMENT
/begin MEASUREMENT CHC_tDebugDCCMLAllwMaxCurr "充电机CML报文限制的电流值，用于上位机观察" FLOAT32_IEEE BMS_CM_single 0 0 -3.4e+38 3.4e+38 ECU_ADDRESS 0x0000 /* @ECU_Address@CHC_tDebugDCCMLAllwMaxCurr@ */ /end MEASUREMENT
/begin MEASUREMENT CHC_tDebugDCCellVoltCurrReq "快充SOP查表电流值，用于上位机观察" FLOAT32_IEEE BMS_CM_single 0 0 -3.4e+38 3.4e+38 ECU_ADDRESS 0x0000 /* @ECU_Address@CHC_tDebugDCCellVoltCurrReq@ */ /end MEASUREMENT
/begin MEASUREMENT CHC_tDebugDCCurrAllow "经报警降流后的电流值，用于上位机观察" FLOAT32_IEEE BMS_CM_single 0 0 -3.4e+38 3.4e+38 ECU_ADDRESS 0x0000 /* @ECU_Address@CHC_tDebugDCCurrAllow@ */ /end MEASUREMENT
/begin MEASUREMENT CHC_tDebugDCCurrReq "未判断加热模式前的最终电流请求值，用于上位机观察" FLOAT32_IEEE BMS_CM_single 0 0 -3.4e+38 3.4e+38 ECU_ADDRESS 0x0000 /* @ECU_Address@CHC_tDebugDCCurrReq@ */ /end MEASUREMENT
/begin MEASUREMENT CHC_tDebugDCEndVoltCurrReq "末端降流后的电流值，用于上位机观察" FLOAT32_IEEE BMS_CM_single 0 0 -3.4e+38 3.4e+38 ECU_ADDRESS 0x0000 /* @ECU_Address@CHC_tDebugDCEndVoltCurrReq@ */ /end MEASUREMENT
/begin MEASUREMENT CHC_tDebugDCReqCurrwithTSM "判断加热模式后的最终电流请求值，用于上位机观察" FLOAT32_IEEE BMS_CM_single 0 0 -3.4e+38 3.4e+38 ECU_ADDRESS 0x0000 /* @ECU_Address@CHC_tDebugDCReqCurrwithTSM@ */ /end MEASUREMENT
/begin MEASUREMENT SOCRC_tDebugKFOneFixValue1Max "一阶模型FixValue的第一个值，用于观察" FLOAT32_IEEE BMS_CM_single 0 0 -3.4e+38 3.4e+38 ECU_ADDRESS 0x0000 /* @ECU_Address@SOCRC_tDebugKFOneFixValue1Max@ */ /end MEASUREMENT
/begin MEASUREMENT SOCRC_tDebugKFOneFixValue1Min "一阶模型FixValue的第一个值，用于观察" FLOAT32_IEEE BMS_CM_single 0 0 -3.4e+38 3.4e+38 ECU_ADDRESS 0x0000 /* @ECU_Address@SOCRC_tDebugKFOneFixValue1Min@ */ /end MEASUREMENT
/begin MEASUREMENT SOCRC_tDebugKFOneFixValue2Max "一阶模型FixValue的第二个值，用于观察" FLOAT32_IEEE BMS_CM_single 0 0 -3.4e+38 3.4e+38 ECU_ADDRESS 0x0000 /* @ECU_Address@SOCRC_tDebugKFOneFixValue2Max@ */ /end MEASUREMENT
/begin MEASUREMENT SOCRC_tDebugKFOneFixValue2Min "一阶模型FixValue的第二个值，用于观察" FLOAT32_IEEE BMS_CM_single 0 0 -3.4e+38 3.4e+38 ECU_ADDRESS 0x0000 /* @ECU_Address@SOCRC_tDebugKFOneFixValue2Min@ */ /end MEASUREMENT
/begin MEASUREMENT SOCRC_tDebugKFOneP1Max "一阶模型P的第一个值，用于观察" FLOAT32_IEEE BMS_CM_single 0 0 -3.4e+38 3.4e+38 ECU_ADDRESS 0x0000 /* @ECU_Address@SOCRC_tDebugKFOneP1Max@ */ /end MEASUREMENT
/begin MEASUREMENT SOCRC_tDebugKFOneP1Min "一阶模型P的第一个值，用于观察" FLOAT32_IEEE BMS_CM_single 0 0 -3.4e+38 3.4e+38 ECU_ADDRESS 0x0000 /* @ECU_Address@SOCRC_tDebugKFOneP1Min@ */ /end MEASUREMENT
/begin MEASUREMENT SOCRC_tDebugKFOneP2Max "一阶模型P的第二个值，用于观察" FLOAT32_IEEE BMS_CM_single 0 0 -3.4e+38 3.4e+38 ECU_ADDRESS 0x0000 /* @ECU_Address@SOCRC_tDebugKFOneP2Max@ */ /end MEASUREMENT
/begin MEASUREMENT SOCRC_tDebugKFOneP2Min "一阶模型P的第二个值，用于观察" FLOAT32_IEEE BMS_CM_single 0 0 -3.4e+38 3.4e+38 ECU_ADDRESS 0x0000 /* @ECU_Address@SOCRC_tDebugKFOneP2Min@ */ /end MEASUREMENT
/begin MEASUREMENT SOCRC_tDebugKFOneP3Max "一阶模型P的第三个值，用于观察" FLOAT32_IEEE BMS_CM_single 0 0 -3.4e+38 3.4e+38 ECU_ADDRESS 0x0000 /* @ECU_Address@SOCRC_tDebugKFOneP3Max@ */ /end MEASUREMENT
/begin MEASUREMENT SOCRC_tDebugKFOneP3Min "一阶模型P的第三个值，用于观察" FLOAT32_IEEE BMS_CM_single 0 0 -3.4e+38 3.4e+38 ECU_ADDRESS 0x0000 /* @ECU_Address@SOCRC_tDebugKFOneP3Min@ */ /end MEASUREMENT
/begin MEASUREMENT SOCRC_tDebugKFOneP4Max "一阶模型P的第四个值，用于观察" FLOAT32_IEEE BMS_CM_single 0 0 -3.4e+38 3.4e+38 ECU_ADDRESS 0x0000 /* @ECU_Address@SOCRC_tDebugKFOneP4Max@ */ /end MEASUREMENT
/begin MEASUREMENT SOCRC_tDebugKFOneP4Min "一阶模型P的第四个值，用于观察" FLOAT32_IEEE BMS_CM_single 0 0 -3.4e+38 3.4e+38 ECU_ADDRESS 0x0000 /* @ECU_Address@SOCRC_tDebugKFOneP4Min@ */ /end MEASUREMENT
/begin MEASUREMENT SOCRC_tDebugKFOneSOCMax "一阶模型SOC值，用于观察" FLOAT32_IEEE BMS_CM_single 0 0 -3.4e+38 3.4e+38 ECU_ADDRESS 0x0000 /* @ECU_Address@SOCRC_tDebugKFOneSOCMax@ */ /end MEASUREMENT
/begin MEASUREMENT SOCRC_tDebugKFOneSOCMin "一阶模型SOC值，用于观察" FLOAT32_IEEE BMS_CM_single 0 0 -3.4e+38 3.4e+38 ECU_ADDRESS 0x0000 /* @ECU_Address@SOCRC_tDebugKFOneSOCMin@ */ /end MEASUREMENT
/begin MEASUREMENT SOCRC_tDebugKFOneUpMax "一阶模型 Up值，用于观察" FLOAT32_IEEE BMS_CM_single 0 0 -3.4e+38 3.4e+38 ECU_ADDRESS 0x0000 /* @ECU_Address@SOCRC_tDebugKFOneUpMax@ */ /end MEASUREMENT
/begin MEASUREMENT SOCRC_tDebugKFOneUpMin "一阶模型 Up值，用于观察" FLOAT32_IEEE BMS_CM_single 0 0 -3.4e+38 3.4e+38 ECU_ADDRESS 0x0000 /* @ECU_Address@SOCRC_tDebugKFOneUpMin@ */ /end MEASUREMENT
/begin MEASUREMENT SOCRC_tDebugKFOneerrorVMax "一阶模型 errorV值，用于观察" FLOAT32_IEEE BMS_CM_single 0 0 -3.4e+38 3.4e+38 ECU_ADDRESS 0x0000 /* @ECU_Address@SOCRC_tDebugKFOneerrorVMax@ */ /end MEASUREMENT
/begin MEASUREMENT SOCRC_tDebugKFOneerrorVMin "一阶模型 errorV值，用于观察" FLOAT32_IEEE BMS_CM_single 0 0 -3.4e+38 3.4e+38 ECU_ADDRESS 0x0000 /* @ECU_Address@SOCRC_tDebugKFOneerrorVMin@ */ /end MEASUREMENT
/begin MEASUREMENT SOC_DebugStaticTime "当前温度下电池静置的时间，用于DeBUG" ULONG BMS_CM_uint32 0 0 0 4.29497e+09 ECU_ADDRESS 0x0000 /* @ECU_Address@SOC_DebugStaticTime@ */ /end MEASUREMENT
/begin MEASUREMENT SOC_tDebugCalibrationSocSuccess "SOC标定成功，用于观察" UBYTE BMS_CM_uint8 0 0 0 255 ECU_ADDRESS 0x0000 /* @ECU_Address@SOC_tDebugCalibrationSocSuccess@ */ /end MEASUREMENT
/begin MEASUREMENT SOC_tDebugCellRealMaxSOC "最大真实SOC" FLOAT32_IEEE BMS_CM_single 0 0 -3.4e+38 3.4e+38 ECU_ADDRESS 0x0000 /* @ECU_Address@SOC_tDebugCellRealMaxSOC@ */ /end MEASUREMENT
/begin MEASUREMENT SOC_tDebugCellRealMinSOC "最小真实SOC" FLOAT32_IEEE BMS_CM_single 0 0 -3.4e+38 3.4e+38 ECU_ADDRESS 0x0000 /* @ECU_Address@SOC_tDebugCellRealMinSOC@ */ /end MEASUREMENT
/begin MEASUREMENT SOC_tDebugFollowSOCStateNum "追随SOC状态机DeBUG" UBYTE BMS_CM_uint8 0 0 0 255 ECU_ADDRESS 0x0000 /* @ECU_Address@SOC_tDebugFollowSOCStateNum@ */ /end MEASUREMENT
/begin MEASUREMENT SOC_tDebugFullEmpCaledMax "满充校准完成，用于上位机观察" UBYTE BMS_CM_uint8 0 0 0 255 ECU_ADDRESS 0x0000 /* @ECU_Address@SOC_tDebugFullEmpCaledMax@ */ /end MEASUREMENT
/begin MEASUREMENT SOC_tDebugFullEmpCaledMin "满放校准完成，用于上位机观察" UBYTE BMS_CM_uint8 0 0 0 255 ECU_ADDRESS 0x0000 /* @ECU_Address@SOC_tDebugFullEmpCaledMin@ */ /end MEASUREMENT
/begin MEASUREMENT SOC_tDebugPack1BeforeFullEmpCaledMax "Pack1最大SOC满电前校准完成，用于上位机观察" UBYTE BMS_CM_uint8 0 0 0 255 ECU_ADDRESS 0x0000 /* @ECU_Address@SOC_tDebugPack1BeforeFullEmpCaledMax@ */ /end MEASUREMENT
/begin MEASUREMENT SOC_tDebugPack1BeforeFullEmpCaledMin "Pack1最小SOC满电前校准完成，用于上位机观察" UBYTE BMS_CM_uint8 0 0 0 255 ECU_ADDRESS 0x0000 /* @ECU_Address@SOC_tDebugPack1BeforeFullEmpCaledMin@ */ /end MEASUREMENT
/begin MEASUREMENT SOC_tDebugPack1StaticCalFlg "Pack1SOC静态校准完成，用于上位机观察" UBYTE BMS_CM_uint8 0 0 0 255 ECU_ADDRESS 0x0000 /* @ECU_Address@SOC_tDebugPack1StaticCalFlg@ */ /end MEASUREMENT
/begin MEASUREMENT SOC_tDebugPack2BeforeFullEmpCaledMax "Pack2最大SOC满电前校准完成，用于上位机观察" UBYTE BMS_CM_uint8 0 0 0 255 ECU_ADDRESS 0x0000 /* @ECU_Address@SOC_tDebugPack2BeforeFullEmpCaledMax@ */ /end MEASUREMENT
/begin MEASUREMENT SOC_tDebugPack2BeforeFullEmpCaledMin "Pack2最小SOC满电前校准完成，用于上位机观察" UBYTE BMS_CM_uint8 0 0 0 255 ECU_ADDRESS 0x0000 /* @ECU_Address@SOC_tDebugPack2BeforeFullEmpCaledMin@ */ /end MEASUREMENT
/begin MEASUREMENT SOC_tDebugPack2StaticCalFlg "Pack2SOC静态校准完成，用于上位机观察" UBYTE BMS_CM_uint8 0 0 0 255 ECU_ADDRESS 0x0000 /* @ECU_Address@SOC_tDebugPack2StaticCalFlg@ */ /end MEASUREMENT
/begin MEASUREMENT SOC_tDebugRealSOC "真实SOC" FLOAT32_IEEE BMS_CM_single 0 0 -3.4e+38 3.4e+38 ECU_ADDRESS 0x0000 /* @ECU_Address@SOC_tDebugRealSOC@ */ /end MEASUREMENT
/begin MEASUREMENT FPM_TMSHVOffReq_U8 "热管理请求下电，用于上位机观察" UBYTE BMS_CM_uint8 0 0 0 255 ECU_ADDRESS 0x0000 /* @ECU_Address@FPM_TMSHVOffReq_U8@ */ /end MEASUREMENT
/begin MEASUREMENT FPM_TMSShutDownReq_U8 "热管理请求关机，用于上位机观察" UBYTE BMS_CM_uint8 0 0 0 255 ECU_ADDRESS 0x0000 /* @ECU_Address@FPM_TMSShutDownReq_U8@ */ /end MEASUREMENT
/begin MEASUREMENT FPM_tACChrgFunctions "慢充功能，用于上位机观察" UBYTE BMS_CM_uint8 0 0 0 255 ECU_ADDRESS 0x0000 /* @ECU_Address@FPM_tACChrgFunctions@ */ /end MEASUREMENT
/begin MEASUREMENT FPM_tBalanceFunctions "均衡功能功能，用于上位机观察" UBYTE BMS_CM_uint8 0 0 0 255 ECU_ADDRESS 0x0000 /* @ECU_Address@FPM_tBalanceFunctions@ */ /end MEASUREMENT
/begin MEASUREMENT FPM_tBattCurrentRelatedFunctions "电流相关功能，用于上位机观察" UBYTE BMS_CM_uint8 0 0 0 255 ECU_ADDRESS 0x0000 /* @ECU_Address@FPM_tBattCurrentRelatedFunctions@ */ /end MEASUREMENT
/begin MEASUREMENT FPM_tBattVoltRelatedFunctions "总压相关功能，用于上位机观察" UBYTE BMS_CM_uint8 0 0 0 255 ECU_ADDRESS 0x0000 /* @ECU_Address@FPM_tBattVoltRelatedFunctions@ */ /end MEASUREMENT
/begin MEASUREMENT FPM_tCellTempRelatedFunctions "单体温度相关功能，用于上位机观察" UBYTE BMS_CM_uint8 0 0 0 255 ECU_ADDRESS 0x0000 /* @ECU_Address@FPM_tCellTempRelatedFunctions@ */ /end MEASUREMENT
/begin MEASUREMENT FPM_tCellVoltRelatedFunctions "单体电压相关功能，用于上位机观察" UBYTE BMS_CM_uint8 0 0 0 255 ECU_ADDRESS 0x0000 /* @ECU_Address@FPM_tCellVoltRelatedFunctions@ */ /end MEASUREMENT
/begin MEASUREMENT FPM_tChargePause "充电暂停，用于上位机观察" UBYTE BMS_CM_uint8 0 0 0 255 ECU_ADDRESS 0x0000 /* @ECU_Address@FPM_tChargePause@ */ /end MEASUREMENT
/begin MEASUREMENT FPM_tChrgFltLevel "充电故障等级，用于上位机观察" UBYTE BMS_CM_uint8 0 0 0 255 ECU_ADDRESS 0x0000 /* @ECU_Address@FPM_tChrgFltLevel@ */ /end MEASUREMENT
/begin MEASUREMENT FPM_tDCChrg2Functions "快充功能，用于上位机观察" UBYTE BMS_CM_uint8 0 0 0 255 ECU_ADDRESS 0x0000 /* @ECU_Address@FPM_tDCChrg2Functions@ */ /end MEASUREMENT
/begin MEASUREMENT FPM_tDCChrg3Functions "快充功能，用于上位机观察" UBYTE BMS_CM_uint8 0 0 0 255 ECU_ADDRESS 0x0000 /* @ECU_Address@FPM_tDCChrg3Functions@ */ /end MEASUREMENT
/begin MEASUREMENT FPM_tDCChrg4Functions "快充功能，用于上位机观察" UBYTE BMS_CM_uint8 0 0 0 255 ECU_ADDRESS 0x0000 /* @ECU_Address@FPM_tDCChrg4Functions@ */ /end MEASUREMENT
/begin MEASUREMENT FPM_tDCChrgFunctions "快充功能，用于上位机观察" UBYTE BMS_CM_uint8 0 0 0 255 ECU_ADDRESS 0x0000 /* @ECU_Address@FPM_tDCChrgFunctions@ */ /end MEASUREMENT
/begin MEASUREMENT FPM_tDiscFltLevel "放电故障等级，用于上位机观察" UBYTE BMS_CM_uint8 0 0 0 255 ECU_ADDRESS 0x0000 /* @ECU_Address@FPM_tDiscFltLevel@ */ /end MEASUREMENT
/begin MEASUREMENT FPM_tDiscFunctions "放电功能，用于上位机观察" UBYTE BMS_CM_uint8 0 0 0 255 ECU_ADDRESS 0x0000 /* @ECU_Address@FPM_tDiscFunctions@ */ /end MEASUREMENT
/begin MEASUREMENT FPM_tEmerPowOff "紧急下电，用于上位机观察" UBYTE BMS_CM_uint8 0 0 0 255 ECU_ADDRESS 0x0000 /* @ECU_Address@FPM_tEmerPowOff@ */ /end MEASUREMENT
/begin MEASUREMENT FPM_tFeedBackFunctions "回馈功能，用于上位机观察" UBYTE BMS_CM_uint8 0 0 0 255 ECU_ADDRESS 0x0000 /* @ECU_Address@FPM_tFeedBackFunctions@ */ /end MEASUREMENT
/begin MEASUREMENT FPM_tFltLevel "故障等级，用于上位机观察" UBYTE BMS_CM_uint8 0 0 0 255 ECU_ADDRESS 0x0000 /* @ECU_Address@FPM_tFltLevel@ */ /end MEASUREMENT
/begin MEASUREMENT FPM_tFltLight "电池故障灯，用于上位机观察" UBYTE BMS_CM_uint8 0 0 0 255 ECU_ADDRESS 0x0000 /* @ECU_Address@FPM_tFltLight@ */ /end MEASUREMENT
/begin MEASUREMENT FPM_tInsulationResRelatedFunctions "绝缘阻值相关功能，用于上位机观察" UBYTE BMS_CM_uint8 0 0 0 255 ECU_ADDRESS 0x0000 /* @ECU_Address@FPM_tInsulationResRelatedFunctions@ */ /end MEASUREMENT
/begin MEASUREMENT FPM_tLimpPow "跛行模式，用于上位机观察" UBYTE BMS_CM_uint8 0 0 0 255 ECU_ADDRESS 0x0000 /* @ECU_Address@FPM_tLimpPow@ */ /end MEASUREMENT
/begin MEASUREMENT FPM_tRLyFunctions "继电器功能，用于上位机观察" UBYTE BMS_CM_uint8 0 0 0 255 ECU_ADDRESS 0x0000 /* @ECU_Address@FPM_tRLyFunctions@ */ /end MEASUREMENT
/begin MEASUREMENT FPM_tReACChrgPow "降放电功率，用于上位机观察" UBYTE BMS_CM_uint8 0 0 0 255 ECU_ADDRESS 0x0000 /* @ECU_Address@FPM_tReACChrgPow@ */ /end MEASUREMENT
/begin MEASUREMENT FPM_tReDCChrg2Pow "降快充功率，用于上位机观察" UBYTE BMS_CM_uint8 0 0 0 255 ECU_ADDRESS 0x0000 /* @ECU_Address@FPM_tReDCChrg2Pow@ */ /end MEASUREMENT
/begin MEASUREMENT FPM_tReDCChrg3Pow "降快充功率，用于上位机观察" UBYTE BMS_CM_uint8 0 0 0 255 ECU_ADDRESS 0x0000 /* @ECU_Address@FPM_tReDCChrg3Pow@ */ /end MEASUREMENT
/begin MEASUREMENT FPM_tReDCChrg4Pow "降快充功率，用于上位机观察" UBYTE BMS_CM_uint8 0 0 0 255 ECU_ADDRESS 0x0000 /* @ECU_Address@FPM_tReDCChrg4Pow@ */ /end MEASUREMENT
/begin MEASUREMENT FPM_tReDCChrgPow "降快充功率，用于上位机观察" UBYTE BMS_CM_uint8 0 0 0 255 ECU_ADDRESS 0x0000 /* @ECU_Address@FPM_tReDCChrgPow@ */ /end MEASUREMENT
/begin MEASUREMENT FPM_tReDiscPow "降慢充功率，用于上位机观察" UBYTE BMS_CM_uint8 0 0 0 255 ECU_ADDRESS 0x0000 /* @ECU_Address@FPM_tReDiscPow@ */ /end MEASUREMENT
/begin MEASUREMENT FPM_tReFBPow "降回馈功率，用于上位机观察" UBYTE BMS_CM_uint8 0 0 0 255 ECU_ADDRESS 0x0000 /* @ECU_Address@FPM_tReFBPow@ */ /end MEASUREMENT
/begin MEASUREMENT FPM_tSOCRelatedFunctions "SOC相关功能，用于上位机观察" UBYTE BMS_CM_uint8 0 0 0 255 ECU_ADDRESS 0x0000 /* @ECU_Address@FPM_tSOCRelatedFunctions@ */ /end MEASUREMENT
/begin MEASUREMENT FPM_tSafeStop "安全停车功能，用于上位机观察" UBYTE BMS_CM_uint8 0 0 0 255 ECU_ADDRESS 0x0000 /* @ECU_Address@FPM_tSafeStop@ */ /end MEASUREMENT
/begin MEASUREMENT FPM_tSelfCheck "自检功能，用于上位机观察" UBYTE BMS_CM_uint8 0 0 0 255 ECU_ADDRESS 0x0000 /* @ECU_Address@FPM_tSelfCheck@ */ /end MEASUREMENT
/begin MEASUREMENT FPM_tSupplyVoltRelatedFunctions "主控供电相关功能，用于上位机观察" UBYTE BMS_CM_uint8 0 0 0 255 ECU_ADDRESS 0x0000 /* @ECU_Address@FPM_tSupplyVoltRelatedFunctions@ */ /end MEASUREMENT
/begin MEASUREMENT FPM_tThermalManageFunctions "热管理功能，用于上位机观察" UBYTE BMS_CM_uint8 0 0 0 255 ECU_ADDRESS 0x0000 /* @ECU_Address@FPM_tThermalManageFunctions@ */ /end MEASUREMENT
/begin MEASUREMENT BDM_mBranchRoadBreak_U8 "支路断路故障，用于上位机观察" UBYTE BMS_CM_uint8 0 0 0 255 ECU_ADDRESS 0x0000 /* @ECU_Address@BDM_mBranchRoadBreak_U8@ */ /end MEASUREMENT
/begin MEASUREMENT BDM_mCellTempOverHiLv_U8 "单体温度极限过高故障等级，用于上位机观察" UBYTE BMS_CM_uint8 0 0 0 255 ECU_ADDRESS 0x0000 /* @ECU_Address@BDM_mCellTempOverHiLv_U8@ */ /end MEASUREMENT
/begin MEASUREMENT BDM_mCellVoltLimitLoLv_U8 "单体电压极限过低故障等级，用于上位机观察" UBYTE BMS_CM_uint8 0 0 0 255 ECU_ADDRESS 0x0000 /* @ECU_Address@BDM_mCellVoltLimitLoLv_U8@ */ /end MEASUREMENT
/begin MEASUREMENT BDM_mCellVoltOverHiLv_U8 "单体电压极限过高故障等级，用于上位机观察" UBYTE BMS_CM_uint8 0 0 0 255 ECU_ADDRESS 0x0000 /* @ECU_Address@BDM_mCellVoltOverHiLv_U8@ */ /end MEASUREMENT
/begin MEASUREMENT BDM_mCellVoltOverLoLv_U8 "电芯过放故障等级，用于上位机观察" UBYTE BMS_CM_uint8 0 0 0 255 ECU_ADDRESS 0x0000 /* @ECU_Address@BDM_mCellVoltOverLoLv_U8@ */ /end MEASUREMENT
/begin MEASUREMENT BDM_mChgDiscCurrHiLv_U8 "充电时放电电流过大故障等级，用于上位机观察" UBYTE BMS_CM_uint8 0 0 0 255 ECU_ADDRESS 0x0000 /* @ECU_Address@BDM_mChgDiscCurrHiLv_U8@ */ /end MEASUREMENT
/begin MEASUREMENT BDM_mChgIResLo_U8 "充电绝缘阻值过低故障等级，用于上位机观察" UBYTE BMS_CM_uint8 0 0 0 255 ECU_ADDRESS 0x0000 /* @ECU_Address@BDM_mChgIResLo_U8@ */ /end MEASUREMENT
/begin MEASUREMENT BDM_mPlantTempHiErr_U8 "板载温度过高故障，用于上位机观察" UBYTE BMS_CM_uint8 0 0 0 255 ECU_ADDRESS 0x0000 /* @ECU_Address@BDM_mPlantTempHiErr_U8@ */ /end MEASUREMENT
/begin MEASUREMENT BDM_mReChgEngSysmatchErr_U8 "充电储能系统不匹配故障，用于上位机观察" UBYTE BMS_CM_uint8 0 0 0 255 ECU_ADDRESS 0x0000 /* @ECU_Address@BDM_mReChgEngSysmatchErr_U8@ */ /end MEASUREMENT
/begin MEASUREMENT BDM_tACChgCurrHiLv "慢充电流过大故障等级，用于上位机观察" UBYTE BMS_CM_uint8 0 0 0 255 ECU_ADDRESS 0x0000 /* @ECU_Address@BDM_tACChgCurrHiLv@ */ /end MEASUREMENT
/begin MEASUREMENT BDM_tACNegTempHiLv "交流充电插座负极温度过高故障，用于上位机观察" UBYTE BMS_CM_uint8 0 0 0 255 ECU_ADDRESS 0x0000 /* @ECU_Address@BDM_tACNegTempHiLv@ */ /end MEASUREMENT
/begin MEASUREMENT BDM_tACPosTempHiLv "交流充电插座正极温度过高故障，用于上位机观察" UBYTE BMS_CM_uint8 0 0 0 255 ECU_ADDRESS 0x0000 /* @ECU_Address@BDM_tACPosTempHiLv@ */ /end MEASUREMENT
/begin MEASUREMENT BDM_tActInputVoltErr "车上_电气故障(电机控制器上报电压异常)，用于上位机观察" UBYTE BMS_CM_uint8 0 0 0 255 ECU_ADDRESS 0x0000 /* @ECU_Address@BDM_tActInputVoltErr@ */ /end MEASUREMENT
/begin MEASUREMENT BDM_tBIResLoLv "车上_电池系统绝缘异常，用于上位机观察" UBYTE BMS_CM_uint8 0 0 0 255 ECU_ADDRESS 0x0000 /* @ECU_Address@BDM_tBIResLoLv@ */ /end MEASUREMENT
/begin MEASUREMENT BDM_tBatResErr "电池绝缘故障，用于上位机观察" UBYTE BMS_CM_uint8 0 0 0 255 ECU_ADDRESS 0x0000 /* @ECU_Address@BDM_tBatResErr@ */ /end MEASUREMENT
/begin MEASUREMENT BDM_tBattVoltErr "车上_电池总压采样异常（PACK总压采样异常)，用于上位机观察" UBYTE BMS_CM_uint8 0 0 0 255 ECU_ADDRESS 0x0000 /* @ECU_Address@BDM_tBattVoltErr@ */ /end MEASUREMENT
/begin MEASUREMENT BDM_tBattVoltHiLv "总压过高故障等级，用于上位机观察" UBYTE BMS_CM_uint8 0 0 0 255 ECU_ADDRESS 0x0000 /* @ECU_Address@BDM_tBattVoltHiLv@ */ /end MEASUREMENT
/begin MEASUREMENT BDM_tBattVoltLoLv "总压过低故障等级，用于上位机观察" UBYTE BMS_CM_uint8 0 0 0 255 ECU_ADDRESS 0x0000 /* @ECU_Address@BDM_tBattVoltLoLv@ */ /end MEASUREMENT
/begin MEASUREMENT BDM_tCellTempDiffHiLv "单体温差过大故障等级，用于上位机观察" UBYTE BMS_CM_uint8 0 0 0 255 ECU_ADDRESS 0x0000 /* @ECU_Address@BDM_tCellTempDiffHiLv@ */ /end MEASUREMENT
/begin MEASUREMENT BDM_tCellTempExceedMaxChgTemp "最高单体温度超过最高允许充电温度故障，用于上位机观察" UBYTE BMS_CM_uint8 0 0 0 255 ECU_ADDRESS 0x0000 /* @ECU_Address@BDM_tCellTempExceedMaxChgTemp@ */ /end MEASUREMENT
/begin MEASUREMENT BDM_tCellTempHiLv "单体温度过高故障等级，用于上位机观察" UBYTE BMS_CM_uint8 0 0 0 255 ECU_ADDRESS 0x0000 /* @ECU_Address@BDM_tCellTempHiLv@ */ /end MEASUREMENT
/begin MEASUREMENT BDM_tCellTempLowerMaxChgTemp "最低单体电压低于最低允许充电电压，用于上位机观察" UBYTE BMS_CM_uint8 0 0 0 255 ECU_ADDRESS 0x0000 /* @ECU_Address@BDM_tCellTempLowerMaxChgTemp@ */ /end MEASUREMENT
/begin MEASUREMENT BDM_tCellVoltDiffHiLv "单体压差过大故障等级，用于上位机观察" UBYTE BMS_CM_uint8 0 0 0 255 ECU_ADDRESS 0x0000 /* @ECU_Address@BDM_tCellVoltDiffHiLv@ */ /end MEASUREMENT
/begin MEASUREMENT BDM_tCellVoltHiLv "单体电压过高故障等级，用于上位机观察" UBYTE BMS_CM_uint8 0 0 0 255 ECU_ADDRESS 0x0000 /* @ECU_Address@BDM_tCellVoltHiLv@ */ /end MEASUREMENT
/begin MEASUREMENT BDM_tCellVoltLoLv "单体电压过低故障等级，用于上位机观察" UBYTE BMS_CM_uint8 0 0 0 255 ECU_ADDRESS 0x0000 /* @ECU_Address@BDM_tCellVoltLoLv@ */ /end MEASUREMENT
/begin MEASUREMENT BDM_tChgBattVoltHiLv "充电总压过高故障等级，用于上位机观察" UBYTE BMS_CM_uint8 0 0 0 255 ECU_ADDRESS 0x0000 /* @ECU_Address@BDM_tChgBattVoltHiLv@ */ /end MEASUREMENT
/begin MEASUREMENT BDM_tChgCellTempHiLv "充电单体温度过高故障等级，用于上位机观察" UBYTE BMS_CM_uint8 0 0 0 255 ECU_ADDRESS 0x0000 /* @ECU_Address@BDM_tChgCellTempHiLv@ */ /end MEASUREMENT
/begin MEASUREMENT BDM_tChgCellTempLoLv "充电单体温度过低故障等级，用于上位机观察" UBYTE BMS_CM_uint8 0 0 0 255 ECU_ADDRESS 0x0000 /* @ECU_Address@BDM_tChgCellTempLoLv@ */ /end MEASUREMENT
/begin MEASUREMENT BDM_tChgCellVoltHiLv "充电单体电压过高故障等级，用于上位机观察" UBYTE BMS_CM_uint8 0 0 0 255 ECU_ADDRESS 0x0000 /* @ECU_Address@BDM_tChgCellVoltHiLv@ */ /end MEASUREMENT
/begin MEASUREMENT BDM_tChgCurrAbnormErr "充电电流异常故障，用于上位机观察" UBYTE BMS_CM_uint8 0 0 0 255 ECU_ADDRESS 0x0000 /* @ECU_Address@BDM_tChgCurrAbnormErr@ */ /end MEASUREMENT
/begin MEASUREMENT BDM_tChgIResLo "充电绝缘阻值过低，用于上位机观察" UBYTE BMS_CM_uint8 0 0 0 255 ECU_ADDRESS 0x0000 /* @ECU_Address@BDM_tChgIResLo@ */ /end MEASUREMENT
/begin MEASUREMENT BDM_tDCChgCurrHiLv "快充电流过大故障等级，用于上位机观察" UBYTE BMS_CM_uint8 0 0 0 255 ECU_ADDRESS 0x0000 /* @ECU_Address@BDM_tDCChgCurrHiLv@ */ /end MEASUREMENT
/begin MEASUREMENT BDM_tDCNegTempHiLv "直流充电插座负极温度过高故障，用于上位机观察" UBYTE BMS_CM_uint8 0 0 0 255 ECU_ADDRESS 0x0000 /* @ECU_Address@BDM_tDCNegTempHiLv@ */ /end MEASUREMENT
/begin MEASUREMENT BDM_tDCNeg_2TempHiLv "直流充电插座负极温度过高故障，用于上位机观察" UBYTE BMS_CM_uint8 0 0 0 255 ECU_ADDRESS 0x0000 /* @ECU_Address@BDM_tDCNeg_2TempHiLv@ */ /end MEASUREMENT
/begin MEASUREMENT BDM_tDCNeg_3TempHiLv "直流充电插座负极温度过高故障，用于上位机观察" UBYTE BMS_CM_uint8 0 0 0 255 ECU_ADDRESS 0x0000 /* @ECU_Address@BDM_tDCNeg_3TempHiLv@ */ /end MEASUREMENT
/begin MEASUREMENT BDM_tDCNeg_4TempHiLv "直流充电插座负极温度过高故障，用于上位机观察" UBYTE BMS_CM_uint8 0 0 0 255 ECU_ADDRESS 0x0000 /* @ECU_Address@BDM_tDCNeg_4TempHiLv@ */ /end MEASUREMENT
/begin MEASUREMENT BDM_tDCPosTempHiLv "直流充电插座正极温度过高故障，用于上位机观察" UBYTE BMS_CM_uint8 0 0 0 255 ECU_ADDRESS 0x0000 /* @ECU_Address@BDM_tDCPosTempHiLv@ */ /end MEASUREMENT
/begin MEASUREMENT BDM_tDCPos_2TempHiLv "直流充电插座正极温度过高故障，用于上位机观察" UBYTE BMS_CM_uint8 0 0 0 255 ECU_ADDRESS 0x0000 /* @ECU_Address@BDM_tDCPos_2TempHiLv@ */ /end MEASUREMENT
/begin MEASUREMENT BDM_tDCPos_3TempHiLv "直流充电插座正极温度过高故障，用于上位机观察" UBYTE BMS_CM_uint8 0 0 0 255 ECU_ADDRESS 0x0000 /* @ECU_Address@BDM_tDCPos_3TempHiLv@ */ /end MEASUREMENT
/begin MEASUREMENT BDM_tDCPos_4TempHiLv "直流充电插座正极温度过高故障，用于上位机观察" UBYTE BMS_CM_uint8 0 0 0 255 ECU_ADDRESS 0x0000 /* @ECU_Address@BDM_tDCPos_4TempHiLv@ */ /end MEASUREMENT
/begin MEASUREMENT BDM_tDiscCurrHiLv "放电电流过大故障等级，用于上位机观察" UBYTE BMS_CM_uint8 0 0 0 255 ECU_ADDRESS 0x0000 /* @ECU_Address@BDM_tDiscCurrHiLv@ */ /end MEASUREMENT
/begin MEASUREMENT BDM_tDischgBattVoltHiLv "放电总压过高故障等级，用于上位机观察" UBYTE BMS_CM_uint8 0 0 0 255 ECU_ADDRESS 0x0000 /* @ECU_Address@BDM_tDischgBattVoltHiLv@ */ /end MEASUREMENT
/begin MEASUREMENT BDM_tDischgCellTempHiLv "放电单体温度过高故障等级，用于上位机观察" UBYTE BMS_CM_uint8 0 0 0 255 ECU_ADDRESS 0x0000 /* @ECU_Address@BDM_tDischgCellTempHiLv@ */ /end MEASUREMENT
/begin MEASUREMENT BDM_tDischgCellTempLoLv "放电单体温度过低故障等级，用于上位机观察" UBYTE BMS_CM_uint8 0 0 0 255 ECU_ADDRESS 0x0000 /* @ECU_Address@BDM_tDischgCellTempLoLv@ */ /end MEASUREMENT
/begin MEASUREMENT BDM_tDischgCellVoltHiLv "放电单体电压过高故障等级，用于上位机观察" UBYTE BMS_CM_uint8 0 0 0 255 ECU_ADDRESS 0x0000 /* @ECU_Address@BDM_tDischgCellVoltHiLv@ */ /end MEASUREMENT
/begin MEASUREMENT BDM_tFBCurrHiLv "回馈电流过大故障等级，用于上位机观察" UBYTE BMS_CM_uint8 0 0 0 255 ECU_ADDRESS 0x0000 /* @ECU_Address@BDM_tFBCurrHiLv@ */ /end MEASUREMENT
/begin MEASUREMENT BDM_tFuseBreakErr "Fuse熔断故障，用于上位机观察" UBYTE BMS_CM_uint8 0 0 0 255 ECU_ADDRESS 0x0000 /* @ECU_Address@BDM_tFuseBreakErr@ */ /end MEASUREMENT
/begin MEASUREMENT BDM_tHeatUncontrolErr "热失控故障，用于上位机观察" UBYTE BMS_CM_uint8 0 0 0 255 ECU_ADDRESS 0x0000 /* @ECU_Address@BDM_tHeatUncontrolErr@ */ /end MEASUREMENT
/begin MEASUREMENT BDM_tIResLoLv "行车绝缘阻值过低故障等级，用于上位机观察" UBYTE BMS_CM_uint8 0 0 0 255 ECU_ADDRESS 0x0000 /* @ECU_Address@BDM_tIResLoLv@ */ /end MEASUREMENT
/begin MEASUREMENT BDM_tNegResLoLv "负极绝缘阻值过低故障等级，用于上位机观察" UBYTE BMS_CM_uint8 0 0 0 255 ECU_ADDRESS 0x0000 /* @ECU_Address@BDM_tNegResLoLv@ */ /end MEASUREMENT
/begin MEASUREMENT BDM_tOverChg "电池过充故障，用于上位机观察" UBYTE BMS_CM_uint8 0 0 0 255 ECU_ADDRESS 0x0000 /* @ECU_Address@BDM_tOverChg@ */ /end MEASUREMENT
/begin MEASUREMENT BDM_tPackNegTempHiLv "电池包极柱负极温度过高故障，用于上位机观察" UBYTE BMS_CM_uint8 0 0 0 255 ECU_ADDRESS 0x0000 /* @ECU_Address@BDM_tPackNegTempHiLv@ */ /end MEASUREMENT
/begin MEASUREMENT BDM_tPackPosTempHiLv "电池包极柱正极温度过高故障，用于上位机观察" UBYTE BMS_CM_uint8 0 0 0 255 ECU_ADDRESS 0x0000 /* @ECU_Address@BDM_tPackPosTempHiLv@ */ /end MEASUREMENT
/begin MEASUREMENT BDM_tPosResLoLv "正极绝缘阻值过低故障等级，用于上位机观察" UBYTE BMS_CM_uint8 0 0 0 255 ECU_ADDRESS 0x0000 /* @ECU_Address@BDM_tPosResLoLv@ */ /end MEASUREMENT
/begin MEASUREMENT BDM_tPumpFlowErr "水泵流量异常，用于上位机观察" UBYTE BMS_CM_uint8 0 0 0 255 ECU_ADDRESS 0x0000 /* @ECU_Address@BDM_tPumpFlowErr@ */ /end MEASUREMENT
/begin MEASUREMENT BDM_tSOCDiffHiLv "最大和最小SOC相差过大故障等级，用于上位机观察" UBYTE BMS_CM_uint8 0 0 0 255 ECU_ADDRESS 0x0000 /* @ECU_Address@BDM_tSOCDiffHiLv@ */ /end MEASUREMENT
/begin MEASUREMENT BDM_tSOCHiLv "SOC过高故障等级，用于上位机观察" UBYTE BMS_CM_uint8 0 0 0 255 ECU_ADDRESS 0x0000 /* @ECU_Address@BDM_tSOCHiLv@ */ /end MEASUREMENT
/begin MEASUREMENT BDM_tSOCJumpHiLv "SOC跳变过大故障等级，用于上位机观察" UBYTE BMS_CM_uint8 0 0 0 255 ECU_ADDRESS 0x0000 /* @ECU_Address@BDM_tSOCJumpHiLv@ */ /end MEASUREMENT
/begin MEASUREMENT BDM_tSOCLoLv "SOC过低故障等级，用于上位机观察" UBYTE BMS_CM_uint8 0 0 0 255 ECU_ADDRESS 0x0000 /* @ECU_Address@BDM_tSOCLoLv@ */ /end MEASUREMENT
/begin MEASUREMENT BDM_tSOHLoErr "SOH过低故障等级，用于上位机观察" UBYTE BMS_CM_uint8 0 0 0 255 ECU_ADDRESS 0x0000 /* @ECU_Address@BDM_tSOHLoErr@ */ /end MEASUREMENT
/begin MEASUREMENT BDM_tThermalMagDisChgCurLoLv "热管理放电电流过低故障，用于上位机观察" UBYTE BMS_CM_uint8 0 0 0 255 ECU_ADDRESS 0x0000 /* @ECU_Address@BDM_tThermalMagDisChgCurLoLv@ */ /end MEASUREMENT
/begin MEASUREMENT BDM_tVIResLoLv "车上_整车绝缘异常，用于上位机观察" UBYTE BMS_CM_uint8 0 0 0 255 ECU_ADDRESS 0x0000 /* @ECU_Address@BDM_tVIResLoLv@ */ /end MEASUREMENT
/begin MEASUREMENT BDM_tWtrInTempHiErr "进水口温度过高故障，用于上位机观察" UBYTE BMS_CM_uint8 0 0 0 255 ECU_ADDRESS 0x0000 /* @ECU_Address@BDM_tWtrInTempHiErr@ */ /end MEASUREMENT
/begin MEASUREMENT BDM_tWtrInTempLoErr "进水口温度过低故障，用于上位机观察" UBYTE BMS_CM_uint8 0 0 0 255 ECU_ADDRESS 0x0000 /* @ECU_Address@BDM_tWtrInTempLoErr@ */ /end MEASUREMENT
/begin MEASUREMENT BDM_tWtrOutTempHiErr "出水口温度过高故障，用于上位机观察" UBYTE BMS_CM_uint8 0 0 0 255 ECU_ADDRESS 0x0000 /* @ECU_Address@BDM_tWtrOutTempHiErr@ */ /end MEASUREMENT
/begin MEASUREMENT BDM_tWtrOutTempLoErr "出水口温度过低故障，用于上位机观察" UBYTE BMS_CM_uint8 0 0 0 255 ECU_ADDRESS 0x0000 /* @ECU_Address@BDM_tWtrOutTempLoErr@ */ /end MEASUREMENT
/begin MEASUREMENT BDM_tZerodriftHiErr "第一电流传感器零漂过大故障，用于上位机观察" UBYTE BMS_CM_uint8 0 0 0 255 ECU_ADDRESS 0x0000 /* @ECU_Address@BDM_tZerodriftHiErr@ */ /end MEASUREMENT
/begin MEASUREMENT BDM_tmPlantTemp "板载温度过高故障，用于上位机观察" UBYTE BMS_CM_uint8 0 0 0 255 ECU_ADDRESS 0x0000 /* @ECU_Address@BDM_tmPlantTemp@ */ /end MEASUREMENT
/begin CHARACTERISTIC SOC_tBattShowSOCLookUp_C "显示SOC窗口区间" /* Characteristic Type */ CURVE 0x0000 /* @ECU_Address@SOC_tBattShowSOCLookUp_C@ */ Lookup1D_FLOAT32_IEEE /* Maxdiff */ 0 BMS_CM_single -3.4e+38 3.4e+38
 /begin AXIS_DESCR /* Description of X-Axis Points */ /* Axis Type */ COM_AXIS /* Reference to Input */ NO_INPUT_QUANTITY BMS_CM_single 22 -3.4e+38 3.4e+38 AXIS_PTS_REF SOC_tBattFollowSOCLookUp_C /end AXIS_DESCR
/end CHARACTERISTIC
/begin CHARACTERISTIC SOC_tStaticTimeCri_C "静置时间标准查表" /* Characteristic Type */ CURVE 0x0000 /* @ECU_Address@SOC_tStaticTimeCri_C@ */ Lookup1D_ULONG /* Maxdiff */ 0 BMS_CM_uint32 0 4.29497e+09
 /begin AXIS_DESCR /* Description of X-Axis Points */ /* Axis Type */ COM_AXIS /* Reference to Input */ NO_INPUT_QUANTITY BMS_CM_single 3 -3.4e+38 3.4e+38 AXIS_PTS_REF SOC_tStaticTempLookUp_C /end AXIS_DESCR
/end CHARACTERISTIC
/begin AXIS_PTS SOC_tBattFollowSOCLookUp_C "追随SOC区间" 0x0000 /* @ECU_Address@SOC_tBattFollowSOCLookUp_C@ */ /* Input Quantity */ NO_INPUT_QUANTITY Lookup1D_X_FLOAT32_IEEE 0 BMS_CM_single 22 -3.4e+38 3.4e+38 /end AXIS_PTS
/begin AXIS_PTS SOC_tStaticTempLookUp_C "温度查表" 0x0000 /* @ECU_Address@SOC_tStaticTempLookUp_C@ */ /* Input Quantity */ NO_INPUT_QUANTITY Lookup1D_X_FLOAT32_IEEE 0 BMS_CM_single 3 -3.4e+38 3.4e+38 /end AXIS_PTS
/begin COMPU_METHOD BMS_CM_double "Q = V" RAT_FUNC "%15.10" "" COEFFS 0 1 0 0 0 1 /end COMPU_METHOD
/begin COMPU_METHOD BMS_CM_int32 "Q = V" RAT_FUNC "%10.0" "" COEFFS 0 1 0 0 0 1 /end COMPU_METHOD
/begin COMPU_METHOD BMS_CM_single "Q = V" RAT_FUNC "%8.6" "" COEFFS 0 1 0 0 0 1 /end COMPU_METHOD
/begin COMPU_METHOD BMS_CM_uint32 "Q = V" RAT_FUNC "%10.0" "" COEFFS 0 1 0 0 0 1 /end COMPU_METHOD
/begin COMPU_METHOD BMS_CM_int16 "Q = V" RAT_FUNC "%5.0" "" COEFFS 0 1 0 0 0 1 /end COMPU_METHOD
/begin COMPU_METHOD BMS_CM_uint16 "Q = V" RAT_FUNC "%5.0" "" COEFFS 0 1 0 0 0 1 /end COMPU_METHOD
/begin COMPU_METHOD BMS_CM_int8 "Q = V" RAT_FUNC "%3.0" "" COEFFS 0 1 0 0 0 1 /end COMPU_METHOD
/begin COMPU_METHOD BMS_CM_uint8 "Q = V" RAT_FUNC "%3.0" "" COEFFS 0 1 0 0 0 1 /end COMPU_METHOD
/begin GROUP BMS_Calibration "BMS_Calibration" ROOT
 /begin REF_CHARACTERISTIC BDM_cDiscCellTempHiLv3HealTiDeb_U16 BDM_cDiscCellTempHiLv3HealValue_F32 BDM_cDiscCellTempHiLv3InitTiDeb_U16 BDM_cDiscCellTempHiLv3TiDeb_U16 BDM_cDiscCellTempHiLv3Value_F32 BDM_cDiscCellTempHiLv4En_U8 BDM_cDiscCellTempHiLv4HealEn_U8 BDM_cDiscCellTempHiLv4HealTiDeb_U16 BDM_cDiscCellTempHiLv4HealValue_F32 BDM_cDiscCellTempHiLv4InitTiDeb_U16 BDM_cDiscCellTempHiLv4TiDeb_U16 BDM_cDiscCellTempHiLv4Value_F32 BDM_cDiscCellTempLoLv1HealTiDeb_U16 BDM_cDiscCellTempLoLv1TiDeb_U16 BDM_cDiscCellTempLoLv3En_U8 BDM_cDiscCellTempLoLv3HealEn_U8 BDM_cDiscCellTempLoLv3HealTiDeb_U16 BDM_cDiscCellTempLoLv3HealValue_F32 BDM_cDiscCellTempLoLv3InitTiDeb_U16 BDM_cDiscCellTempLoLv3TiDeb_U16 BDM_cDiscCellTempLoLv3Value_F32 BDM_cDiscCurrHiLv1En_U8 BDM_cDiscCurrHiLv1HealEn_U8 BDM_cDiscCurrHiLv1HealTiDeb_U16 BDM_cDiscCurrHiLv1InitTiDeb_U16 BDM_cDiscCurrHiLv1TiDeb_U16 BDM_cDiscCurrHiLv2En_U8 BDM_cDiscCurrHiLv2HealEn_U8 BDM_cDiscCurrHiLv2HealTiDeb_U16 BDM_cDiscCurrHiLv2HealValue_F32 BDM_cDiscCurrHiLv2InitTiDeb_U16 BDM_cDiscCurrHiLv2TiDeb_U16 BDM_cDiscCurrHiLv2Value_F32 BDM_cDiscCurrHiLv3En_U8 BDM_cDiscCurrHiLv3HealEn_U8 BDM_cDiscCurrHiLv3HealTiDeb_U16 BDM_cDiscCurrHiLv3HealValue_F32 BDM_cDiscCurrHiLv3InitTiDeb_U16 BDM_cDiscCurrHiLv3TiDeb_U16 BDM_cDiscCurrHiLv3Value_F32 BDM_cDiscCurrHiLv4En_U8 BDM_cDiscCurrHiLv4HealEn_U8 BDM_cDiscCurrHiLv4HealTiDeb_U16 BDM_cDiscCurrHiLv4InitTiDeb_U16 BDM_cDiscCurrHiLv4TiDeb_U16 BDM_cFBPowHiLv1En_U8 BDM_cFBPowHiLv1HealEn_U8 BDM_cFBPowHiLv1HealTiDeb_U16 BDM_cFBPowHiLv1InitTiDeb_U16 BDM_cFBPowHiLv1TiDeb_U16 BDM_cFBPowHiLv2En_U8 BDM_cFBPowHiLv2HealEn_U8 BDM_cFBPowHiLv2HealTiDeb_U16 BDM_cFBPowHiLv2HealValue_F32 BDM_cFBPowHiLv2InitTiDeb_U16 BDM_cFBPowHiLv2TiDeb_U16 BDM_cFBPowHiLv2Value_F32 BDM_cFBPowHiLv3En_U8 BDM_cFBPowHiLv3HealEn_U8 BDM_cFBPowHiLv3HealTiDeb_U16 BDM_cFBPowHiLv3HealValue_F32 BDM_cFBPowHiLv3InitTiDeb_U16 BDM_cFBPowHiLv3TiDeb_U16 BDM_cFBPowHiLv3Value_F32 BDM_cFBPowHiLv4En_U8 BDM_cFBPowHiLv4HealEn_U8 BDM_cFBPowHiLv4HealTiDeb_U16 BDM_cFBPowHiLv4InitTiDeb_U16 BDM_cFBPowHiLv4TiDeb_U16 BDM_cFuseBreakErrLv1En_U8 BDM_cFuseBreakErrLv1HealEn_U8 BDM_cFuseBreakErrLv1HealTiDeb_U16 BDM_cFuseBreakErrLv1HealValue_F32 BDM_cFuseBreakErrLv1InitTiDeb_U16 BDM_cFuseBreakErrLv1TiDeb_U16 BDM_cFuseBreakErrLv1Value_F32 BDM_cHTBattVoltLoLv1HealValue_F32 BDM_cHTBattVoltLoLv1Value_F32 BDM_cHTBattVoltLoLv2HealValue_F32 BDM_cHTBattVoltLoLv2Value_F32 BDM_cHTBattVoltLoLv3HealValue_F32 BDM_cHTBattVoltLoLv3Value_F32 BDM_cHTCellVoltLoLv1HealValue_F32 BDM_cHTCellVoltLoLv1Value_F32 BDM_cHTCellVoltLoLv2HealValue_F32 BDM_cHTCellVoltLoLv2Value_F32 BDM_cHTCellVoltLoLv3HealValue_F32 BDM_cHTCellVoltLoLv3Value_F32 BDM_cHTCellVoltLoLv4HealValue_F32 BDM_cHTCellVoltLoLv4Value_F32 BDM_cHTCellVoltOverLoLv1HealValue_F32 BDM_cHTCellVoltOverLoLv1Value_F32 BDM_cIResLoLv1En_U8 BDM_cIResLoLv1HealEn_U8 BDM_cIResLoLv1HealTiDeb_U16 BDM_cIResLoLv1HealValue_F32 BDM_cIResLoLv1InitTiDeb_U16 BDM_cIResLoLv1TiDeb_U16 BDM_cIResLoLv1Value_F32 BDM_cIResLoLv2En_U8 BDM_cIResLoLv2HealEn_U8 BDM_cIResLoLv2HealTiDeb_U16 BDM_cIResLoLv2HealValue_F32 BDM_cIResLoLv2InitTiDeb_U16 BDM_cIResLoLv2TiDeb_U16 BDM_cIResLoLv2Value_F32 BDM_cIResLoLv3En_U8 BDM_cIResLoLv3HealEn_U8 BDM_cIResLoLv3HealTiDeb_U16 BDM_cIResLoLv3HealValue_F32 BDM_cIResLoLv3InitTiDeb_U16 BDM_cIResLoLv3TiDeb_U16 BDM_cIResLoLv3Value_F32 BDM_cIResLoLv4En_U8 BDM_cIResLoLv4HealEn_U8 BDM_cIResLoLv4HealTiDeb_U16 BDM_cIResLoLv4HealValue_F32 BDM_cIResLoLv4InitTiDeb_U16 BDM_cIResLoLv4TiDeb_U16 BDM_cIResLoLv4Value_F32 BDM_cLTBattVoltLoLv1HealValue_F32 BDM_cLTBattVoltLoLv1Value_F32 BDM_cLTBattVoltLoLv2HealValue_F32 BDM_cLTBattVoltLoLv2Value_F32 BDM_cLTBattVoltLoLv3HealValue_F32 BDM_cLTBattVoltLoLv3Value_F32 BDM_cLTCellVoltLoLv1HealValue_F32 BDM_cLTCellVoltLoLv1Value_F32 BDM_cLTCellVoltLoLv2HealValue_F32 BDM_cLTCellVoltLoLv2Value_F32 BDM_cLTCellVoltLoLv3HealValue_F32 BDM_cLTCellVoltLoLv3Value_F32 BDM_cLTCellVoltLoLv4HealValue_F32 BDM_cLTCellVoltLoLv4Value_F32 BDM_cMTBattVoltLoLv1HealValue_F32 BDM_cMTBattVoltLoLv1Value_F32 BDM_cMTBattVoltLoLv2HealValue_F32 BDM_cMTBattVoltLoLv2Value_F32 BDM_cMTBattVoltLoLv3HealValue_F32 BDM_cMTBattVoltLoLv3Value_F32 BDM_cMTCellVoltLoLv1HealValue_F32 BDM_cMTCellVoltLoLv1Value_F32 BDM_cMTCellVoltLoLv2HealValue_F32 BDM_cMTCellVoltLoLv2Value_F32 BDM_cMTCellVoltLoLv3HealValue_F32 BDM_cMTCellVoltLoLv3Value_F32 BDM_cPackPoleTempHiLv1En_U8 BDM_cPackPoleTempHiLv1HealEn_U8 BDM_cPackPoleTempHiLv1HealTiDeb_U16 BDM_cPackPoleTempHiLv1HealValue_F32 BDM_cPackPoleTempHiLv1InitTiDeb_U16 BDM_cPackPoleTempHiLv1TiDeb_U16 BDM_cPackPoleTempHiLv1Value_F32 BDM_cPackPoleTempHiLv2En_U8 BDM_cPackPoleTempHiLv2HealEn_U8 BDM_cPackPoleTempHiLv2HealTiDeb_U16 BDM_cPackPoleTempHiLv2HealValue_F32 BDM_cPackPoleTempHiLv2InitTiDeb_U16 BDM_cPackPoleTempHiLv2TiDeb_U16 BDM_cPackPoleTempHiLv2Value_F32 BDM_cPrChgResErrLv1En_U8 BDM_cPrChgResErrLv1HealEn_U8 BDM_cPrChgResErrLv1HealTiDeb_U16 BDM_cPrChgResErrLv1HealValue_F32 BDM_cPrChgResErrLv1InitTiDeb_U16 BDM_cPrChgResErrLv1TiDeb_U16 BDM_cPrChgResErrLv1Value_F32 BDM_cRlyTempHiLv1En_U8 BDM_cRlyTempHiLv1HealEn_U8 BDM_cRlyTempHiLv1HealTiDeb_U16 BDM_cRlyTempHiLv1HealValue_F32 BDM_cRlyTempHiLv1InitTiDeb_U16 BDM_cRlyTempHiLv1TiDeb_U16 BDM_cRlyTempHiLv1Value_F32 BDM_cRlyTempHiLv2En_U8 BDM_cRlyTempHiLv2HealEn_U8 BDM_cRlyTempHiLv2HealTiDeb_U16 BDM_cRlyTempHiLv2HealValue_F32 BDM_cRlyTempHiLv2InitTiDeb_U16 BDM_cRlyTempHiLv2TiDeb_U16 BDM_cRlyTempHiLv2Value_F32 BDM_cSOCDiffHiLv1En_U8 BDM_cSOCDiffHiLv1HealEn_U8 BDM_cSOCDiffHiLv1HealTiDeb_U16 BDM_cSOCDiffHiLv1HealValue_F32 BDM_cSOCDiffHiLv1InitTiDeb_U16 BDM_cSOCDiffHiLv1TiDeb_U16 BDM_cSOCDiffHiLv1Value_F32 BDM_cSOCHiLv1En_U8 BDM_cSOCHiLv1HealEn_U8 BDM_cSOCHiLv1HealTiDeb_U16 BDM_cSOCHiLv1HealValue_F32 BDM_cSOCHiLv1InitTiDeb_U16 BDM_cSOCHiLv1TiDeb_U16 BDM_cSOCHiLv1Value_F32 BDM_cSOCJumpHiLv1En_U8 BDM_cSOCJumpHiLv1HealEn_U8 BDM_cSOCJumpHiLv1HealTiDeb_U16 BDM_cSOCJumpHiLv1HealValue_F32 BDM_cSOCJumpHiLv1InitTiDeb_U16 BDM_cSOCJumpHiLv1TiDeb_U16 BDM_cSOCJumpHiLv1Value_F32 BDM_cSOCLoLv1En_U8 BDM_cSOCLoLv1HealEn_U8 BDM_cSOCLoLv1HealTiDeb_U16 BDM_cSOCLoLv1HealValue_F32 BDM_cSOCLoLv1InitTiDeb_U16 BDM_cSOCLoLv1TiDeb_U16 BDM_cSOCLoLv1Value_F32 BDM_cSOCLoLv2En_U8 BDM_cSOCLoLv2HealEn_U8 BDM_cSOCLoLv2HealTiDeb_U16 BDM_cSOCLoLv2HealValue_F32 BDM_cSOCLoLv2InitTiDeb_U16 BDM_cSOCLoLv2TiDeb_U16 BDM_cSOCLoLv2Value_F32 BDM_cSOCLoLv3En_U8 BDM_cSOCLoLv3HealEn_U8 BDM_cSOCLoLv3HealTiDeb_U16 BDM_cSOCLoLv3HealValue_F32 BDM_cSOCLoLv3InitTiDeb_U16 BDM_cSOCLoLv3TiDeb_U16 BDM_cSOCLoLv3Value_F32 BDM_cSOHLoLv1En_U8 BDM_cSOHLoLv1HealEn_U8 BDM_cSOHLoLv1HealTiDeb_U16 BDM_cSOHLoLv1HealValue_F32 BDM_cSOHLoLv1InitTiDeb_U16 BDM_cSOHLoLv1TiDeb_U16 BDM_cSOHLoLv1Value_F32 BDM_cSOHLoLv2En_U8 BDM_cSOHLoLv2HealEn_U8 BDM_cSOHLoLv2HealTiDeb_U16 BDM_cSOHLoLv2HealValue_F32 BDM_cSOHLoLv2InitTiDeb_U16 BDM_cSOHLoLv2TiDeb_U16 BDM_cSOHLoLv2Value_F32 BDM_cThermalMagDisChgCurLoLv1En_U8 BDM_cThermalMagDisChgCurLoLv1HealEn_U8 BDM_cThermalMagDisChgCurLoLv1HealTiDeb_U16 BDM_cThermalMagDisChgCurLoLv1InitTiDeb_U16 BDM_cThermalMagDisChgCurLoLv1TiDeb_U32 BDM_cWtrInTempHiLv1En_U8 BDM_cWtrInTempHiLv1HealEn_U8 BDM_cWtrInTempHiLv1HealTiDeb_U16 BDM_cWtrInTempHiLv1HealValue_F32 BDM_cWtrInTempHiLv1InitTiDeb_U16 BDM_cWtrInTempHiLv1TiDeb_U16 BDM_cWtrInTempHiLv1Value_F32 BDM_cWtrInTempLoLv1En_U8 BDM_cWtrInTempLoLv1HealEn_U8 BDM_cWtrInTempLoLv1HealTiDeb_U16 BDM_cWtrInTempLoLv1HealValue_F32 BDM_cWtrInTempLoLv1InitTiDeb_U16 BDM_cWtrInTempLoLv1TiDeb_U16 BDM_cWtrInTempLoLv1Value_F32 BDM_cWtrOutTempHiLv1En_U8 BDM_cWtrOutTempHiLv1HealEn_U8 BDM_cWtrOutTempHiLv1HealTiDeb_U16 BDM_cWtrOutTempHiLv1HealValue_F32 BDM_cWtrOutTempHiLv1InitTiDeb_U16 BDM_cWtrOutTempHiLv1TiDeb_U16 BDM_cWtrOutTempHiLv1Value_F32 BDM_cWtrOutTempLoLv1En_U8 BDM_cWtrOutTempLoLv1HealEn_U8 BDM_cWtrOutTempLoLv1HealTiDeb_U16 BDM_cWtrOutTempLoLv1HealValue_F32 BDM_cWtrOutTempLoLv1InitTiDeb_U16 BDM_cWtrOutTempLoLv1TiDeb_U16 BDM_cWtrOutTempLoLv1Value_F32 BDM_ccCellVoltHiLv1HealTiDeb_U16 BDM_ccCellVoltHiLv1TiDeb_U16 BDM_ccCellVoltHiLv2HealTiDeb_U16 BDM_ccCellVoltHiLv2TiDeb_U16 BDM_ccCellVoltHiLv3HealTiDeb_U16 BDM_ccCellVoltHiLv3TiDeb_U16 BDM_ccCellVoltHiLv4HealTiDeb_U16 BDM_ccCellVoltHiLv4TiDeb_U16 /end REF_CHARACTERISTIC
/end GROUP
/begin GROUP BMS_Observation "BMS_Observation" ROOT
 /begin REF_MEASUREMENT ACM_tDebugACChgEn ACM_tDebugACChgModeSt_U8 ACM_tDebugChrgLckOp SDM_tHVIL1Cycle SDM_tHVIL1Duty SDM_tHVIL2Cycle SDM_tHVIL2Duty FCM_tDebugDCChgMod EEP_tPowerOffOnTime LVM_ChangeConnector_CANTimeOut_U8 LVM_ChangeConnector_ConnectErr_U8 LVM_ChangeConnector_LockErr_U8 LVM_ChangeConnector_TempErr_U8 LVM_ChangeConnector_TempHi_U8 LVM_mVehCANErr_U8 CDP_PECErr_U8 SMC_tDebugACChgOffReqSt_U8 SMC_tDebugACChgReqSt_U8 SMC_tDebugBMSModeSt_U8 SMC_tDebugDCChgReqSt_U8 SMC_tDebugDcChgOffReqSt_U8 SMC_tDebugDiscReqOffSt_U8 SMC_tDebugDiscReqSt_U8 SMC_tDebugErrHvOffReqSt_U8 SMC_tDebugSelfCheckSt_U8 SMC_tDebugStandbyErrOffReq_U8 SMC_tDebugStationChgReqOffSt_U8 SMC_tDebugStationChgReqSt_U8 SMC_tDebugRlyReqSt_U8 SMC_tDebugThermalReqOffSt_U8 SMC_tDebugThermalReqSt_U8 CDP_mCellTempException_U8 CDP_mCellVoltException_U8 FCMGB_tChgFinish FCMGB_tGBDebugSt_U8 FCMGB_tChrgStpRasn FCMGB_tChgVoltMaxReq_F32 FCMGB_tChgCurrMaxReq_F32 FCMGB_tAPlusLoss_U8 RCM_tDebug_U8 B2T_ChgSt B2T_HVRequest B2T_HVRlySt B2T_SetTemp B2V_ST0_ChgNegRly1St B2V_ST0_ChgNegRly2St B2V_ST0_ChgPosRly1St B2V_ST0_ChgPosRly2St B2V_ST0_NegRlySt B2V_ST0_PosRlySt B2V_ST0_PreChgRlySt B2V_ST2_BattSOC B2V_ST2_BattSOH B2V_ST4_AvgCellTemp B2V_ST5_AvgCellVolt B2V_ST7_BranchCur1 B2V_ST7_BranchCur2 B2V_ST7_BranchCur3 B2V_ST7_BranchCur4 B2V_ST8_Version1 B2V_ST8_Version2 B2V_ST8_Version3 B2V_ST8_Version4 B2V_ST8_Version5 B2V_ST8_Version6 B2V_ST8_Version7 B2V_ST8_Version8 BMU_RealSOC BMU_RealSOH TRM_mPack1A1_U8 TRM_mPack1A2_U8 TRM_mPack2A1_U8 TRM_mPack2A2_U8 TRM_mPack3A1_U8 TRM_mPack3A2_U8 TRM_mPack4A1_U8 TRM_mPack4A2_U8 TRM_mPack1B_U8 TRM_mPack2B_U8 TRM_mPack3B_U8 TRM_mPack4B_U8 TRM_mPack1C_U8 TRM_mPack2C_U8 TRM_mPack3C_U8 TRM_mPack4C_U8 TRM_mPack1D_U8 TRM_mPack2D_U8 TRM_mPack3D_U8 TRM_mPack4D_U8 SOC_tDebugPack3BeforeFullEmpCaledMax SOC_tDebugPack3BeforeFullEmpCaledMin SOC_tDebugPack4BeforeFullEmpCaledMax SOC_tDebugPack4BeforeFullEmpCaledMin SOC_tDebugPack3StaticCalFlg SOC_tDebugPack4StaticCalFlg SDM_mHVIL1OpenErr_U8 SDM_mHVIL2OpenErr_U8 SDM_mHVIL3OpenErr_U8 SDM_mHVIL4OpenErr_U8 SDM_mHVIL5OpenErr_U8 SDM_mHVILOpenErr_U8 SDM_mHVILSt_U8 SDM_mInsulationResErr_U8 HVIL1Cycle_IN HVIL1Cycle_Out HVIL1Duty_IN HVIL1Duty_Out HVIL2Cycle_IN HVIL2Cycle_Out HVIL2Duty_IN HVIL2Duty_Out HVIL3Cycle_IN HVIL3Cycle_Out HVIL3Duty_IN HVIL3Duty_Out HVIL4Cycle_IN HVIL4Cycle_Out HVIL4Duty_IN HVIL4Duty_Out HVIL5Volt_IN HVIL5Volt_OUT BAU_info1_Count BAU_info2_Count BAU_info3_Count BAU_info4_Count BAU_info5_Count BAU_info6_Count BAU_info7_Count BAU_info7_Version_Day BAU_info7_Version_Month BAU_info7_Version_Num BAU_info7_Version_Year DCNeg1Temp DCNeg2Temp DCNeg3Temp DCNeg4Temp DCPos1Temp DCPos2Temp DCPos3Temp DCPos4Temp LVM_info6_AplusVolt LVM_info6_CCUSupplyVolt LVM_info6_HallSupplyVolt LVM_info6_KL15Volt LVM_info6_KL30Volt LVM_mBMSSupplyVoltHiLv_U8 LVM_mBMSSupplyVoltLoLv_U8 LVM_mBMSToTMS_WakeSt_U8 LVM_mCC2ConnectErr_U8 LVM_mCC2_2ConnectErr_U8 LVM_mDCNegTempErr_U8 LVM_mDCPosTempErr_U8 LVM_mDC_2NegTempErr_U8 LVM_mDC_2PosTempErr_U8 LVM_mDC_3NegTempErr_U8 LVM_mDC_3PosTempErr_U8 LVM_mDC_4NegTempErr_U8 LVM_mDC_4PosTempErr_U8 LVM_mWtrInTempErr_U8 LVM_mWtrIn_2TempErr_U8 LVM_mWtrIn_3TempErr_U8 LVM_mWtrIn_4TempErr_U8 LVM_mWtrOutTempErr_U8 LVM_mWtrOut_2TempErr_U8 LVM_mWtrOut_3TempErr_U8 LVM_mWtrOut_4TempErr_U8 WtrIn_3Temp WtrIn_4Temp WtrOUT_3Temp WtrOUT_4Temp RSP_mAChgPosRlySt RSP_mBChgPosRlySt RSP_mCChgPosRlySt RSP_mDChgPosRlySt RSP_mHeatRlySt RSP_mNegRlySt RSP_mNegRlySt2 RSP_mPosRlySt RSP_mPosRlySt2 mTMSFaultCodeLv_U8 SDM_DisableIso LVM_mCC2_3ConnectErr_U8 LVM_mCC2_4ConnectErr_U8 DCOSP_tDebugBcsCur_U16 SOH_Pack1DebugCycIndex_F32 SOH_Pack1DebugRealSOH_F32 SOH_Pack2DebugCycIndex_F32 SOH_Pack2DebugRealSOH_F32 SOH_Pack3DebugCycIndex_F32 SOH_Pack3DebugRealSOH_F32 SOH_Pack4DebugCycIndex_F32 SOH_Pack4DebugRealSOH_F32 CEB_mBMUCellBalancePositionAry_U8 CEB_mBalanceCtrlAry_U8 CEB_mBalanceOffDiffVol_U16 CEB_mBalanceOnDiffVol_U16 CEB_mCellBalanceState_U8 CEB_mCellBalanceWorkReminTimeAry_U16 CEB_mStaticFlag_U8 CEB_tBalanceMaxTime_U16 CEB_tCellRealSOCAry_F32 CEB_tDebug_U8 CEB_tDiffBalanceCtrlAry_U8 CEB_tDiffBalanceCtrlReq_U8 CEB_tDiffOfCompleteStaticSocAry_F32 CEB_tMaxCalSoc_F32 CEB_tMinCalSoc_F32 CEB_tMinSocIndex_U32 CEB_tOCVAdjustFlag_U8 CEB_tPwmCalInit_U8 CEB_tStaticBalanceReqLv_U8 CEB_tStaticBalanceTimeAry_U16 CHC_tDeBugCellVoltEnd CHC_tDebugDCCMLAllwMaxCurr CHC_tDebugDCCellVoltCurrReq CHC_tDebugDCCurrAllow CHC_tDebugDCCurrReq CHC_tDebugDCEndVoltCurrReq CHC_tDebugDCReqCurrwithTSM SOCRC_tDebugKFOneFixValue1Max SOCRC_tDebugKFOneFixValue1Min SOCRC_tDebugKFOneFixValue2Max SOCRC_tDebugKFOneFixValue2Min SOCRC_tDebugKFOneP1Max SOCRC_tDebugKFOneP1Min SOCRC_tDebugKFOneP2Max SOCRC_tDebugKFOneP2Min SOCRC_tDebugKFOneP3Max SOCRC_tDebugKFOneP3Min SOCRC_tDebugKFOneP4Max SOCRC_tDebugKFOneP4Min SOCRC_tDebugKFOneSOCMax SOCRC_tDebugKFOneSOCMin SOCRC_tDebugKFOneUpMax SOCRC_tDebugKFOneUpMin SOCRC_tDebugKFOneerrorVMax SOCRC_tDebugKFOneerrorVMin SOC_DebugStaticTime SOC_tDebugCalibrationSocSuccess SOC_tDebugCellRealMaxSOC SOC_tDebugCellRealMinSOC SOC_tDebugFollowSOCStateNum SOC_tDebugFullEmpCaledMax SOC_tDebugFullEmpCaledMin SOC_tDebugPack1BeforeFullEmpCaledMax SOC_tDebugPack1BeforeFullEmpCaledMin SOC_tDebugPack1StaticCalFlg SOC_tDebugPack2BeforeFullEmpCaledMax SOC_tDebugPack2BeforeFullEmpCaledMin SOC_tDebugPack2StaticCalFlg SOC_tDebugRealSOC FPM_TMSHVOffReq_U8 FPM_TMSShutDownReq_U8 FPM_tACChrgFunctions FPM_tBalanceFunctions FPM_tBattCurrentRelatedFunctions FPM_tBattVoltRelatedFunctions FPM_tCellTempRelatedFunctions FPM_tCellVoltRelatedFunctions FPM_tChargePause FPM_tChrgFltLevel FPM_tDCChrg2Functions FPM_tDCChrg3Functions FPM_tDCChrg4Functions FPM_tDCChrgFunctions FPM_tDiscFltLevel FPM_tDiscFunctions FPM_tEmerPowOff FPM_tFeedBackFunctions FPM_tFltLevel FPM_tFltLight FPM_tInsulationResRelatedFunctions FPM_tLimpPow FPM_tRLyFunctions FPM_tReACChrgPow FPM_tReDCChrg2Pow FPM_tReDCChrg3Pow FPM_tReDCChrg4Pow FPM_tReDCChrgPow FPM_tReDiscPow FPM_tReFBPow FPM_tSOCRelatedFunctions FPM_tSafeStop FPM_tSelfCheck FPM_tSupplyVoltRelatedFunctions FPM_tThermalManageFunctions BDM_mBranchRoadBreak_U8 BDM_mCellTempOverHiLv_U8 BDM_mCellVoltLimitLoLv_U8 BDM_mCellVoltOverHiLv_U8 BDM_mCellVoltOverLoLv_U8 BDM_mChgDiscCurrHiLv_U8 BDM_mChgIResLo_U8 BDM_mPlantTempHiErr_U8 BDM_mReChgEngSysmatchErr_U8 BDM_tACChgCurrHiLv BDM_tACNegTempHiLv BDM_tACPosTempHiLv BDM_tActInputVoltErr BDM_tBIResLoLv BDM_tBatResErr BDM_tBattVoltErr BDM_tBattVoltHiLv BDM_tBattVoltLoLv BDM_tCellTempDiffHiLv BDM_tCellTempExceedMaxChgTemp BDM_tCellTempHiLv BDM_tCellTempLowerMaxChgTemp BDM_tCellVoltDiffHiLv BDM_tCellVoltHiLv BDM_tCellVoltLoLv BDM_tChgBattVoltHiLv BDM_tChgCellTempHiLv BDM_tChgCellTempLoLv BDM_tChgCellVoltHiLv BDM_tChgCurrAbnormErr BDM_tChgIResLo BDM_tDCChgCurrHiLv BDM_tDCNegTempHiLv BDM_tDCNeg_2TempHiLv BDM_tDCNeg_3TempHiLv BDM_tDCNeg_4TempHiLv BDM_tDCPosTempHiLv BDM_tDCPos_2TempHiLv BDM_tDCPos_3TempHiLv BDM_tDCPos_4TempHiLv BDM_tDiscCurrHiLv BDM_tDischgBattVoltHiLv BDM_tDischgCellTempHiLv BDM_tDischgCellTempLoLv BDM_tDischgCellVoltHiLv BDM_tFBCurrHiLv BDM_tFuseBreakErr BDM_tHeatUncontrolErr BDM_tIResLoLv BDM_tNegResLoLv BDM_tOverChg BDM_tPackNegTempHiLv BDM_tPackPosTempHiLv BDM_tPosResLoLv BDM_tPumpFlowErr BDM_tSOCDiffHiLv BDM_tSOCHiLv BDM_tSOCJumpHiLv BDM_tSOCLoLv BDM_tSOHLoErr BDM_tThermalMagDisChgCurLoLv BDM_tVIResLoLv BDM_tWtrInTempHiErr BDM_tWtrInTempLoErr BDM_tWtrOutTempHiErr BDM_tWtrOutTempLoErr BDM_tZerodriftHiErr BDM_tmPlantTemp /end REF_MEASUREMENT
/end GROUP
/begin GROUP BMS_Table "BMS_Table" ROOT
 /begin REF_MEASUREMENT SOC_tBattFollowSOCLookUp_C SOC_tStaticTempLookUp_C SOC_tBattShowSOCLookUp_C SOC_tStaticTimeCri_C /end REF_MEASUREMENT
/end GROUP
/end MODULE
/end PROJECT
